AUTOSAR XML (schema 00047)
package /Adc
  module config Adc
    NewAdcConfigSet0 (AdcConfigSet)
      3 x AdcHwUnit, all with AdcSuspendMethod=ADC_SUSPEND_METHOD_SYNC, AdcResultFormat=ADC_FORMAT_UNSIGNED_INTEGER, AdcResultAlign=ADC_ALIGN_RIGHT, AdcReSolution=ADC_RESOLUTION_12BIT, AdcSamplingPeriod=ADC_SAMPLING_PERIOD_18STATES, AdcBufferAmp=true:
        NewAdcHwUnit0
          4 x AdcHwUnitTH, all with AdcUseTH=false:
            NewAdcHwUnitTH{0..3}
        NewAdcHwUnit1
          4 x AdcHwUnitTH, all with AdcUseTH=false:
            NewAdcHwUnitTH{0..3}
        NewAdcHwUnit2
      NewAdcGroup0 (AdcGroup):
        AdcGroupConversionMode = ADC_CONV_MODE_ONESHOT
        AdcGroupId = ADC_GR_0
        AdcGroupTriggSrc = ADC_TRIGG_SRC_SW
        AdcHwTrigSignal = PIC2_EDG_DIRECT_RISING
        AdcUseTAUD{0..3} = false
        AdcUseTSG30TG0 = false
        AdcUseTSG30TG1 = false
        AdcUseE3S0AD = false
        AdcUseE3S0AD1 = false
        AdcUseTAUD2Ch7 = false
        AdcUseTAUD2Ch15 = false
        AdcUseTAUJ{0..3}Ch3 = false
        AdcHwUnitId = ADC_HWUNIT0
        AdcScanGroupId = ADC_SG0
        AdcDmaId = ADC_DMA_OFF
        AdcUseDmaHalfInt = false
        AdcAccessMode = ADC_ACCESS_MODE_SINGLE
        AdcStreamingNum = 1
        12 x AdcGroupDefinition:
          NewAdcGroupDefinition0: AdcConvChannel=ADC_CH00
          NewAdcGroupDefinition1: AdcConvChannel=ADC_CH01
          NewAdcGroupDefinition2: AdcConvChannel=ADC_CH02
          NewAdcGroupDefinition3: AdcConvChannel=ADC_CH03
          NewAdcGroupDefinition4: AdcConvChannel=ADC_CH04
          NewAdcGroupDefinition5: AdcConvChannel=ADC_CH05
          NewAdcGroupDefinition6: AdcConvChannel=ADC_CH06
          NewAdcGroupDefinition7: AdcConvChannel=ADC_CH07
          NewAdcGroupDefinition8: AdcConvChannel=ADC_CH08
          NewAdcGroupDefinition9: AdcConvChannel=ADC_CH17
          NewAdcGroupDefinition10: AdcConvChannel=ADC_CH18
          NewAdcGroupDefinition11: AdcConvChannel=ADC_CH19
      4 x AdcTAUD:
        NewAdcTAUD0
          5 x AdcTAUDScanGroup:
            NewAdcTAUDScanGroup{0..4}
        NewAdcTAUD1
          5 x AdcTAUDScanGroup:
            NewAdcTAUDScanGroup{0..4}
        NewAdcTAUD2
          5 x AdcTAUDScanGroup:
            NewAdcTAUDScanGroup{0..4}
        NewAdcTAUD3
          5 x AdcTAUDScanGroup:
            NewAdcTAUDScanGroup{0..4}
      NewAdcGroup1 (AdcGroup):
        AdcGroupConversionMode = ADC_CONV_MODE_ONESHOT
        AdcGroupId = ADC_GR_1
        AdcGroupTriggSrc = ADC_TRIGG_SRC_SW
        AdcHwTrigSignal = PIC2_EDG_DIRECT_RISING
        AdcUseTAUD{0..3} = false
        AdcUseTSG30TG0 = false
        AdcUseTSG30TG1 = false
        AdcUseE3S0AD = false
        AdcUseE3S0AD1 = false
        AdcUseTAUD2Ch7 = false
        AdcUseTAUD2Ch15 = false
        AdcUseTAUJ{0..3}Ch3 = false
        AdcHwUnitId = ADC_HWUNIT1
        AdcScanGroupId = ADC_SG0
        AdcDmaId = ADC_DMA_OFF
        AdcUseDmaHalfInt = false
        AdcAccessMode = ADC_ACCESS_MODE_SINGLE
        AdcStreamingNum = 1
        16 x AdcGroupDefinition:
          NewAdcGroupDefinition0: AdcConvChannel=ADC_CH00
          NewAdcGroupDefinition1: AdcConvChannel=ADC_CH01
          NewAdcGroupDefinition2: AdcConvChannel=ADC_CH02
          NewAdcGroupDefinition3: AdcConvChannel=ADC_CH03
          NewAdcGroupDefinition4: AdcConvChannel=ADC_CH04
          NewAdcGroupDefinition5: AdcConvChannel=ADC_CH05
          NewAdcGroupDefinition6: AdcConvChannel=ADC_CH06
          NewAdcGroupDefinition7: AdcConvChannel=ADC_CH07
          NewAdcGroupDefinition8: AdcConvChannel=ADC_CH09
          NewAdcGroupDefinition9: AdcConvChannel=ADC_CH10
          NewAdcGroupDefinition10: AdcConvChannel=ADC_CH11
          NewAdcGroupDefinition11: AdcConvChannel=ADC_CH12
          NewAdcGroupDefinition12: AdcConvChannel=ADC_CH13
          NewAdcGroupDefinition13: AdcConvChannel=ADC_CH14
          NewAdcGroupDefinition14: AdcConvChannel=ADC_CH15
          NewAdcGroupDefinition15: AdcConvChannel=ADC_CH17
      NewAdcGroup2 (AdcGroup):
        AdcGroupConversionMode = ADC_CONV_MODE_ONESHOT
        AdcGroupId = ADC_GR_2
        AdcGroupTriggSrc = ADC_TRIGG_SRC_SW
        AdcHwTrigSignal = PIC2_EDG_DIRECT_RISING
        AdcUseTAUD{0..3} = false
        AdcUseTSG30TG0 = false
        AdcUseTSG30TG1 = false
        AdcUseE3S0AD = false
        AdcUseE3S0AD1 = false
        AdcUseTAUD2Ch7 = false
        AdcUseTAUD2Ch15 = false
        AdcUseTAUJ{0..3}Ch3 = false
        AdcHwUnitId = ADC_HWUNIT2
        AdcScanGroupId = ADC_SG0
        AdcDmaId = ADC_DMA_OFF
        AdcUseDmaHalfInt = false
        AdcAccessMode = ADC_ACCESS_MODE_SINGLE
        AdcStreamingNum = 1
        NewAdcGroupDefinition0 (AdcGroupDefinition): AdcConvChannel=ADC_CH03
        NewAdcGroupDefinition1 (AdcGroupDefinition): AdcConvChannel=ADC_CH04
    NewAdcGeneral0 (AdcGeneral):
      AdcPackage = ADC_U2A16_373
      AdcDeInitApi = false
      AdcEnableStartStopGroupApi = true
      AdcHwTriggerApi = false
      AdcReadGroupApi = true
      AdcDetReportRuntimeError = false
      AdcProcessTimeOut = 2000
      AdcRegisterCheck = false
      AdcRegisterRefresh = false
      AdcGlobalRegisterControl = true
