[part 2 of 2: package /Port]
AUTOSAR XML (schema 00047)
package /Port  (continued)
  module config Port  (continued)
    NewPortConfigSet1 (PortConfigSet)
      21 x PortContainer:
        NewPortContainer0: PortNumber=0, PortNumberOfPortPins=13
          13 x PortPin, all with PortIsSetPinConfig=true, PortPinDirectionChangeable=true, PortPinModeChangeable=true, PortPinLevelValue=PORT_PIN_LEVEL_LOW, PortDriveStrength=VERY_LOW_DRIVER, PortOpenDrainControl=PUSH_PULL, PortInputBufferType=INPUT_TYPE_SHMT1, PortEnableOutputvalueInversion=false, PortEnableBiDirectionMode=false, PortIsSetSafeStateConfig=true, PortSetSafeStateTrigger=DISABLE, PortEnableIPControl=false:
            NewPortPin0: PortPinId=0, PortPinDirection=PORT_PIN_OUT, PortPinInitialMode=GPIO, PortPinMode=GPIO, PortPullUpPullDown=NO_PULL, PortEnableInputBuffer=false
            NewPortPin1: PortPinId=1, PortPinDirection=PORT_PIN_OUT, PortPinInitialMode=GPIO, PortPinMode=GPIO, PortPullUpPullDown=NO_PULL, PortEnableInputBuffer=false
            NewPortPin2: PortPinId=2, PortPinDirection=PORT_PIN_IN, PortPinInitialMode=ALT3, PortPinMode=ALT3, PortPullUpPullDown=PULL_DOWN, PortEnableInputBuffer=false
            NewPortPin3: PortPinId=3, PortPinDirection=PORT_PIN_OUT, PortPinInitialMode=GPIO, PortPinMode=GPIO, PortPullUpPullDown=NO_PULL, PortEnableInputBuffer=false
            NewPortPin4: PortPinId=4, PortPinDirection=PORT_PIN_IN, PortPinInitialMode=ALT3, PortPinMode=ALT3, PortPullUpPullDown=PULL_DOWN, PortEnableInputBuffer=false
            NewPortPin5: PortPinId=5, PortPinDirection=PORT_PIN_OUT, PortPinInitialMode=GPIO, PortPinMode=GPIO, PortPullUpPullDown=NO_PULL, PortEnableInputBuffer=false
            NewPortPin6: PortPinId=6, PortPinDirection=PORT_PIN_OUT, PortPinInitialMode=GPIO, PortPinMode=GPIO, PortPullUpPullDown=NO_PULL, PortEnableInputBuffer=false
            NewPortPin7: PortPinId=7, PortPinDirection=PORT_PIN_IN, PortPinInitialMode=GPIO, PortPinMode=GPIO, PortPullUpPullDown=PULL_DOWN, PortEnableInputBuffer=true
            NewPortPin8: PortPinId=8, PortPinDirection=PORT_PIN_OUT, PortPinInitialMode=GPIO, PortPinMode=GPIO, PortPullUpPullDown=NO_PULL, PortEnableInputBuffer=false
            NewPortPin9: PortPinId=9, PortPinDirection=PORT_PIN_IN, PortPinInitialMode=GPIO, PortPinMode=GPIO, PortPullUpPullDown=PULL_DOWN, PortEnableInputBuffer=true
            NewPortPin10: PortPinId=10, PortPinDirection=PORT_PIN_IN, PortPinInitialMode=GPIO, PortPinMode=GPIO, PortPullUpPullDown=PULL_DOWN, PortEnableInputBuffer=true
            NewPortPin11: PortPinId=11, PortPinDirection=PORT_PIN_OUT, PortPinInitialMode=GPIO, PortPinMode=GPIO, PortPullUpPullDown=NO_PULL, PortEnableInputBuffer=false
            NewPortPin12: PortPinId=12, PortPinDirection=PORT_PIN_IN, PortPinInitialMode=ALT3, PortPinMode=ALT3, PortPullUpPullDown=PULL_DOWN, PortEnableInputBuffer=false
        NewPortContainer2: PortNumber=2, PortNumberOfPortPins=16
          16 x PortPin, all with PortIsSetPinConfig=true, PortPinDirectionChangeable=true, PortPinModeChangeable=true, PortPinLevelValue=PORT_PIN_LEVEL_LOW, PortOpenDrainControl=PUSH_PULL, PortInputBufferType=INPUT_TYPE_SHMT1, PortEnableOutputvalueInversion=false, PortEnableBiDirectionMode=false, PortIsSetSafeStateConfig=true, PortSetSafeStateTrigger=DISABLE, PortEnableIPControl=false:
            NewPortPin0: PortPinId=0, PortPinDirection=PORT_PIN_OUT, PortPinInitialMode=GPIO, PortPinMode=GPIO, PortPullUpPullDown=NO_PULL, PortDriveStrength=VERY_LOW_DRIVER, PortEnableInputBuffer=false
            NewPortPin1: PortPinId=1, PortPinDirection=PORT_PIN_OUT, PortPinInitialMode=GPIO, PortPinMode=GPIO, PortPullUpPullDown=NO_PULL, PortDriveStrength=VERY_LOW_DRIVER, PortEnableInputBuffer=false
            NewPortPin2: PortPinId=2, PortPinDirection=PORT_PIN_IN, PortPinInitialMode=GPIO, PortPinMode=GPIO, PortPullUpPullDown=PULL_DOWN, PortDriveStrength=VERY_LOW_DRIVER, PortEnableInputBuffer=true
            NewPortPin3: PortPinId=3, PortPinDirection=PORT_PIN_OUT, PortPinInitialMode=GPIO, PortPinMode=GPIO, PortPullUpPullDown=NO_PULL, PortDriveStrength=VERY_LOW_DRIVER, PortEnableInputBuffer=false
            NewPortPin4: PortPinId=4, PortPinDirection=PORT_PIN_OUT, PortPinInitialMode=ALT5, PortPinMode=ALT5, PortPullUpPullDown=NO_PULL, PortDriveStrength=VERY_LOW_DRIVER, PortEnableInputBuffer=false
            NewPortPin5: PortPinId=5, PortPinDirection=PORT_PIN_IN, PortPinInitialMode=ALT5, PortPinMode=ALT5, PortPullUpPullDown=NO_PULL, PortDriveStrength=VERY_LOW_DRIVER, PortEnableInputBuffer=false
            NewPortPin6: PortPinId=6, PortPinDirection=PORT_PIN_OUT, PortPinInitialMode=ALT6, PortPinMode=ALT6, PortPullUpPullDown=NO_PULL, PortDriveStrength=VERY_LOW_DRIVER, PortEnableInputBuffer=false
            NewPortPin7: PortPinId=7, PortPinDirection=PORT_PIN_IN, PortPinInitialMode=GPIO, PortPinMode=GPIO, PortPullUpPullDown=PULL_DOWN, PortDriveStrength=VERY_LOW_DRIVER, PortEnableInputBuffer=true
            NewPortPin8: PortPinId=8, PortPinDirection=PORT_PIN_OUT, PortPinInitialMode=ALT6, PortPinMode=ALT6, PortPullUpPullDown=NO_PULL, PortDriveStrength=VERY_LOW_DRIVER, PortEnableInputBuffer=false
            NewPortPin9: PortPinId=9, PortPinDirection=PORT_PIN_IN, PortPinInitialMode=ALT3, PortPinMode=ALT3, PortPullUpPullDown=NO_PULL, PortDriveStrength=VERY_LOW_DRIVER, PortEnableInputBuffer=false
            NewPortPin10: PortPinId=10, PortPinDirection=PORT_PIN_OUT, PortPinInitialMode=GPIO, PortPinMode=GPIO, PortPullUpPullDown=NO_PULL, PortDriveStrength=VERY_LOW_DRIVER, PortEnableInputBuffer=false
            NewPortPin11: PortPinId=11, PortPinDirection=PORT_PIN_IN, PortPinInitialMode=GPIO, PortPinMode=GPIO, PortPullUpPullDown=PULL_DOWN, PortDriveStrength=VERY_LOW_DRIVER, PortEnableInputBuffer=true
            NewPortPin{12..14}: PortPinId={12..14}, PortPinDirection=PORT_PIN_OUT, PortPinInitialMode=GPIO, PortPinMode=GPIO, PortPullUpPullDown=NO_PULL, PortDriveStrength=MEDIUM_DRIVER, PortEnableInputBuffer=false
            NewPortPin15: PortPinId=15, PortPinDirection=PORT_PIN_OUT, PortPinInitialMode=GPIO, PortPinMode=GPIO, PortPullUpPullDown=NO_PULL, PortDriveStrength=VERY_LOW_DRIVER, PortEnableInputBuffer=false
        NewPortContainer3: PortNumber=3, PortNumberOfPortPins=9
          9 x PortPin, all with PortIsSetPinConfig=true, PortPinDirectionChangeable=true, PortPinModeChangeable=true, PortPinLevelValue=PORT_PIN_LEVEL_LOW, PortDriveStrength=VERY_LOW_DRIVER, PortOpenDrainControl=PUSH_PULL, PortInputBufferType=INPUT_TYPE_SHMT1, PortEnableOutputvalueInversion=false, PortEnableBiDirectionMode=false, PortIsSetSafeStateConfig=true, PortSetSafeStateTrigger=DISABLE, PortEnableIPControl=false:
            NewPortPin0: PortPinId=0, PortPinDirection=PORT_PIN_IN, PortPinInitialMode=ALT3, PortPinMode=ALT3, PortPullUpPullDown=PULL_DOWN, PortEnableInputBuffer=false
            NewPortPin1: PortPinId=1, PortPinDirection=PORT_PIN_IN, PortPinInitialMode=GPIO, PortPinMode=GPIO, PortPullUpPullDown=PULL_DOWN, PortEnableInputBuffer=true
            NewPortPin2: PortPinId=2, PortPinDirection=PORT_PIN_IN, PortPinInitialMode=GPIO, PortPinMode=GPIO, PortPullUpPullDown=PULL_DOWN, PortEnableInputBuffer=true
            NewPortPin3: PortPinId=3, PortPinDirection=PORT_PIN_OUT, PortPinInitialMode=GPIO, PortPinMode=GPIO, PortPullUpPullDown=NO_PULL, PortEnableInputBuffer=false
            NewPortPin4: PortPinId=4, PortPinDirection=PORT_PIN_OUT, PortPinInitialMode=ALT2, PortPinMode=ALT2, PortPullUpPullDown=NO_PULL, PortEnableInputBuffer=false
            NewPortPin5: PortPinId=5, PortPinDirection=PORT_PIN_IN, PortPinInitialMode=ALT2, PortPinMode=ALT2, PortPullUpPullDown=NO_PULL, PortEnableInputBuffer=false
            NewPortPin6: PortPinId=6, PortPinDirection=PORT_PIN_IN, PortPinInitialMode=GPIO, PortPinMode=GPIO, PortPullUpPullDown=PULL_DOWN, PortEnableInputBuffer=true
            NewPortPin7: PortPinId=7, PortPinDirection=PORT_PIN_IN, PortPinInitialMode=GPIO, PortPinMode=GPIO, PortPullUpPullDown=NO_PULL, PortEnableInputBuffer=true
            NewPortPin8: PortPinId=8, PortPinDirection=PORT_PIN_IN, PortPinInitialMode=GPIO, PortPinMode=GPIO, PortPullUpPullDown=NO_PULL, PortEnableInputBuffer=true
        NewPortContainer4: PortNumber=4, PortNumberOfPortPins=14
          14 x PortPin, all with PortIsSetPinConfig=true, PortPinDirectionChangeable=true, PortPinModeChangeable=true, PortPinLevelValue=PORT_PIN_LEVEL_LOW, PortDriveStrength=VERY_LOW_DRIVER, PortOpenDrainControl=PUSH_PULL, PortInputBufferType=INPUT_TYPE_SHMT1, PortEnableOutputvalueInversion=false, PortEnableBiDirectionMode=false, PortIsSetSafeStateConfig=true, PortSetSafeStateTrigger=DISABLE, PortEnableIPControl=false:
            NewPortPin0: PortPinId=0, PortPinDirection=PORT_PIN_OUT, PortPinInitialMode=GPIO, PortPinMode=GPIO, PortPullUpPullDown=NO_PULL, PortEnableInputBuffer=false
            NewPortPin1: PortPinId=1, PortPinDirection=PORT_PIN_IN, PortPinInitialMode=GPIO, PortPinMode=GPIO, PortPullUpPullDown=PULL_DOWN, PortEnableInputBuffer=true
            NewPortPin4: PortPinId=4, PortPinDirection=PORT_PIN_IN, PortPinInitialMode=ALT4, PortPinMode=ALT4, PortPullUpPullDown=NO_PULL, PortEnableInputBuffer=false
            NewPortPin5: PortPinId=5, PortPinDirection=PORT_PIN_OUT, PortPinInitialMode=GPIO, PortPinMode=GPIO, PortPullUpPullDown=NO_PULL, PortEnableInputBuffer=false
            NewPortPin6: PortPinId=6, PortPinDirection=PORT_PIN_OUT, PortPinInitialMode=GPIO, PortPinMode=GPIO, PortPullUpPullDown=NO_PULL, PortEnableInputBuffer=false
            NewPortPin7: PortPinId=7, PortPinDirection=PORT_PIN_IN, PortPinInitialMode=GPIO, PortPinMode=GPIO, PortPullUpPullDown=PULL_DOWN, PortEnableInputBuffer=true
            NewPortPin8: PortPinId=8, PortPinDirection=PORT_PIN_OUT, PortPinInitialMode=GPIO, PortPinMode=GPIO, PortPullUpPullDown=NO_PULL, PortEnableInputBuffer=false
            NewPortPin9: PortPinId=9, PortPinDirection=PORT_PIN_IN, PortPinInitialMode=GPIO, PortPinMode=GPIO, PortPullUpPullDown=PULL_DOWN, PortEnableInputBuffer=true
            NewPortPin10: PortPinId=10, PortPinDirection=PORT_PIN_IN, PortPinInitialMode=GPIO, PortPinMode=GPIO, PortPullUpPullDown=PULL_DOWN, PortEnableInputBuffer=true
            NewPortPin11: PortPinId=11, PortPinDirection=PORT_PIN_OUT, PortPinInitialMode=ALT2, PortPinMode=ALT2, PortPullUpPullDown=NO_PULL, PortEnableInputBuffer=false
            NewPortPin12: PortPinId=12, PortPinDirection=PORT_PIN_IN, PortPinInitialMode=ALT2, PortPinMode=ALT2, PortPullUpPullDown=NO_PULL, PortEnableInputBuffer=false
            NewPortPin13: PortPinId=13, PortPinDirection=PORT_PIN_OUT, PortPinInitialMode=GPIO, PortPinMode=GPIO, PortPullUpPullDown=NO_PULL, PortEnableInputBuffer=false
            NewPortPin14: PortPinId=14, PortPinDirection=PORT_PIN_OUT, PortPinInitialMode=GPIO, PortPinMode=GPIO, PortPullUpPullDown=NO_PULL, PortEnableInputBuffer=false
            NewPortPin15: PortPinId=15, PortPinDirection=PORT_PIN_IN, PortPinInitialMode=GPIO, PortPinMode=GPIO, PortPullUpPullDown=NO_PULL, PortEnableInputBuffer=true
        NewPortContainer5: PortNumber=5, PortNumberOfPortPins=4
          4 x PortPin, all with PortPinDirectionChangeable=true, PortPinModeChangeable=true, PortPinDirection=PORT_PIN_IN, PortPinLevelValue=PORT_PIN_LEVEL_LOW, PortDriveStrength=VERY_LOW_DRIVER, PortOpenDrainControl=PUSH_PULL, PortInputBufferType=INPUT_TYPE_SHMT1, PortEnableOutputvalueInversion=false, PortEnableBiDirectionMode=false, PortIsSetSafeStateConfig=true, PortSetSafeStateTrigger=DISABLE, PortEnableIPControl=false:
            NewPortPin2: PortPinId=2, PortIsSetPinConfig=true, PortPinInitialMode=GPIO, PortPinMode=GPIO, PortPullUpPullDown=NO_PULL, PortEnableInputBuffer=true
            NewPortPin3: PortPinId=3, PortIsSetPinConfig=false, PortPinInitialMode=GPIO, PortPinMode=GPIO, PortPullUpPullDown=NO_PULL, PortEnableInputBuffer=false
            NewPortPin4: PortPinId=4, PortIsSetPinConfig=true, PortPinInitialMode=ALT8, PortPinMode=ALT8, PortPullUpPullDown=NO_PULL, PortEnableInputBuffer=false
            NewPortPin6: PortPinId=6, PortIsSetPinConfig=true, PortPinInitialMode=GPIO, PortPinMode=GPIO, PortPullUpPullDown=PULL_DOWN, PortEnableInputBuffer=true
        NewPortContainer6: PortNumber=6, PortNumberOfPortPins=15
          15 x PortPin, all with PortPinDirectionChangeable=true, PortPinModeChangeable=true, PortPinLevelValue=PORT_PIN_LEVEL_LOW, PortOpenDrainControl=PUSH_PULL, PortInputBufferType=INPUT_TYPE_SHMT1, PortEnableOutputvalueInversion=false, PortEnableBiDirectionMode=false, PortIsSetSafeStateConfig=true, PortSetSafeStateTrigger=DISABLE, PortEnableIPControl=false:
            NewPortPin0: PortPinId=0, PortIsSetPinConfig=true, PortPinDirection=PORT_PIN_OUT, PortPinInitialMode=GPIO, PortPinMode=GPIO, PortPullUpPullDown=NO_PULL, PortDriveStrength=VERY_LOW_DRIVER, PortEnableInputBuffer=false
            NewPortPin{2..4}: PortPinId={2..4}, PortIsSetPinConfig=true, PortPinDirection=PORT_PIN_IN, PortPinInitialMode=GPIO, PortPinMode=GPIO, PortPullUpPullDown=PULL_DOWN, PortDriveStrength=VERY_LOW_DRIVER, PortEnableInputBuffer=true
            NewPortPin5: PortPinId=5, PortIsSetPinConfig=true, PortPinDirection=PORT_PIN_IN, PortPinInitialMode=GPIO, PortPinMode=GPIO, PortPullUpPullDown=PULL_UP, PortDriveStrength=VERY_LOW_DRIVER, PortEnableInputBuffer=true
            NewPortPin{6..9}: PortPinId={6..9}, PortIsSetPinConfig=true, PortPinDirection=PORT_PIN_OUT, PortPinInitialMode=GPIO, PortPinMode=GPIO, PortPullUpPullDown=NO_PULL, PortDriveStrength=VERY_LOW_DRIVER, PortEnableInputBuffer=false
            NewPortPin10: PortPinId=10, PortIsSetPinConfig=true, PortPinDirection=PORT_PIN_OUT, PortPinInitialMode=GPIO, PortPinMode=GPIO, PortPullUpPullDown=NO_PULL, PortDriveStrength=HIGH_DRIVER, PortEnableInputBuffer=false
            NewPortPin11: PortPinId=11, PortIsSetPinConfig=true, PortPinDirection=PORT_PIN_OUT, PortPinInitialMode=GPIO, PortPinMode=GPIO, PortPullUpPullDown=NO_PULL, PortDriveStrength=VERY_LOW_DRIVER, PortEnableInputBuffer=false
            NewPortPin12: PortPinId=12, PortIsSetPinConfig=true, PortPinDirection=PORT_PIN_OUT, PortPinInitialMode=ALT4, PortPinMode=ALT4, PortPullUpPullDown=NO_PULL, PortDriveStrength=VERY_LOW_DRIVER, PortEnableInputBuffer=false
            NewPortPin13: PortPinId=13, PortIsSetPinConfig=false, PortPinDirection=PORT_PIN_IN, PortPinInitialMode=GPIO, PortPinMode=GPIO, PortPullUpPullDown=NO_PULL, PortDriveStrength=VERY_LOW_DRIVER, PortEnableInputBuffer=false
            NewPortPin14: PortPinId=14, PortIsSetPinConfig=false, PortPinDirection=PORT_PIN_IN, PortPinInitialMode=GPIO, PortPinMode=GPIO, PortPullUpPullDown=NO_PULL, PortDriveStrength=VERY_LOW_DRIVER, PortEnableInputBuffer=false
            NewPortPin15: PortPinId=15, PortIsSetPinConfig=true, PortPinDirection=PORT_PIN_IN, PortPinInitialMode=ALT7, PortPinMode=ALT7, PortPullUpPullDown=NO_PULL, PortDriveStrength=VERY_LOW_DRIVER, PortEnableInputBuffer=false
        NewPortContainer8: PortNumber=8, PortNumberOfPortPins=10
          10 x PortPin, all with PortPinDirectionChangeable=true, PortPinModeChangeable=true, PortDriveStrength=VERY_LOW_DRIVER, PortOpenDrainControl=PUSH_PULL, PortInputBufferType=INPUT_TYPE_SHMT1, PortEnableOutputvalueInversion=false, PortEnableBiDirectionMode=false, PortIsSetSafeStateConfig=true, PortSetSafeStateTrigger=DISABLE, PortEnableIPControl=false:
            NewPortPin0: PortPinId=0, PortIsSetPinConfig=false, PortPinDirection=PORT_PIN_OUT, PortPinInitialMode=GPIO, PortPinMode=GPIO, PortPinLevelValue=PORT_PIN_LEVEL_LOW, PortPullUpPullDown=NO_PULL, PortEnableInputBuffer=false
            NewPortPin1: PortPinId=1, PortIsSetPinConfig=true, PortPinDirection=PORT_PIN_IN, PortPinInitialMode=ALT3, PortPinMode=ALT3, PortPinLevelValue=PORT_PIN_LEVEL_LOW, PortPullUpPullDown=PULL_DOWN, PortEnableInputBuffer=false
            NewPortPin2: PortPinId=2, PortIsSetPinConfig=false, PortPinDirection=PORT_PIN_OUT, PortPinInitialMode=GPIO, PortPinMode=GPIO, PortPinLevelValue=PORT_PIN_LEVEL_LOW, PortPullUpPullDown=NO_PULL, PortEnableInputBuffer=false
            NewPortPin3: PortPinId=3, PortIsSetPinConfig=true, PortPinDirection=PORT_PIN_IN, PortPinInitialMode=GPIO, PortPinMode=GPIO, PortPinLevelValue=PORT_PIN_LEVEL_LOW, PortPullUpPullDown=NO_PULL, PortEnableInputBuffer=true
            NewPortPin4: PortPinId=4, PortIsSetPinConfig=true, PortPinDirection=PORT_PIN_IN, PortPinInitialMode=GPIO, PortPinMode=GPIO, PortPinLevelValue=PORT_PIN_LEVEL_LOW, PortPullUpPullDown=NO_PULL, PortEnableInputBuffer=true
            NewPortPin5: PortPinId=5, PortIsSetPinConfig=true, PortPinDirection=PORT_PIN_OUT, PortPinInitialMode=GPIO, PortPinMode=GPIO, PortPinLevelValue=PORT_PIN_LEVEL_HIGH, PortPullUpPullDown=NO_PULL, PortEnableInputBuffer=false
            NewPortPin6: PortPinId=6, PortIsSetPinConfig=true, PortPinDirection=PORT_PIN_IN, PortPinInitialMode=GPIO, PortPinMode=GPIO, PortPinLevelValue=PORT_PIN_LEVEL_LOW, PortPullUpPullDown=PULL_DOWN, PortEnableInputBuffer=true
            NewPortPin7: PortPinId=7, PortIsSetPinConfig=true, PortPinDirection=PORT_PIN_OUT, PortPinInitialMode=GPIO, PortPinMode=GPIO, PortPinLevelValue=PORT_PIN_LEVEL_HIGH, PortPullUpPullDown=NO_PULL, PortEnableInputBuffer=false
            NewPortPin8: PortPinId=8, PortIsSetPinConfig=true, PortPinDirection=PORT_PIN_IN, PortPinInitialMode=GPIO, PortPinMode=GPIO, PortPinLevelValue=PORT_PIN_LEVEL_LOW, PortPullUpPullDown=PULL_DOWN, PortEnableInputBuffer=true
            NewPortPin9: PortPinId=9, PortIsSetPinConfig=true, PortPinDirection=PORT_PIN_OUT, PortPinInitialMode=GPIO, PortPinMode=GPIO, PortPinLevelValue=PORT_PIN_LEVEL_LOW, PortPullUpPullDown=NO_PULL, PortEnableInputBuffer=false
        NewPortContainer10: PortNumber=10, PortNumberOfPortPins=15
          15 x PortPin, all with PortPinDirectionChangeable=true, PortPinModeChangeable=true, PortPinInitialMode=GPIO, PortPinMode=GPIO, PortInputBufferType=INPUT_TYPE_SHMT1, PortEnableOutputvalueInversion=false, PortEnableBiDirectionMode=false, PortIsSetSafeStateConfig=true, PortSetSafeStateTrigger=DISABLE, PortEnableIPControl=false:
            NewPortPin0: PortPinId=0, PortIsSetPinConfig=true, PortPinDirection=PORT_PIN_OUT, PortPinLevelValue=PORT_PIN_LEVEL_HIGH, PortPullUpPullDown=NO_PULL, PortDriveStrength=MEDIUM_DRIVER, PortOpenDrainControl=EMULATED_N_CHANNEL_OPEN_DRAIN, PortEnableInputBuffer=false
            NewPortPin1: PortPinId=1, PortIsSetPinConfig=true, PortPinDirection=PORT_PIN_OUT, PortPinLevelValue=PORT_PIN_LEVEL_HIGH, PortPullUpPullDown=NO_PULL, PortDriveStrength=MEDIUM_DRIVER, PortOpenDrainControl=EMULATED_N_CHANNEL_OPEN_DRAIN, PortEnableInputBuffer=false
            NewPortPin2: PortPinId=2, PortIsSetPinConfig=true, PortPinDirection=PORT_PIN_OUT, PortPinLevelValue=PORT_PIN_LEVEL_LOW, PortPullUpPullDown=NO_PULL, PortDriveStrength=VERY_LOW_DRIVER, PortOpenDrainControl=PUSH_PULL, PortEnableInputBuffer=false
            NewPortPin3: PortPinId=3, PortIsSetPinConfig=true, PortPinDirection=PORT_PIN_IN, PortPinLevelValue=PORT_PIN_LEVEL_LOW, PortPullUpPullDown=PULL_DOWN, PortDriveStrength=VERY_LOW_DRIVER, PortOpenDrainControl=PUSH_PULL, PortEnableInputBuffer=true
            NewPortPin4: PortPinId=4, PortIsSetPinConfig=true, PortPinDirection=PORT_PIN_OUT, PortPinLevelValue=PORT_PIN_LEVEL_LOW, PortPullUpPullDown=NO_PULL, PortDriveStrength=VERY_LOW_DRIVER, PortOpenDrainControl=PUSH_PULL, PortEnableInputBuffer=false
            NewPortPin5: PortPinId=5, PortIsSetPinConfig=false, PortPinDirection=PORT_PIN_OUT, PortPinLevelValue=PORT_PIN_LEVEL_LOW, PortPullUpPullDown=NO_PULL, PortDriveStrength=VERY_LOW_DRIVER, PortOpenDrainControl=PUSH_PULL, PortEnableInputBuffer=false
            NewPortPin6: PortPinId=6, PortIsSetPinConfig=true, PortPinDirection=PORT_PIN_OUT, PortPinLevelValue=PORT_PIN_LEVEL_LOW, PortPullUpPullDown=NO_PULL, PortDriveStrength=VERY_LOW_DRIVER, PortOpenDrainControl=PUSH_PULL, PortEnableInputBuffer=false
            NewPortPin7: PortPinId=7, PortIsSetPinConfig=true, PortPinDirection=PORT_PIN_IN, PortPinLevelValue=PORT_PIN_LEVEL_LOW, PortPullUpPullDown=PULL_DOWN, PortDriveStrength=VERY_LOW_DRIVER, PortOpenDrainControl=PUSH_PULL, PortEnableInputBuffer=true
            NewPortPin8: PortPinId=8, PortIsSetPinConfig=true, PortPinDirection=PORT_PIN_IN, PortPinLevelValue=PORT_PIN_LEVEL_LOW, PortPullUpPullDown=PULL_DOWN, PortDriveStrength=VERY_LOW_DRIVER, PortOpenDrainControl=PUSH_PULL, PortEnableInputBuffer=true
            NewPortPin9: PortPinId=9, PortIsSetPinConfig=true, PortPinDirection=PORT_PIN_IN, PortPinLevelValue=PORT_PIN_LEVEL_LOW, PortPullUpPullDown=NO_PULL, PortDriveStrength=VERY_LOW_DRIVER, PortOpenDrainControl=PUSH_PULL, PortEnableInputBuffer=true
            NewPortPin10: PortPinId=10, PortIsSetPinConfig=true, PortPinDirection=PORT_PIN_OUT, PortPinLevelValue=PORT_PIN_LEVEL_LOW, PortPullUpPullDown=NO_PULL, PortDriveStrength=VERY_LOW_DRIVER, PortOpenDrainControl=PUSH_PULL, PortEnableInputBuffer=false
            NewPortPin11: PortPinId=11, PortIsSetPinConfig=true, PortPinDirection=PORT_PIN_IN, PortPinLevelValue=PORT_PIN_LEVEL_LOW, PortPullUpPullDown=PULL_DOWN, PortDriveStrength=VERY_LOW_DRIVER, PortOpenDrainControl=PUSH_PULL, PortEnableInputBuffer=true
            NewPortPin12: PortPinId=12, PortIsSetPinConfig=true, PortPinDirection=PORT_PIN_OUT, PortPinLevelValue=PORT_PIN_LEVEL_LOW, PortPullUpPullDown=NO_PULL, PortDriveStrength=VERY_LOW_DRIVER, PortOpenDrainControl=PUSH_PULL, PortEnableInputBuffer=false
            NewPortPin13: PortPinId=13, PortIsSetPinConfig=true, PortPinDirection=PORT_PIN_OUT, PortPinLevelValue=PORT_PIN_LEVEL_LOW, PortPullUpPullDown=NO_PULL, PortDriveStrength=VERY_LOW_DRIVER, PortOpenDrainControl=PUSH_PULL, PortEnableInputBuffer=false
            NewPortPin14: PortPinId=14, PortIsSetPinConfig=true, PortPinDirection=PORT_PIN_IN, PortPinLevelValue=PORT_PIN_LEVEL_LOW, PortPullUpPullDown=NO_PULL, PortDriveStrength=VERY_LOW_DRIVER, PortOpenDrainControl=PUSH_PULL, PortEnableInputBuffer=true
        NewPortContainer11: PortNumber=11, PortNumberOfPortPins=16
          16 x PortPin, all with PortIsSetPinConfig=true, PortPinDirectionChangeable=true, PortPinModeChangeable=true, PortPinLevelValue=PORT_PIN_LEVEL_LOW, PortDriveStrength=VERY_LOW_DRIVER, PortOpenDrainControl=PUSH_PULL, PortInputBufferType=INPUT_TYPE_SHMT1, PortEnableOutputvalueInversion=false, PortEnableBiDirectionMode=false, PortIsSetSafeStateConfig=true, PortSetSafeStateTrigger=DISABLE:
            NewPortPin0: PortPinId=0, PortPinDirection=PORT_PIN_OUT, PortPinInitialMode=ALT1, PortPinMode=ALT1, PortPullUpPullDown=NO_PULL, PortEnableInputBuffer=false, PortEnableIPControl=false
            NewPortPin1: PortPinId=1, PortPinDirection=PORT_PIN_IN, PortPinInitialMode=ALT1, PortPinMode=ALT1, PortPullUpPullDown=PULL_DOWN, PortEnableInputBuffer=false, PortEnableIPControl=false
            NewPortPin2: PortPinId=2, PortPinDirection=PORT_PIN_OUT, PortPinInitialMode=ALT1, PortPinMode=ALT1, PortPullUpPullDown=NO_PULL, PortEnableInputBuffer=false, PortEnableIPControl=true
            NewPortPin3: PortPinId=3, PortPinDirection=PORT_PIN_OUT, PortPinInitialMode=ALT1, PortPinMode=ALT1, PortPullUpPullDown=NO_PULL, PortEnableInputBuffer=false, PortEnableIPControl=false
            NewPortPin{4..7}: PortPinId={4..7}, PortPinDirection=PORT_PIN_OUT, PortPinInitialMode=GPIO, PortPinMode=GPIO, PortPullUpPullDown=NO_PULL, PortEnableInputBuffer=false, PortEnableIPControl=false
            NewPortPin8: PortPinId=8, PortPinDirection=PORT_PIN_OUT, PortPinInitialMode=ALT1, PortPinMode=ALT1, PortPullUpPullDown=NO_PULL, PortEnableInputBuffer=false, PortEnableIPControl=false
            NewPortPin9: PortPinId=9, PortPinDirection=PORT_PIN_IN, PortPinInitialMode=ALT1, PortPinMode=ALT1, PortPullUpPullDown=PULL_DOWN, PortEnableInputBuffer=false, PortEnableIPControl=false
            NewPortPin10: PortPinId=10, PortPinDirection=PORT_PIN_OUT, PortPinInitialMode=ALT1, PortPinMode=ALT1, PortPullUpPullDown=NO_PULL, PortEnableInputBuffer=false, PortEnableIPControl=true
            NewPortPin11: PortPinId=11, PortPinDirection=PORT_PIN_OUT, PortPinInitialMode=ALT1, PortPinMode=ALT1, PortPullUpPullDown=NO_PULL, PortEnableInputBuffer=false, PortEnableIPControl=false
            NewPortPin12: PortPinId=12, PortPinDirection=PORT_PIN_IN, PortPinInitialMode=GPIO, PortPinMode=GPIO, PortPullUpPullDown=PULL_DOWN, PortEnableInputBuffer=true, PortEnableIPControl=false
            NewPortPin13: PortPinId=13, PortPinDirection=PORT_PIN_OUT, PortPinInitialMode=GPIO, PortPinMode=GPIO, PortPullUpPullDown=NO_PULL, PortEnableInputBuffer=false, PortEnableIPControl=false
            NewPortPin14: PortPinId=14, PortPinDirection=PORT_PIN_IN, PortPinInitialMode=GPIO, PortPinMode=GPIO, PortPullUpPullDown=PULL_DOWN, PortEnableInputBuffer=true, PortEnableIPControl=false
            NewPortPin15: PortPinId=15, PortPinDirection=PORT_PIN_IN, PortPinInitialMode=GPIO, PortPinMode=GPIO, PortPullUpPullDown=PULL_DOWN, PortEnableInputBuffer=true, PortEnableIPControl=false
        NewPortContainer17: PortNumber=17, PortNumberOfPortPins=7
          7 x PortPin, all with PortIsSetPinConfig=true, PortPinDirectionChangeable=true, PortPinModeChangeable=true, PortPinInitialMode=GPIO, PortPinMode=GPIO, PortPinLevelValue=PORT_PIN_LEVEL_LOW, PortDriveStrength=VERY_LOW_DRIVER, PortOpenDrainControl=PUSH_PULL, PortInputBufferType=INPUT_TYPE_SHMT1, PortEnableOutputvalueInversion=false, PortEnableBiDirectionMode=false, PortIsSetSafeStateConfig=true, PortSetSafeStateTrigger=DISABLE, PortEnableIPControl=false:
            NewPortPin0: PortPinId=0, PortPinDirection=PORT_PIN_IN, PortPullUpPullDown=PULL_DOWN, PortEnableInputBuffer=true
            NewPortPin{1..5}: PortPinId={1..5}, PortPinDirection=PORT_PIN_OUT, PortPullUpPullDown=NO_PULL, PortEnableInputBuffer=false
            NewPortPin6: PortPinId=6, PortPinDirection=PORT_PIN_IN, PortPullUpPullDown=PULL_DOWN, PortEnableInputBuffer=true
        NewPortContainer20: PortNumber=20, PortNumberOfPortPins=14
          14 x PortPin, all with PortIsSetPinConfig=true, PortPinDirectionChangeable=true, PortPinModeChangeable=true, PortPinInitialMode=GPIO, PortPinMode=GPIO, PortPinLevelValue=PORT_PIN_LEVEL_LOW, PortDriveStrength=VERY_LOW_DRIVER, PortOpenDrainControl=PUSH_PULL, PortInputBufferType=INPUT_TYPE_SHMT1, PortEnableOutputvalueInversion=false, PortEnableBiDirectionMode=false, PortIsSetSafeStateConfig=true, PortSetSafeStateTrigger=DISABLE, PortEnableIPControl=false:
            NewPortPin0: PortPinId=0, PortPinDirection=PORT_PIN_IN, PortPullUpPullDown=PULL_DOWN, PortEnableInputBuffer=true
            NewPortPin1: PortPinId=1, PortPinDirection=PORT_PIN_OUT, PortPullUpPullDown=NO_PULL, PortEnableInputBuffer=false
            NewPortPin2: PortPinId=2, PortPinDirection=PORT_PIN_OUT, PortPullUpPullDown=NO_PULL, PortEnableInputBuffer=false
            NewPortPin3: PortPinId=3, PortPinDirection=PORT_PIN_IN, PortPullUpPullDown=PULL_DOWN, PortEnableInputBuffer=true
            NewPortPin4: PortPinId=4, PortPinDirection=PORT_PIN_OUT, PortPullUpPullDown=NO_PULL, PortEnableInputBuffer=false
            NewPortPin5: PortPinId=5, PortPinDirection=PORT_PIN_IN, PortPullUpPullDown=PULL_DOWN, PortEnableInputBuffer=true
            NewPortPin6: PortPinId=6, PortPinDirection=PORT_PIN_OUT, PortPullUpPullDown=NO_PULL, PortEnableInputBuffer=false
            NewPortPin7: PortPinId=7, PortPinDirection=PORT_PIN_IN, PortPullUpPullDown=PULL_UP, PortEnableInputBuffer=true
            NewPortPin8: PortPinId=8, PortPinDirection=PORT_PIN_OUT, PortPullUpPullDown=NO_PULL, PortEnableInputBuffer=false
            NewPortPin9: PortPinId=9, PortPinDirection=PORT_PIN_OUT, PortPullUpPullDown=NO_PULL, PortEnableInputBuffer=false
            NewPortPin10: PortPinId=10, PortPinDirection=PORT_PIN_IN, PortPullUpPullDown=NO_PULL, PortEnableInputBuffer=true
            NewPortPin{12..14}: PortPinId={12..14}, PortPinDirection=PORT_PIN_OUT, PortPullUpPullDown=NO_PULL, PortEnableInputBuffer=false
        NewPortContainer21: PortNumber=21, PortNumberOfPortPins=8
          8 x PortPin, all with PortIsSetPinConfig=true, PortPinDirectionChangeable=true, PortPinModeChangeable=true, PortPinLevelValue=PORT_PIN_LEVEL_LOW, PortDriveStrength=VERY_LOW_DRIVER, PortOpenDrainControl=PUSH_PULL, PortInputBufferType=INPUT_TYPE_SHMT1, PortEnableOutputvalueInversion=false, PortEnableBiDirectionMode=false, PortIsSetSafeStateConfig=true, PortSetSafeStateTrigger=DISABLE:
            NewPortPin0: PortPinId=0, PortPinDirection=PORT_PIN_IN, PortPinInitialMode=GPIO, PortPinMode=GPIO, PortPullUpPullDown=PULL_DOWN, PortEnableInputBuffer=true, PortEnableIPControl=false
            NewPortPin1: PortPinId=1, PortPinDirection=PORT_PIN_IN, PortPinInitialMode=GPIO, PortPinMode=GPIO, PortPullUpPullDown=PULL_DOWN, PortEnableInputBuffer=true, PortEnableIPControl=false
            NewPortPin2: PortPinId=2, PortPinDirection=PORT_PIN_OUT, PortPinInitialMode=GPIO, PortPinMode=GPIO, PortPullUpPullDown=NO_PULL, PortEnableInputBuffer=false, PortEnableIPControl=false
            NewPortPin3: PortPinId=3, PortPinDirection=PORT_PIN_OUT, PortPinInitialMode=ALT6, PortPinMode=ALT6, PortPullUpPullDown=NO_PULL, PortEnableInputBuffer=false, PortEnableIPControl=true
            NewPortPin4: PortPinId=4, PortPinDirection=PORT_PIN_OUT, PortPinInitialMode=GPIO, PortPinMode=GPIO, PortPullUpPullDown=NO_PULL, PortEnableInputBuffer=false, PortEnableIPControl=false
            NewPortPin5: PortPinId=5, PortPinDirection=PORT_PIN_IN, PortPinInitialMode=GPIO, PortPinMode=GPIO, PortPullUpPullDown=NO_PULL, PortEnableInputBuffer=true, PortEnableIPControl=false
            NewPortPin6: PortPinId=6, PortPinDirection=PORT_PIN_IN, PortPinInitialMode=GPIO, PortPinMode=GPIO, PortPullUpPullDown=PULL_DOWN, PortEnableInputBuffer=true, PortEnableIPControl=false
            NewPortPin7: PortPinId=7, PortPinDirection=PORT_PIN_IN, PortPinInitialMode=GPIO, PortPinMode=GPIO, PortPullUpPullDown=PULL_DOWN, PortEnableInputBuffer=true, PortEnableIPControl=false
        NewPortContainer22: PortNumber=22, PortNumberOfPortPins=5
          5 x PortPin, all with PortIsSetPinConfig=true, PortPinDirectionChangeable=true, PortPinModeChangeable=true, PortPinDirection=PORT_PIN_OUT, PortPinInitialMode=GPIO, PortPinMode=GPIO, PortPullUpPullDown=NO_PULL, PortInputBufferType=INPUT_TYPE_SHMT1, PortEnableInputBuffer=false, PortEnableOutputvalueInversion=false, PortEnableBiDirectionMode=false, PortIsSetSafeStateConfig=true, PortSetSafeStateTrigger=DISABLE, PortEnableIPControl=false:
            NewPortPin{0..2}: PortPinId={0..2}, PortPinLevelValue=PORT_PIN_LEVEL_LOW, PortDriveStrength=VERY_LOW_DRIVER, PortOpenDrainControl=PUSH_PULL
            NewPortPin3: PortPinId=3, PortPinLevelValue=PORT_PIN_LEVEL_HIGH, PortDriveStrength=MEDIUM_DRIVER, PortOpenDrainControl=EMULATED_N_CHANNEL_OPEN_DRAIN
            NewPortPin4: PortPinId=4, PortPinLevelValue=PORT_PIN_LEVEL_HIGH, PortDriveStrength=MEDIUM_DRIVER, PortOpenDrainControl=EMULATED_N_CHANNEL_OPEN_DRAIN
        NewPortContainer24: PortNumber=24, PortNumberOfPortPins=10
          10 x PortPin, all with PortIsSetPinConfig=true, PortPinDirectionChangeable=true, PortPinModeChangeable=true, PortPinInitialMode=GPIO, PortPinMode=GPIO, PortPinLevelValue=PORT_PIN_LEVEL_LOW, PortDriveStrength=VERY_LOW_DRIVER, PortOpenDrainControl=PUSH_PULL, PortInputBufferType=INPUT_TYPE_SHMT1, PortEnableOutputvalueInversion=false, PortEnableBiDirectionMode=false, PortIsSetSafeStateConfig=true, PortSetSafeStateTrigger=DISABLE, PortEnableIPControl=false:
            NewPortPin4: PortPinId=4, PortPinDirection=PORT_PIN_OUT, PortPullUpPullDown=NO_PULL, PortEnableInputBuffer=false
            NewPortPin5: PortPinId=5, PortPinDirection=PORT_PIN_IN, PortPullUpPullDown=PULL_UP, PortEnableInputBuffer=true
            NewPortPin{6..9}: PortPinId={6..9}, PortPinDirection=PORT_PIN_OUT, PortPullUpPullDown=NO_PULL, PortEnableInputBuffer=false
            NewPortPin10: PortPinId=10, PortPinDirection=PORT_PIN_IN, PortPullUpPullDown=PULL_DOWN, PortEnableInputBuffer=true
            NewPortPin11: PortPinId=11, PortPinDirection=PORT_PIN_OUT, PortPullUpPullDown=NO_PULL, PortEnableInputBuffer=false
            NewPortPin12: PortPinId=12, PortPinDirection=PORT_PIN_IN, PortPullUpPullDown=PULL_DOWN, PortEnableInputBuffer=true
            NewPortPin13: PortPinId=13, PortPinDirection=PORT_PIN_OUT, PortPullUpPullDown=NO_PULL, PortEnableInputBuffer=false
        NewPortContainer25: PortNumber=25, PortNumberOfPortPins=5
          5 x PortPin, all with PortIsSetPinConfig=false, PortPinDirectionChangeable=true, PortPinModeChangeable=true, PortPinDirection=PORT_PIN_IN, PortPinInitialMode=GPIO, PortPinMode=GPIO, PortPinLevelValue=PORT_PIN_LEVEL_LOW, PortDriveStrength=VERY_LOW_DRIVER, PortOpenDrainControl=PUSH_PULL, PortInputBufferType=INPUT_TYPE_SHMT1, PortEnableOutputvalueInversion=false, PortEnableBiDirectionMode=false, PortIsSetSafeStateConfig=true, PortSetSafeStateTrigger=DISABLE, PortEnableIPControl=false:
            NewPortPin0: PortPinId=0, PortPullUpPullDown=PULL_UP, PortEnableInputBuffer=true
            NewPortPin1: PortPinId=1, PortPullUpPullDown=NO_PULL, PortEnableInputBuffer=false
            NewPortPin2: PortPinId=2, PortPullUpPullDown=PULL_UP, PortEnableInputBuffer=true
            NewPortPin3: PortPinId=3, PortPullUpPullDown=NO_PULL, PortEnableInputBuffer=false
            NewPortPin5: PortPinId=5, PortPullUpPullDown=NO_PULL, PortEnableInputBuffer=false
        NewPortContainer26: PortNumber=26, PortNumberOfPortPins=16
          16 x PortPin, all with PortIsSetPinConfig=true, PortPinDirectionChangeable=true, PortPinModeChangeable=true, PortPinInitialMode=GPIO, PortPinMode=GPIO, PortPinLevelValue=PORT_PIN_LEVEL_LOW, PortPullUpPullDown=NO_PULL, PortDriveStrength=VERY_LOW_DRIVER, PortOpenDrainControl=PUSH_PULL, PortInputBufferType=INPUT_TYPE_SHMT1, PortEnableInputBuffer=false, PortEnableOutputvalueInversion=false, PortEnableBiDirectionMode=false, PortIsSetSafeStateConfig=true, PortSetSafeStateTrigger=DISABLE, PortEnableIPControl=false:
            NewPortPin{0..3}: PortPinId={0..3}, PortPinDirection=PORT_PIN_IN
            NewPortPin4: PortPinId=4, PortPinDirection=PORT_PIN_OUT
            NewPortPin5: PortPinId=5, PortPinDirection=PORT_PIN_OUT
            NewPortPin{6..8}: PortPinId={6..8}, PortPinDirection=PORT_PIN_IN
            NewPortPin{9..15}: PortPinId={9..15}, PortPinDirection=PORT_PIN_OUT
        NewPortContainer27: PortNumber=27, PortNumberOfPortPins=4
          4 x PortPin, all with PortIsSetPinConfig=true, PortPinDirectionChangeable=true, PortPinModeChangeable=true, PortPinInitialMode=GPIO, PortPinMode=GPIO, PortPinLevelValue=PORT_PIN_LEVEL_LOW, PortPullUpPullDown=NO_PULL, PortDriveStrength=VERY_LOW_DRIVER, PortOpenDrainControl=PUSH_PULL, PortInputBufferType=INPUT_TYPE_SHMT1, PortEnableInputBuffer=false, PortEnableOutputvalueInversion=false, PortEnableBiDirectionMode=false, PortIsSetSafeStateConfig=true, PortSetSafeStateTrigger=DISABLE, PortEnableIPControl=false:
            NewPortPin0: PortPinId=0, PortPinDirection=PORT_PIN_OUT
            NewPortPin{1..3}: PortPinId={1..3}, PortPinDirection=PORT_PIN_IN
        NewPortContainer28: PortNumber=28, PortNumberOfPortPins=16
          16 x PortPin, all with PortIsSetPinConfig=true, PortPinDirectionChangeable=true, PortPinModeChangeable=true, PortPinInitialMode=GPIO, PortPinMode=GPIO, PortPinLevelValue=PORT_PIN_LEVEL_LOW, PortPullUpPullDown=NO_PULL, PortDriveStrength=VERY_LOW_DRIVER, PortOpenDrainControl=PUSH_PULL, PortInputBufferType=INPUT_TYPE_SHMT1, PortEnableInputBuffer=false, PortEnableOutputvalueInversion=false, PortEnableBiDirectionMode=false, PortIsSetSafeStateConfig=true, PortSetSafeStateTrigger=DISABLE, PortEnableIPControl=false:
            NewPortPin{0..7}: PortPinId={0..7}, PortPinDirection=PORT_PIN_IN
            NewPortPin8: PortPinId=8, PortPinDirection=PORT_PIN_OUT
            NewPortPin{9..15}: PortPinId={9..15}, PortPinDirection=PORT_PIN_IN
        NewPortContainer29: PortNumber=29, PortNumberOfPortPins=4
          4 x PortPin, all with PortIsSetPinConfig=true, PortPinDirectionChangeable=true, PortPinModeChangeable=true, PortPinInitialMode=GPIO, PortPinMode=GPIO, PortPinLevelValue=PORT_PIN_LEVEL_LOW, PortPullUpPullDown=NO_PULL, PortDriveStrength=VERY_LOW_DRIVER, PortOpenDrainControl=PUSH_PULL, PortInputBufferType=INPUT_TYPE_SHMT1, PortEnableOutputvalueInversion=false, PortEnableBiDirectionMode=false, PortIsSetSafeStateConfig=true, PortSetSafeStateTrigger=DISABLE, PortEnableIPControl=false:
            NewPortPin0: PortPinId=0, PortPinDirection=PORT_PIN_OUT, PortEnableInputBuffer=false
            NewPortPin1: PortPinId=1, PortPinDirection=PORT_PIN_IN, PortEnableInputBuffer=false
            NewPortPin2: PortPinId=2, PortPinDirection=PORT_PIN_IN, PortEnableInputBuffer=true
            NewPortPin3: PortPinId=3, PortPinDirection=PORT_PIN_IN, PortEnableInputBuffer=true
        NewPortContainer30: PortNumber=30, PortNumberOfPortPins=16
          16 x PortPin, all with PortIsSetPinConfig=true, PortPinDirectionChangeable=true, PortPinModeChangeable=true, PortPinInitialMode=GPIO, PortPinMode=GPIO, PortPullUpPullDown=NO_PULL, PortDriveStrength=VERY_LOW_DRIVER, PortOpenDrainControl=PUSH_PULL, PortInputBufferType=INPUT_TYPE_SHMT1, PortEnableOutputvalueInversion=false, PortEnableBiDirectionMode=false, PortIsSetSafeStateConfig=true, PortSetSafeStateTrigger=DISABLE, PortEnableIPControl=false:
            NewPortPin0: PortPinId=0, PortPinDirection=PORT_PIN_IN, PortPinLevelValue=PORT_PIN_LEVEL_LOW, PortEnableInputBuffer=true
            NewPortPin1: PortPinId=1, PortPinDirection=PORT_PIN_OUT, PortPinLevelValue=PORT_PIN_LEVEL_LOW, PortEnableInputBuffer=false
            NewPortPin2: PortPinId=2, PortPinDirection=PORT_PIN_OUT, PortPinLevelValue=PORT_PIN_LEVEL_LOW, PortEnableInputBuffer=false
            NewPortPin3: PortPinId=3, PortPinDirection=PORT_PIN_IN, PortPinLevelValue=PORT_PIN_LEVEL_LOW, PortEnableInputBuffer=false
            NewPortPin4: PortPinId=4, PortPinDirection=PORT_PIN_IN, PortPinLevelValue=PORT_PIN_LEVEL_LOW, PortEnableInputBuffer=false
            NewPortPin{5..7}: PortPinId={5..7}, PortPinDirection=PORT_PIN_OUT, PortPinLevelValue=PORT_PIN_LEVEL_LOW, PortEnableInputBuffer=false
            NewPortPin8: PortPinId=8, PortPinDirection=PORT_PIN_OUT, PortPinLevelValue=PORT_PIN_LEVEL_HIGH, PortEnableInputBuffer=false
            NewPortPin{9..11}: PortPinId={9..11}, PortPinDirection=PORT_PIN_OUT, PortPinLevelValue=PORT_PIN_LEVEL_LOW, PortEnableInputBuffer=false
            NewPortPin12: PortPinId=12, PortPinDirection=PORT_PIN_IN, PortPinLevelValue=PORT_PIN_LEVEL_LOW, PortEnableInputBuffer=true
            NewPortPin{13..15}: PortPinId={13..15}, PortPinDirection=PORT_PIN_OUT, PortPinLevelValue=PORT_PIN_LEVEL_LOW, PortEnableInputBuffer=false
        NewPortContainer31: PortNumber=31, PortNumberOfPortPins=4
          4 x PortPin, all with PortPinDirectionChangeable=true, PortPinModeChangeable=true, PortPinDirection=PORT_PIN_OUT, PortPinInitialMode=GPIO, PortPinMode=GPIO, PortPullUpPullDown=NO_PULL, PortDriveStrength=VERY_LOW_DRIVER, PortOpenDrainControl=PUSH_PULL, PortInputBufferType=INPUT_TYPE_SHMT1, PortEnableInputBuffer=false, PortEnableOutputvalueInversion=false, PortEnableBiDirectionMode=false, PortIsSetSafeStateConfig=true, PortSetSafeStateTrigger=DISABLE, PortEnableIPControl=false:
            NewPortPin0: PortPinId=0, PortIsSetPinConfig=true, PortPinLevelValue=PORT_PIN_LEVEL_LOW
            NewPortPin1: PortPinId=1, PortIsSetPinConfig=false, PortPinLevelValue=PORT_PIN_LEVEL_LOW
            NewPortPin2: PortPinId=2, PortIsSetPinConfig=true, PortPinLevelValue=PORT_PIN_LEVEL_LOW
            NewPortPin3: PortPinId=3, PortIsSetPinConfig=true, PortPinLevelValue=PORT_PIN_LEVEL_HIGH
      NewPortLVDS0 (PortLVDS):
        PortIsSetLVDSConfig = true
        PortLVDSGroup = LVDSGROUP_A
        PortLVDSCTRL0 = DISABLE
        PortLVDSCTRL1 = DISABLE
        PortLVDSCTRL{3..5} = DISABLE
        PortLVDSOutputType = ANSI_TIA_EIA_644_STANDARD
        PortLVDSVoltage = VOLTAGE_5V
      NewPortLVDS1 (PortLVDS):
        PortIsSetLVDSConfig = true
        PortLVDSGroup = LVDSGROUP_B
        PortLVDSCTRL0 = DISABLE
        PortLVDSCTRL1 = DISABLE
        PortLVDSCTRL{3..5} = DISABLE
        PortLVDSOutputType = ANSI_TIA_EIA_644_STANDARD
        PortLVDSVoltage = VOLTAGE_5V
      156 x PortNoiseFilter, all with PortNoiseFilterBypassMode=NOISE_FILTER_SIGNAL, PortDetectionMode=DISABLE_EDGE_DETECTION:
        NewPortNoiseFilter0: PortIsSetNoiseFilterConfig=true, PortNoiseFilterFunctionName=RLIN30RX, PortEnableDigitalNoiseFilter=false, PortNumberOfSamples=2, PortSamplingClockFrequency=SUPPLY_DEVIDED_BY_1
        NewPortNoiseFilter1: PortIsSetNoiseFilterConfig=true, PortNoiseFilterFunctionName=RLIN31RX, PortEnableDigitalNoiseFilter=false, PortNumberOfSamples=2, PortSamplingClockFrequency=SUPPLY_DEVIDED_BY_1
        NewPortNoiseFilter2: PortIsSetNoiseFilterConfig=true, PortNoiseFilterFunctionName=CAN0RX, PortEnableDigitalNoiseFilter=false, PortNumberOfSamples=2, PortSamplingClockFrequency=SUPPLY_DEVIDED_BY_1
        NewPortNoiseFilter3: PortIsSetNoiseFilterConfig=true, PortNoiseFilterFunctionName=CAN1RX, PortEnableDigitalNoiseFilter=false, PortNumberOfSamples=2, PortSamplingClockFrequency=SUPPLY_DEVIDED_BY_1
        NewPortNoiseFilter4: PortIsSetNoiseFilterConfig=true, PortNoiseFilterFunctionName=FLX0RXDA, PortEnableDigitalNoiseFilter=false, PortNumberOfSamples=2, PortSamplingClockFrequency=SUPPLY_DEVIDED_BY_1
        NewPortNoiseFilter5: PortIsSetNoiseFilterConfig=true, PortNoiseFilterFunctionName=FLX1RXDA, PortEnableDigitalNoiseFilter=false, PortNumberOfSamples=2, PortSamplingClockFrequency=SUPPLY_DEVIDED_BY_1
        NewPortNoiseFilter6: PortIsSetNoiseFilterConfig=true, PortNoiseFilterFunctionName=SENT0RX, PortEnableDigitalNoiseFilter=false, PortNumberOfSamples=2, PortSamplingClockFrequency=SUPPLY_DEVIDED_BY_1
        NewPortNoiseFilter7: PortIsSetNoiseFilterConfig=true, PortNoiseFilterFunctionName=SENT1RX, PortEnableDigitalNoiseFilter=false, PortNumberOfSamples=2, PortSamplingClockFrequency=SUPPLY_DEVIDED_BY_1
        NewPortNoiseFilter8: PortIsSetNoiseFilterConfig=true, PortNoiseFilterFunctionName=SENT2RX, PortEnableDigitalNoiseFilter=false, PortNumberOfSamples=2, PortSamplingClockFrequency=SUPPLY_DEVIDED_BY_1
        NewPortNoiseFilter9: PortIsSetNoiseFilterConfig=true, PortNoiseFilterFunctionName=SENT3RX, PortEnableDigitalNoiseFilter=false, PortNumberOfSamples=2, PortSamplingClockFrequency=SUPPLY_DEVIDED_BY_1
        NewPortNoiseFilter10: PortIsSetNoiseFilterConfig=true, PortNoiseFilterFunctionName=SENT4RX, PortEnableDigitalNoiseFilter=false, PortNumberOfSamples=2, PortSamplingClockFrequency=SUPPLY_DEVIDED_BY_1
        NewPortNoiseFilter11: PortIsSetNoiseFilterConfig=true, PortNoiseFilterFunctionName=SENT5RX, PortEnableDigitalNoiseFilter=false, PortNumberOfSamples=2, PortSamplingClockFrequency=SUPPLY_DEVIDED_BY_1
        NewPortNoiseFilter12: PortIsSetNoiseFilterConfig=true, PortNoiseFilterFunctionName=SENT6RX, PortEnableDigitalNoiseFilter=false, PortNumberOfSamples=2, PortSamplingClockFrequency=SUPPLY_DEVIDED_BY_1
        NewPortNoiseFilter13: PortIsSetNoiseFilterConfig=true, PortNoiseFilterFunctionName=SENT7RX, PortEnableDigitalNoiseFilter=false, PortNumberOfSamples=2, PortSamplingClockFrequency=SUPPLY_DEVIDED_BY_1
        NewPortNoiseFilter14: PortIsSetNoiseFilterConfig=true, PortNoiseFilterFunctionName=PSI50RX, PortEnableDigitalNoiseFilter=false, PortNumberOfSamples=2, PortSamplingClockFrequency=SUPPLY_DEVIDED_BY_1
        NewPortNoiseFilter15: PortIsSetNoiseFilterConfig=true, PortNoiseFilterFunctionName=PSI51RX, PortEnableDigitalNoiseFilter=false, PortNumberOfSamples=2, PortSamplingClockFrequency=SUPPLY_DEVIDED_BY_1
        NewPortNoiseFilter16: PortIsSetNoiseFilterConfig=true, PortNoiseFilterFunctionName=PSI52RX, PortEnableDigitalNoiseFilter=false, PortNumberOfSamples=2, PortSamplingClockFrequency=SUPPLY_DEVIDED_BY_1
        NewPortNoiseFilter17: PortIsSetNoiseFilterConfig=true, PortNoiseFilterFunctionName=PSI53RX, PortEnableDigitalNoiseFilter=false, PortNumberOfSamples=2, PortSamplingClockFrequency=SUPPLY_DEVIDED_BY_1
        NewPortNoiseFilter18: PortIsSetNoiseFilterConfig=true, PortNoiseFilterFunctionName=INTTAPA0ESO_TAPA0ESO, PortEnableDigitalNoiseFilter=true, PortNumberOfSamples=5, PortSamplingClockFrequency=SUPPLY_DEVIDED_BY_128
        NewPortNoiseFilter19: PortIsSetNoiseFilterConfig=true, PortNoiseFilterFunctionName=INTTAPA1ESO_TAPA1ESO, PortEnableDigitalNoiseFilter=true, PortNumberOfSamples=5, PortSamplingClockFrequency=SUPPLY_DEVIDED_BY_128
        NewPortNoiseFilter20: PortIsSetNoiseFilterConfig=true, PortNoiseFilterFunctionName=ADCJ0TRG0, PortEnableDigitalNoiseFilter=false, PortNumberOfSamples=2, PortSamplingClockFrequency=SUPPLY_DEVIDED_BY_1
        NewPortNoiseFilter21: PortIsSetNoiseFilterConfig=true, PortNoiseFilterFunctionName=ADCJ0TRG1, PortEnableDigitalNoiseFilter=false, PortNumberOfSamples=2, PortSamplingClockFrequency=SUPPLY_DEVIDED_BY_1
        NewPortNoiseFilter22: PortIsSetNoiseFilterConfig=true, PortNoiseFilterFunctionName=ADCJ0TRG2, PortEnableDigitalNoiseFilter=false, PortNumberOfSamples=2, PortSamplingClockFrequency=SUPPLY_DEVIDED_BY_1
        NewPortNoiseFilter23: PortIsSetNoiseFilterConfig=true, PortNoiseFilterFunctionName=ADCJ0TRG3, PortEnableDigitalNoiseFilter=false, PortNumberOfSamples=2, PortSamplingClockFrequency=SUPPLY_DEVIDED_BY_1
        NewPortNoiseFilter24: PortIsSetNoiseFilterConfig=true, PortNoiseFilterFunctionName=ADCJ0TRG4, PortEnableDigitalNoiseFilter=false, PortNumberOfSamples=2, PortSamplingClockFrequency=SUPPLY_DEVIDED_BY_1
        NewPortNoiseFilter25: PortIsSetNoiseFilterConfig=true, PortNoiseFilterFunctionName=ADCJ1TRG0, PortEnableDigitalNoiseFilter=false, PortNumberOfSamples=2, PortSamplingClockFrequency=SUPPLY_DEVIDED_BY_1
        NewPortNoiseFilter26: PortIsSetNoiseFilterConfig=true, PortNoiseFilterFunctionName=ADCJ1TRG1, PortEnableDigitalNoiseFilter=false, PortNumberOfSamples=2, PortSamplingClockFrequency=SUPPLY_DEVIDED_BY_1
        NewPortNoiseFilter27: PortIsSetNoiseFilterConfig=true, PortNoiseFilterFunctionName=ADCJ1TRG2, PortEnableDigitalNoiseFilter=false, PortNumberOfSamples=2, PortSamplingClockFrequency=SUPPLY_DEVIDED_BY_1
        NewPortNoiseFilter28: PortIsSetNoiseFilterConfig=true, PortNoiseFilterFunctionName=ADCJ1TRG3, PortEnableDigitalNoiseFilter=false, PortNumberOfSamples=2, PortSamplingClockFrequency=SUPPLY_DEVIDED_BY_1
        NewPortNoiseFilter29: PortIsSetNoiseFilterConfig=true, PortNoiseFilterFunctionName=ADCJ1TRG4, PortEnableDigitalNoiseFilter=false, PortNumberOfSamples=2, PortSamplingClockFrequency=SUPPLY_DEVIDED_BY_1
        NewPortNoiseFilter30: PortIsSetNoiseFilterConfig=true, PortNoiseFilterFunctionName=ADCJ2TRG0, PortEnableDigitalNoiseFilter=false, PortNumberOfSamples=2, PortSamplingClockFrequency=SUPPLY_DEVIDED_BY_1
        NewPortNoiseFilter31: PortIsSetNoiseFilterConfig=true, PortNoiseFilterFunctionName=ADCJ2TRG1, PortEnableDigitalNoiseFilter=false, PortNumberOfSamples=2, PortSamplingClockFrequency=SUPPLY_DEVIDED_BY_1
        NewPortNoiseFilter32: PortIsSetNoiseFilterConfig=true, PortNoiseFilterFunctionName=ADCJ2TRG2, PortEnableDigitalNoiseFilter=false, PortNumberOfSamples=2, PortSamplingClockFrequency=SUPPLY_DEVIDED_BY_1
        NewPortNoiseFilter33: PortIsSetNoiseFilterConfig=true, PortNoiseFilterFunctionName=ADCJ2TRG3, PortEnableDigitalNoiseFilter=false, PortNumberOfSamples=2, PortSamplingClockFrequency=SUPPLY_DEVIDED_BY_1
        NewPortNoiseFilter34: PortIsSetNoiseFilterConfig=true, PortNoiseFilterFunctionName=ADCJ2TRG4, PortEnableDigitalNoiseFilter=false, PortNumberOfSamples=2, PortSamplingClockFrequency=SUPPLY_DEVIDED_BY_1
        NewPortNoiseFilter35: PortIsSetNoiseFilterConfig=true, PortNoiseFilterFunctionName=ENCA0TIN0, PortEnableDigitalNoiseFilter=false, PortNumberOfSamples=2, PortSamplingClockFrequency=SUPPLY_DEVIDED_BY_1
        NewPortNoiseFilter36: PortIsSetNoiseFilterConfig=true, PortNoiseFilterFunctionName=ENCA0TIN1, PortEnableDigitalNoiseFilter=false, PortNumberOfSamples=2, PortSamplingClockFrequency=SUPPLY_DEVIDED_BY_1
        NewPortNoiseFilter37: PortIsSetNoiseFilterConfig=true, PortNoiseFilterFunctionName=ENCA1TIN0, PortEnableDigitalNoiseFilter=false, PortNumberOfSamples=2, PortSamplingClockFrequency=SUPPLY_DEVIDED_BY_1
        NewPortNoiseFilter38: PortIsSetNoiseFilterConfig=true, PortNoiseFilterFunctionName=ENCA1TIN1, PortEnableDigitalNoiseFilter=false, PortNumberOfSamples=2, PortSamplingClockFrequency=SUPPLY_DEVIDED_BY_1
        NewPortNoiseFilter39: PortIsSetNoiseFilterConfig=true, PortNoiseFilterFunctionName=TAUD0I0, PortEnableDigitalNoiseFilter=false, PortNumberOfSamples=5, PortSamplingClockFrequency=SUPPLY_DEVIDED_BY_128
        NewPortNoiseFilter40: PortIsSetNoiseFilterConfig=true, PortNoiseFilterFunctionName=TAUD0I1, PortEnableDigitalNoiseFilter=false, PortNumberOfSamples=5, PortSamplingClockFrequency=SUPPLY_DEVIDED_BY_128
        NewPortNoiseFilter41: PortIsSetNoiseFilterConfig=true, PortNoiseFilterFunctionName=TAUD0I2, PortEnableDigitalNoiseFilter=false, PortNumberOfSamples=5, PortSamplingClockFrequency=SUPPLY_DEVIDED_BY_128
        NewPortNoiseFilter42: PortIsSetNoiseFilterConfig=true, PortNoiseFilterFunctionName=TAUD0I3, PortEnableDigitalNoiseFilter=false, PortNumberOfSamples=5, PortSamplingClockFrequency=SUPPLY_DEVIDED_BY_128
        NewPortNoiseFilter43: PortIsSetNoiseFilterConfig=true, PortNoiseFilterFunctionName=TAUD0I4, PortEnableDigitalNoiseFilter=false, PortNumberOfSamples=5, PortSamplingClockFrequency=SUPPLY_DEVIDED_BY_128
        NewPortNoiseFilter44: PortIsSetNoiseFilterConfig=true, PortNoiseFilterFunctionName=TAUD0I5, PortEnableDigitalNoiseFilter=false, PortNumberOfSamples=5, PortSamplingClockFrequency=SUPPLY_DEVIDED_BY_128
        NewPortNoiseFilter45: PortIsSetNoiseFilterConfig=true, PortNoiseFilterFunctionName=TAUD0I6, PortEnableDigitalNoiseFilter=false, PortNumberOfSamples=5, PortSamplingClockFrequency=SUPPLY_DEVIDED_BY_128
        NewPortNoiseFilter46: PortIsSetNoiseFilterConfig=true, PortNoiseFilterFunctionName=TAUD0I7, PortEnableDigitalNoiseFilter=false, PortNumberOfSamples=5, PortSamplingClockFrequency=SUPPLY_DEVIDED_BY_128
        NewPortNoiseFilter47: PortIsSetNoiseFilterConfig=true, PortNoiseFilterFunctionName=TAUD0I8, PortEnableDigitalNoiseFilter=false, PortNumberOfSamples=5, PortSamplingClockFrequency=SUPPLY_DEVIDED_BY_128
        NewPortNoiseFilter48: PortIsSetNoiseFilterConfig=true, PortNoiseFilterFunctionName=TAUD0I9, PortEnableDigitalNoiseFilter=false, PortNumberOfSamples=5, PortSamplingClockFrequency=SUPPLY_DEVIDED_BY_128
        NewPortNoiseFilter49: PortIsSetNoiseFilterConfig=true, PortNoiseFilterFunctionName=TAUD0I10, PortEnableDigitalNoiseFilter=false, PortNumberOfSamples=5, PortSamplingClockFrequency=SUPPLY_DEVIDED_BY_128
        NewPortNoiseFilter50: PortIsSetNoiseFilterConfig=true, PortNoiseFilterFunctionName=TAUD0I11, PortEnableDigitalNoiseFilter=false, PortNumberOfSamples=5, PortSamplingClockFrequency=SUPPLY_DEVIDED_BY_128
        NewPortNoiseFilter51: PortIsSetNoiseFilterConfig=true, PortNoiseFilterFunctionName=TAUD0I12, PortEnableDigitalNoiseFilter=false, PortNumberOfSamples=5, PortSamplingClockFrequency=SUPPLY_DEVIDED_BY_128
        NewPortNoiseFilter52: PortIsSetNoiseFilterConfig=true, PortNoiseFilterFunctionName=TAUD0I13, PortEnableDigitalNoiseFilter=false, PortNumberOfSamples=5, PortSamplingClockFrequency=SUPPLY_DEVIDED_BY_128
        NewPortNoiseFilter53: PortIsSetNoiseFilterConfig=true, PortNoiseFilterFunctionName=TAUD0I14, PortEnableDigitalNoiseFilter=true, PortNumberOfSamples=5, PortSamplingClockFrequency=SUPPLY_DEVIDED_BY_128
        NewPortNoiseFilter54: PortIsSetNoiseFilterConfig=true, PortNoiseFilterFunctionName=TAUD0I15, PortEnableDigitalNoiseFilter=false, PortNumberOfSamples=5, PortSamplingClockFrequency=SUPPLY_DEVIDED_BY_128
        NewPortNoiseFilter55: PortIsSetNoiseFilterConfig=true, PortNoiseFilterFunctionName=TAUD1I0, PortEnableDigitalNoiseFilter=false, PortNumberOfSamples=2, PortSamplingClockFrequency=SUPPLY_DEVIDED_BY_1
        NewPortNoiseFilter56: PortIsSetNoiseFilterConfig=true, PortNoiseFilterFunctionName=TAUD1I1, PortEnableDigitalNoiseFilter=false, PortNumberOfSamples=2, PortSamplingClockFrequency=SUPPLY_DEVIDED_BY_1
        NewPortNoiseFilter57: PortIsSetNoiseFilterConfig=true, PortNoiseFilterFunctionName=TAUD1I2, PortEnableDigitalNoiseFilter=false, PortNumberOfSamples=2, PortSamplingClockFrequency=SUPPLY_DEVIDED_BY_1
        NewPortNoiseFilter58: PortIsSetNoiseFilterConfig=true, PortNoiseFilterFunctionName=TAUD1I3, PortEnableDigitalNoiseFilter=false, PortNumberOfSamples=2, PortSamplingClockFrequency=SUPPLY_DEVIDED_BY_1
        NewPortNoiseFilter59: PortIsSetNoiseFilterConfig=true, PortNoiseFilterFunctionName=TAUD1I4, PortEnableDigitalNoiseFilter=false, PortNumberOfSamples=2, PortSamplingClockFrequency=SUPPLY_DEVIDED_BY_1
        NewPortNoiseFilter60: PortIsSetNoiseFilterConfig=true, PortNoiseFilterFunctionName=TAUD1I5, PortEnableDigitalNoiseFilter=false, PortNumberOfSamples=2, PortSamplingClockFrequency=SUPPLY_DEVIDED_BY_1
        NewPortNoiseFilter61: PortIsSetNoiseFilterConfig=true, PortNoiseFilterFunctionName=TAUD1I6, PortEnableDigitalNoiseFilter=false, PortNumberOfSamples=2, PortSamplingClockFrequency=SUPPLY_DEVIDED_BY_1
        NewPortNoiseFilter62: PortIsSetNoiseFilterConfig=true, PortNoiseFilterFunctionName=TAUD1I7, PortEnableDigitalNoiseFilter=false, PortNumberOfSamples=2, PortSamplingClockFrequency=SUPPLY_DEVIDED_BY_1
        NewPortNoiseFilter63: PortIsSetNoiseFilterConfig=true, PortNoiseFilterFunctionName=TAUD1I8, PortEnableDigitalNoiseFilter=false, PortNumberOfSamples=2, PortSamplingClockFrequency=SUPPLY_DEVIDED_BY_1
        NewPortNoiseFilter64: PortIsSetNoiseFilterConfig=true, PortNoiseFilterFunctionName=TAUD1I9, PortEnableDigitalNoiseFilter=false, PortNumberOfSamples=2, PortSamplingClockFrequency=SUPPLY_DEVIDED_BY_1
        NewPortNoiseFilter65: PortIsSetNoiseFilterConfig=true, PortNoiseFilterFunctionName=TAUD1I10, PortEnableDigitalNoiseFilter=false, PortNumberOfSamples=2, PortSamplingClockFrequency=SUPPLY_DEVIDED_BY_1
        NewPortNoiseFilter66: PortIsSetNoiseFilterConfig=true, PortNoiseFilterFunctionName=TAUD1I11, PortEnableDigitalNoiseFilter=false, PortNumberOfSamples=2, PortSamplingClockFrequency=SUPPLY_DEVIDED_BY_1
        NewPortNoiseFilter67: PortIsSetNoiseFilterConfig=true, PortNoiseFilterFunctionName=TAUD1I12, PortEnableDigitalNoiseFilter=false, PortNumberOfSamples=2, PortSamplingClockFrequency=SUPPLY_DEVIDED_BY_1
        NewPortNoiseFilter68: PortIsSetNoiseFilterConfig=true, PortNoiseFilterFunctionName=TAUD1I13, PortEnableDigitalNoiseFilter=false, PortNumberOfSamples=2, PortSamplingClockFrequency=SUPPLY_DEVIDED_BY_1
        NewPortNoiseFilter69: PortIsSetNoiseFilterConfig=true, PortNoiseFilterFunctionName=TAUD1I14, PortEnableDigitalNoiseFilter=false, PortNumberOfSamples=2, PortSamplingClockFrequency=SUPPLY_DEVIDED_BY_1
        NewPortNoiseFilter70: PortIsSetNoiseFilterConfig=true, PortNoiseFilterFunctionName=TAUD1I15, PortEnableDigitalNoiseFilter=false, PortNumberOfSamples=2, PortSamplingClockFrequency=SUPPLY_DEVIDED_BY_1
        NewPortNoiseFilter71: PortIsSetNoiseFilterConfig=true, PortNoiseFilterFunctionName=TAUD2I0, PortEnableDigitalNoiseFilter=false, PortNumberOfSamples=2, PortSamplingClockFrequency=SUPPLY_DEVIDED_BY_1
        NewPortNoiseFilter72: PortIsSetNoiseFilterConfig=true, PortNoiseFilterFunctionName=TAUD2I1, PortEnableDigitalNoiseFilter=false, PortNumberOfSamples=2, PortSamplingClockFrequency=SUPPLY_DEVIDED_BY_1
        NewPortNoiseFilter73: PortIsSetNoiseFilterConfig=true, PortNoiseFilterFunctionName=TAUD2I2, PortEnableDigitalNoiseFilter=false, PortNumberOfSamples=2, PortSamplingClockFrequency=SUPPLY_DEVIDED_BY_1
        NewPortNoiseFilter74: PortIsSetNoiseFilterConfig=true, PortNoiseFilterFunctionName=TAUD2I3, PortEnableDigitalNoiseFilter=false, PortNumberOfSamples=2, PortSamplingClockFrequency=SUPPLY_DEVIDED_BY_1
        NewPortNoiseFilter75: PortIsSetNoiseFilterConfig=true, PortNoiseFilterFunctionName=TAUD2I4, PortEnableDigitalNoiseFilter=false, PortNumberOfSamples=2, PortSamplingClockFrequency=SUPPLY_DEVIDED_BY_1
        NewPortNoiseFilter76: PortIsSetNoiseFilterConfig=true, PortNoiseFilterFunctionName=TAUD2I5, PortEnableDigitalNoiseFilter=false, PortNumberOfSamples=2, PortSamplingClockFrequency=SUPPLY_DEVIDED_BY_1
        NewPortNoiseFilter77: PortIsSetNoiseFilterConfig=true, PortNoiseFilterFunctionName=TAUD2I6, PortEnableDigitalNoiseFilter=false, PortNumberOfSamples=2, PortSamplingClockFrequency=SUPPLY_DEVIDED_BY_1
        NewPortNoiseFilter78: PortIsSetNoiseFilterConfig=true, PortNoiseFilterFunctionName=TAUD2I7, PortEnableDigitalNoiseFilter=false, PortNumberOfSamples=2, PortSamplingClockFrequency=SUPPLY_DEVIDED_BY_1
        NewPortNoiseFilter79: PortIsSetNoiseFilterConfig=true, PortNoiseFilterFunctionName=TAUD2I8, PortEnableDigitalNoiseFilter=false, PortNumberOfSamples=2, PortSamplingClockFrequency=SUPPLY_DEVIDED_BY_1
        NewPortNoiseFilter80: PortIsSetNoiseFilterConfig=true, PortNoiseFilterFunctionName=TAUD2I9, PortEnableDigitalNoiseFilter=false, PortNumberOfSamples=2, PortSamplingClockFrequency=SUPPLY_DEVIDED_BY_1
        NewPortNoiseFilter81: PortIsSetNoiseFilterConfig=true, PortNoiseFilterFunctionName=TAUD2I10, PortEnableDigitalNoiseFilter=false, PortNumberOfSamples=2, PortSamplingClockFrequency=SUPPLY_DEVIDED_BY_1
        NewPortNoiseFilter82: PortIsSetNoiseFilterConfig=true, PortNoiseFilterFunctionName=TAUD2I11, PortEnableDigitalNoiseFilter=false, PortNumberOfSamples=2, PortSamplingClockFrequency=SUPPLY_DEVIDED_BY_1
        NewPortNoiseFilter83: PortIsSetNoiseFilterConfig=true, PortNoiseFilterFunctionName=TAUD2I12, PortEnableDigitalNoiseFilter=false, PortNumberOfSamples=2, PortSamplingClockFrequency=SUPPLY_DEVIDED_BY_1
        NewPortNoiseFilter84: PortIsSetNoiseFilterConfig=true, PortNoiseFilterFunctionName=TAUD2I13, PortEnableDigitalNoiseFilter=false, PortNumberOfSamples=2, PortSamplingClockFrequency=SUPPLY_DEVIDED_BY_1
        NewPortNoiseFilter85: PortIsSetNoiseFilterConfig=true, PortNoiseFilterFunctionName=TAUD2I14, PortEnableDigitalNoiseFilter=false, PortNumberOfSamples=2, PortSamplingClockFrequency=SUPPLY_DEVIDED_BY_1
        NewPortNoiseFilter86: PortIsSetNoiseFilterConfig=true, PortNoiseFilterFunctionName=TAUD2I15, PortEnableDigitalNoiseFilter=false, PortNumberOfSamples=2, PortSamplingClockFrequency=SUPPLY_DEVIDED_BY_1
        NewPortNoiseFilter87: PortIsSetNoiseFilterConfig=true, PortNoiseFilterFunctionName=TSG30PTSI0_ENCA0E0, PortEnableDigitalNoiseFilter=false, PortNumberOfSamples=2, PortSamplingClockFrequency=SUPPLY_DEVIDED_BY_1
        NewPortNoiseFilter88: PortIsSetNoiseFilterConfig=true, PortNoiseFilterFunctionName=TSG30PTSI1_ENCA0E1, PortEnableDigitalNoiseFilter=false, PortNumberOfSamples=2, PortSamplingClockFrequency=SUPPLY_DEVIDED_BY_1
        NewPortNoiseFilter89: PortIsSetNoiseFilterConfig=true, PortNoiseFilterFunctionName=TSG30PTSI2_ENCA0EC, PortEnableDigitalNoiseFilter=false, PortNumberOfSamples=2, PortSamplingClockFrequency=SUPPLY_DEVIDED_BY_1
        NewPortNoiseFilter90: PortIsSetNoiseFilterConfig=true, PortNoiseFilterFunctionName=TSG30CLKI, PortEnableDigitalNoiseFilter=false, PortNumberOfSamples=2, PortSamplingClockFrequency=SUPPLY_DEVIDED_BY_1
        NewPortNoiseFilter91: PortIsSetNoiseFilterConfig=true, PortNoiseFilterFunctionName=TSG31PTSI0_ENCA1E0, PortEnableDigitalNoiseFilter=false, PortNumberOfSamples=2, PortSamplingClockFrequency=SUPPLY_DEVIDED_BY_1
        NewPortNoiseFilter92: PortIsSetNoiseFilterConfig=true, PortNoiseFilterFunctionName=TSG31PTSI1_ENCA1E1, PortEnableDigitalNoiseFilter=false, PortNumberOfSamples=2, PortSamplingClockFrequency=SUPPLY_DEVIDED_BY_1
        NewPortNoiseFilter93: PortIsSetNoiseFilterConfig=true, PortNoiseFilterFunctionName=TSG31PTSI2_ENCA1EC, PortEnableDigitalNoiseFilter=false, PortNumberOfSamples=2, PortSamplingClockFrequency=SUPPLY_DEVIDED_BY_1
        NewPortNoiseFilter94: PortIsSetNoiseFilterConfig=true, PortNoiseFilterFunctionName=TSG31CLKI, PortEnableDigitalNoiseFilter=false, PortNumberOfSamples=2, PortSamplingClockFrequency=SUPPLY_DEVIDED_BY_1
        NewPortNoiseFilter95: PortIsSetNoiseFilterConfig=false, PortNoiseFilterFunctionName=NMI, PortEnableDigitalNoiseFilter=false, PortNumberOfSamples=2, PortSamplingClockFrequency=SUPPLY_DEVIDED_BY_1
        NewPortNoiseFilter96: PortIsSetNoiseFilterConfig=false, PortNoiseFilterFunctionName=INTP0, PortEnableDigitalNoiseFilter=false, PortNumberOfSamples=2, PortSamplingClockFrequency=SUPPLY_DEVIDED_BY_1
        NewPortNoiseFilter97: PortIsSetNoiseFilterConfig=false, PortNoiseFilterFunctionName=INTP1, PortEnableDigitalNoiseFilter=false, PortNumberOfSamples=2, PortSamplingClockFrequency=SUPPLY_DEVIDED_BY_1
        NewPortNoiseFilter98: PortIsSetNoiseFilterConfig=false, PortNoiseFilterFunctionName=INTP2, PortEnableDigitalNoiseFilter=false, PortNumberOfSamples=2, PortSamplingClockFrequency=SUPPLY_DEVIDED_BY_1
        NewPortNoiseFilter99: PortIsSetNoiseFilterConfig=false, PortNoiseFilterFunctionName=INTP3, PortEnableDigitalNoiseFilter=false, PortNumberOfSamples=2, PortSamplingClockFrequency=SUPPLY_DEVIDED_BY_1
        NewPortNoiseFilter100: PortIsSetNoiseFilterConfig=false, PortNoiseFilterFunctionName=INTP4, PortEnableDigitalNoiseFilter=false, PortNumberOfSamples=2, PortSamplingClockFrequency=SUPPLY_DEVIDED_BY_1
        NewPortNoiseFilter101: PortIsSetNoiseFilterConfig=false, PortNoiseFilterFunctionName=INTP5, PortEnableDigitalNoiseFilter=false, PortNumberOfSamples=2, PortSamplingClockFrequency=SUPPLY_DEVIDED_BY_1
        NewPortNoiseFilter102: PortIsSetNoiseFilterConfig=false, PortNoiseFilterFunctionName=INTP6, PortEnableDigitalNoiseFilter=false, PortNumberOfSamples=2, PortSamplingClockFrequency=SUPPLY_DEVIDED_BY_1
        NewPortNoiseFilter103: PortIsSetNoiseFilterConfig=false, PortNoiseFilterFunctionName=INTP7, PortEnableDigitalNoiseFilter=false, PortNumberOfSamples=2, PortSamplingClockFrequency=SUPPLY_DEVIDED_BY_1
        NewPortNoiseFilter104: PortIsSetNoiseFilterConfig=false, PortNoiseFilterFunctionName=INTP8, PortEnableDigitalNoiseFilter=false, PortNumberOfSamples=2, PortSamplingClockFrequency=SUPPLY_DEVIDED_BY_1
        NewPortNoiseFilter105: PortIsSetNoiseFilterConfig=false, PortNoiseFilterFunctionName=INTP9, PortEnableDigitalNoiseFilter=false, PortNumberOfSamples=2, PortSamplingClockFrequency=SUPPLY_DEVIDED_BY_1
        NewPortNoiseFilter106: PortIsSetNoiseFilterConfig=false, PortNoiseFilterFunctionName=INTP10, PortEnableDigitalNoiseFilter=false, PortNumberOfSamples=2, PortSamplingClockFrequency=SUPPLY_DEVIDED_BY_1
        NewPortNoiseFilter107: PortIsSetNoiseFilterConfig=false, PortNoiseFilterFunctionName=INTP11, PortEnableDigitalNoiseFilter=false, PortNumberOfSamples=2, PortSamplingClockFrequency=SUPPLY_DEVIDED_BY_1
        NewPortNoiseFilter108: PortIsSetNoiseFilterConfig=false, PortNoiseFilterFunctionName=INTP12, PortEnableDigitalNoiseFilter=false, PortNumberOfSamples=2, PortSamplingClockFrequency=SUPPLY_DEVIDED_BY_1
        NewPortNoiseFilter109: PortIsSetNoiseFilterConfig=false, PortNoiseFilterFunctionName=INTP13, PortEnableDigitalNoiseFilter=false, PortNumberOfSamples=2, PortSamplingClockFrequency=SUPPLY_DEVIDED_BY_1
        NewPortNoiseFilter110: PortIsSetNoiseFilterConfig=false, PortNoiseFilterFunctionName=INTP14, PortEnableDigitalNoiseFilter=false, PortNumberOfSamples=2, PortSamplingClockFrequency=SUPPLY_DEVIDED_BY_1
        NewPortNoiseFilter111: PortIsSetNoiseFilterConfig=false, PortNoiseFilterFunctionName=INTP15, PortEnableDigitalNoiseFilter=false, PortNumberOfSamples=2, PortSamplingClockFrequency=SUPPLY_DEVIDED_BY_1
        NewPortNoiseFilter112: PortIsSetNoiseFilterConfig=false, PortNoiseFilterFunctionName=INTP16, PortEnableDigitalNoiseFilter=false, PortNumberOfSamples=2, PortSamplingClockFrequency=SUPPLY_DEVIDED_BY_1
        NewPortNoiseFilter113: PortIsSetNoiseFilterConfig=false, PortNoiseFilterFunctionName=INTP17, PortEnableDigitalNoiseFilter=false, PortNumberOfSamples=2, PortSamplingClockFrequency=SUPPLY_DEVIDED_BY_1
        NewPortNoiseFilter114: PortIsSetNoiseFilterConfig=false, PortNoiseFilterFunctionName=INTP18, PortEnableDigitalNoiseFilter=false, PortNumberOfSamples=2, PortSamplingClockFrequency=SUPPLY_DEVIDED_BY_1
        NewPortNoiseFilter115: PortIsSetNoiseFilterConfig=false, PortNoiseFilterFunctionName=INTP19, PortEnableDigitalNoiseFilter=false, PortNumberOfSamples=2, PortSamplingClockFrequency=SUPPLY_DEVIDED_BY_1
        NewPortNoiseFilter116: PortIsSetNoiseFilterConfig=false, PortNoiseFilterFunctionName=INTP20, PortEnableDigitalNoiseFilter=false, PortNumberOfSamples=2, PortSamplingClockFrequency=SUPPLY_DEVIDED_BY_1
        NewPortNoiseFilter117: PortIsSetNoiseFilterConfig=false, PortNoiseFilterFunctionName=INTP21, PortEnableDigitalNoiseFilter=false, PortNumberOfSamples=2, PortSamplingClockFrequency=SUPPLY_DEVIDED_BY_1
        NewPortNoiseFilter118: PortIsSetNoiseFilterConfig=false, PortNoiseFilterFunctionName=INTP22, PortEnableDigitalNoiseFilter=false, PortNumberOfSamples=2, PortSamplingClockFrequency=SUPPLY_DEVIDED_BY_1
        NewPortNoiseFilter119: PortIsSetNoiseFilterConfig=false, PortNoiseFilterFunctionName=INTP23, PortEnableDigitalNoiseFilter=false, PortNumberOfSamples=2, PortSamplingClockFrequency=SUPPLY_DEVIDED_BY_1
        NewPortNoiseFilter120: PortIsSetNoiseFilterConfig=false, PortNoiseFilterFunctionName=INTP24, PortEnableDigitalNoiseFilter=false, PortNumberOfSamples=2, PortSamplingClockFrequency=SUPPLY_DEVIDED_BY_1
        NewPortNoiseFilter121: PortIsSetNoiseFilterConfig=false, PortNoiseFilterFunctionName=INTP25, PortEnableDigitalNoiseFilter=false, PortNumberOfSamples=2, PortSamplingClockFrequency=SUPPLY_DEVIDED_BY_1
        NewPortNoiseFilter122: PortIsSetNoiseFilterConfig=false, PortNoiseFilterFunctionName=INTP26, PortEnableDigitalNoiseFilter=false, PortNumberOfSamples=2, PortSamplingClockFrequency=SUPPLY_DEVIDED_BY_1
        NewPortNoiseFilter123: PortIsSetNoiseFilterConfig=false, PortNoiseFilterFunctionName=INTP27, PortEnableDigitalNoiseFilter=false, PortNumberOfSamples=2, PortSamplingClockFrequency=SUPPLY_DEVIDED_BY_1
        NewPortNoiseFilter124: PortIsSetNoiseFilterConfig=false, PortNoiseFilterFunctionName=INTP28, PortEnableDigitalNoiseFilter=false, PortNumberOfSamples=2, PortSamplingClockFrequency=SUPPLY_DEVIDED_BY_1
        NewPortNoiseFilter125: PortIsSetNoiseFilterConfig=false, PortNoiseFilterFunctionName=INTP29, PortEnableDigitalNoiseFilter=false, PortNumberOfSamples=2, PortSamplingClockFrequency=SUPPLY_DEVIDED_BY_1
        NewPortNoiseFilter126: PortIsSetNoiseFilterConfig=false, PortNoiseFilterFunctionName=INTP30, PortEnableDigitalNoiseFilter=false, PortNumberOfSamples=2, PortSamplingClockFrequency=SUPPLY_DEVIDED_BY_1
        NewPortNoiseFilter127: PortIsSetNoiseFilterConfig=false, PortNoiseFilterFunctionName=INTP31, PortEnableDigitalNoiseFilter=false, PortNumberOfSamples=2, PortSamplingClockFrequency=SUPPLY_DEVIDED_BY_1
        NewPortNoiseFilter128: PortIsSetNoiseFilterConfig=false, PortNoiseFilterFunctionName=INTP32, PortEnableDigitalNoiseFilter=false, PortNumberOfSamples=2, PortSamplingClockFrequency=SUPPLY_DEVIDED_BY_1
        NewPortNoiseFilter129: PortIsSetNoiseFilterConfig=false, PortNoiseFilterFunctionName=INTP33, PortEnableDigitalNoiseFilter=false, PortNumberOfSamples=2, PortSamplingClockFrequency=SUPPLY_DEVIDED_BY_1
        NewPortNoiseFilter130: PortIsSetNoiseFilterConfig=false, PortNoiseFilterFunctionName=INTP34, PortEnableDigitalNoiseFilter=false, PortNumberOfSamples=2, PortSamplingClockFrequency=SUPPLY_DEVIDED_BY_1
        NewPortNoiseFilter131: PortIsSetNoiseFilterConfig=false, PortNoiseFilterFunctionName=INTP35, PortEnableDigitalNoiseFilter=false, PortNumberOfSamples=2, PortSamplingClockFrequency=SUPPLY_DEVIDED_BY_1
        NewPortNoiseFilter132: PortIsSetNoiseFilterConfig=false, PortNoiseFilterFunctionName=INTP36, PortEnableDigitalNoiseFilter=false, PortNumberOfSamples=2, PortSamplingClockFrequency=SUPPLY_DEVIDED_BY_1
        NewPortNoiseFilter133: PortIsSetNoiseFilterConfig=false, PortNoiseFilterFunctionName=INTP37, PortEnableDigitalNoiseFilter=false, PortNumberOfSamples=2, PortSamplingClockFrequency=SUPPLY_DEVIDED_BY_1
        NewPortNoiseFilter134: PortIsSetNoiseFilterConfig=false, PortNoiseFilterFunctionName=INTP38, PortEnableDigitalNoiseFilter=false, PortNumberOfSamples=2, PortSamplingClockFrequency=SUPPLY_DEVIDED_BY_1
        NewPortNoiseFilter135: PortIsSetNoiseFilterConfig=false, PortNoiseFilterFunctionName=INTP39, PortEnableDigitalNoiseFilter=false, PortNumberOfSamples=2, PortSamplingClockFrequency=SUPPLY_DEVIDED_BY_1
        NewPortNoiseFilter136: PortIsSetNoiseFilterConfig=true, PortNoiseFilterFunctionName=TAUJ0I0, PortEnableDigitalNoiseFilter=false, PortNumberOfSamples=2, PortSamplingClockFrequency=SUPPLY_DEVIDED_BY_1
        NewPortNoiseFilter137: PortIsSetNoiseFilterConfig=true, PortNoiseFilterFunctionName=TAUJ0I1, PortEnableDigitalNoiseFilter=false, PortNumberOfSamples=2, PortSamplingClockFrequency=SUPPLY_DEVIDED_BY_1
        NewPortNoiseFilter138: PortIsSetNoiseFilterConfig=true, PortNoiseFilterFunctionName=TAUJ0I2, PortEnableDigitalNoiseFilter=false, PortNumberOfSamples=2, PortSamplingClockFrequency=SUPPLY_DEVIDED_BY_1
        NewPortNoiseFilter139: PortIsSetNoiseFilterConfig=true, PortNoiseFilterFunctionName=TAUJ0I3, PortEnableDigitalNoiseFilter=false, PortNumberOfSamples=2, PortSamplingClockFrequency=SUPPLY_DEVIDED_BY_1
        NewPortNoiseFilter140: PortIsSetNoiseFilterConfig=true, PortNoiseFilterFunctionName=TAUJ1I0, PortEnableDigitalNoiseFilter=false, PortNumberOfSamples=2, PortSamplingClockFrequency=SUPPLY_DEVIDED_BY_1
        NewPortNoiseFilter141: PortIsSetNoiseFilterConfig=true, PortNoiseFilterFunctionName=TAUJ1I1, PortEnableDigitalNoiseFilter=false, PortNumberOfSamples=2, PortSamplingClockFrequency=SUPPLY_DEVIDED_BY_1
        NewPortNoiseFilter142: PortIsSetNoiseFilterConfig=true, PortNoiseFilterFunctionName=TAUJ1I2, PortEnableDigitalNoiseFilter=false, PortNumberOfSamples=2, PortSamplingClockFrequency=SUPPLY_DEVIDED_BY_1
        NewPortNoiseFilter143: PortIsSetNoiseFilterConfig=true, PortNoiseFilterFunctionName=TAUJ1I3, PortEnableDigitalNoiseFilter=false, PortNumberOfSamples=2, PortSamplingClockFrequency=SUPPLY_DEVIDED_BY_1
        NewPortNoiseFilter144: PortIsSetNoiseFilterConfig=true, PortNoiseFilterFunctionName=TAUJ2I0, PortEnableDigitalNoiseFilter=false, PortNumberOfSamples=2, PortSamplingClockFrequency=SUPPLY_DEVIDED_BY_1
        NewPortNoiseFilter145: PortIsSetNoiseFilterConfig=true, PortNoiseFilterFunctionName=TAUJ2I1, PortEnableDigitalNoiseFilter=false, PortNumberOfSamples=2, PortSamplingClockFrequency=SUPPLY_DEVIDED_BY_1
        NewPortNoiseFilter146: PortIsSetNoiseFilterConfig=true, PortNoiseFilterFunctionName=TAUJ2I2, PortEnableDigitalNoiseFilter=false, PortNumberOfSamples=2, PortSamplingClockFrequency=SUPPLY_DEVIDED_BY_1
        NewPortNoiseFilter147: PortIsSetNoiseFilterConfig=true, PortNoiseFilterFunctionName=TAUJ2I3, PortEnableDigitalNoiseFilter=false, PortNumberOfSamples=2, PortSamplingClockFrequency=SUPPLY_DEVIDED_BY_1
        NewPortNoiseFilter148: PortIsSetNoiseFilterConfig=true, PortNoiseFilterFunctionName=TAUJ3I0, PortEnableDigitalNoiseFilter=false, PortNumberOfSamples=2, PortSamplingClockFrequency=SUPPLY_DEVIDED_BY_1
        NewPortNoiseFilter149: PortIsSetNoiseFilterConfig=true, PortNoiseFilterFunctionName=TAUJ3I1, PortEnableDigitalNoiseFilter=false, PortNumberOfSamples=2, PortSamplingClockFrequency=SUPPLY_DEVIDED_BY_1
        NewPortNoiseFilter150: PortIsSetNoiseFilterConfig=true, PortNoiseFilterFunctionName=TAUJ3I2, PortEnableDigitalNoiseFilter=false, PortNumberOfSamples=2, PortSamplingClockFrequency=SUPPLY_DEVIDED_BY_1
        NewPortNoiseFilter151: PortIsSetNoiseFilterConfig=true, PortNoiseFilterFunctionName=TAUJ3I3, PortEnableDigitalNoiseFilter=false, PortNumberOfSamples=2, PortSamplingClockFrequency=SUPPLY_DEVIDED_BY_1
        NewPortNoiseFilter152: PortIsSetNoiseFilterConfig=true, PortNoiseFilterFunctionName=ERRORIN0, PortEnableDigitalNoiseFilter=false, PortNumberOfSamples=2, PortSamplingClockFrequency=SUPPLY_DEVIDED_BY_1
        NewPortNoiseFilter153: PortIsSetNoiseFilterConfig=true, PortNoiseFilterFunctionName=ERRORIN1, PortEnableDigitalNoiseFilter=false, PortNumberOfSamples=2, PortSamplingClockFrequency=SUPPLY_DEVIDED_BY_1
        NewPortNoiseFilter154: PortIsSetNoiseFilterConfig=true, PortNoiseFilterFunctionName=ERRORIN2, PortEnableDigitalNoiseFilter=false, PortNumberOfSamples=2, PortSamplingClockFrequency=SUPPLY_DEVIDED_BY_1
        NewPortNoiseFilter155: PortIsSetNoiseFilterConfig=true, PortNoiseFilterFunctionName=ERRORIN3, PortEnableDigitalNoiseFilter=false, PortNumberOfSamples=2, PortSamplingClockFrequency=SUPPLY_DEVIDED_BY_1
    48 x PortSetPinConfigSet:
      NewPortSetPinConfigSet0: PortSetPinConfigId=0, PortSetPinConfigLabel=MSPI0SI
        NewPortSetPin0 (PortSetPin):
          PortSetPinIsSetPinConfig = true
          PortSetPinSymbolicName = P2_11
          PortSetPinDirection = PORT_PIN_IN
          PortSetPinEnableIPControl = false
          PortSetPinMode = ALT3
          PortSetPinPullUpPullDown = PULL_DOWN
          PortSetPinEnableInputBuffer = false
          PortSetPinInputBufferType = INPUT_TYPE_SHMT1
          PortSetPinOpenDrain = PUSH_PULL
          PortSetPinDriveStrength = VERY_LOW_DRIVER
          PortSetPinEnableOutputValueInversion = false
          PortSetPinEnableBiDirection = false
          PortSetPinLevelValue = PORT_PIN_LEVEL_LOW
          PortSetPinIsSetSafeStateConfig = false
          PortSetPinSafeStateTrigger = DISABLE
          PortSetPinEnableLVDS = false
          PortSetPinLVDSVoltage = VOLTAGE_5V
          PortSetPinLVDSOutPutType = ANSI_TIA_EIA_644_STANDARD
        NewPortSetPinNoiseFilter0 (PortSetPinNoiseFilter):
          PortSetPinIsSetNoiseFilterConfig = false
          PortSetPinNoiseFilterFunctionName = RLIN30RX
          PortSetPinEnableDigitalNoiseFilter = false
          PortSetPinNoiseFilterBypassMode = NOISE_FILTER_SIGNAL
          PortSetPinDetectionMode = DISABLE_EDGE_DETECTION
          PortSetPinNumberOfSamples = 2
          PortSetPinSamplingClockFrequency = SUPPLY_DEVIDED_BY_1
      NewPortSetPinConfigSet1: PortSetPinConfigId=1, PortSetPinConfigLabel=MSPI0SC
        NewPortSetPin0 (PortSetPin):
          PortSetPinIsSetPinConfig = true
          PortSetPinSymbolicName = P2_12
          PortSetPinDirection = PORT_PIN_OUT
          PortSetPinEnableIPControl = false
          PortSetPinMode = ALT3
          PortSetPinPullUpPullDown = NO_PULL
          PortSetPinEnableInputBuffer = false
          PortSetPinInputBufferType = INPUT_TYPE_SHMT1
          PortSetPinOpenDrain = PUSH_PULL
          PortSetPinDriveStrength = MEDIUM_DRIVER
          PortSetPinEnableOutputValueInversion = false
          PortSetPinEnableBiDirection = false
          PortSetPinLevelValue = PORT_PIN_LEVEL_LOW
          PortSetPinIsSetSafeStateConfig = false
          PortSetPinSafeStateTrigger = DISABLE
          PortSetPinEnableLVDS = false
          PortSetPinLVDSVoltage = VOLTAGE_5V
          PortSetPinLVDSOutPutType = ANSI_TIA_EIA_644_STANDARD
        NewPortSetPinNoiseFilter0 (PortSetPinNoiseFilter):
          PortSetPinIsSetNoiseFilterConfig = false
          PortSetPinNoiseFilterFunctionName = RLIN30RX
          PortSetPinEnableDigitalNoiseFilter = false
          PortSetPinNoiseFilterBypassMode = NOISE_FILTER_SIGNAL
          PortSetPinDetectionMode = DISABLE_EDGE_DETECTION
          PortSetPinNumberOfSamples = 2
          PortSetPinSamplingClockFrequency = SUPPLY_DEVIDED_BY_1
      NewPortSetPinConfigSet2: PortSetPinConfigId=2, PortSetPinConfigLabel=MSPI0SO
        NewPortSetPin0 (PortSetPin):
          PortSetPinIsSetPinConfig = true
          PortSetPinSymbolicName = P2_13
          PortSetPinDirection = PORT_PIN_OUT
          PortSetPinEnableIPControl = true
          PortSetPinMode = ALT3
          PortSetPinPullUpPullDown = NO_PULL
          PortSetPinEnableInputBuffer = false
          PortSetPinInputBufferType = INPUT_TYPE_SHMT1
          PortSetPinOpenDrain = PUSH_PULL
          PortSetPinDriveStrength = MEDIUM_DRIVER
          PortSetPinEnableOutputValueInversion = false
          PortSetPinEnableBiDirection = false
          PortSetPinLevelValue = PORT_PIN_LEVEL_LOW
          PortSetPinIsSetSafeStateConfig = false
          PortSetPinSafeStateTrigger = DISABLE
          PortSetPinEnableLVDS = false
          PortSetPinLVDSVoltage = VOLTAGE_5V
          PortSetPinLVDSOutPutType = ANSI_TIA_EIA_644_STANDARD
        NewPortSetPinNoiseFilter0 (PortSetPinNoiseFilter):
          PortSetPinIsSetNoiseFilterConfig = false
          PortSetPinNoiseFilterFunctionName = RLIN30RX
          PortSetPinEnableDigitalNoiseFilter = false
          PortSetPinNoiseFilterBypassMode = NOISE_FILTER_SIGNAL
          PortSetPinDetectionMode = DISABLE_EDGE_DETECTION
          PortSetPinNumberOfSamples = 2
          PortSetPinSamplingClockFrequency = SUPPLY_DEVIDED_BY_1
      NewPortSetPinConfigSet3: PortSetPinConfigId=3, PortSetPinConfigLabel=MSPI0CSS0
        NewPortSetPin0 (PortSetPin):
          PortSetPinIsSetPinConfig = true
          PortSetPinSymbolicName = P2_14
          PortSetPinDirection = PORT_PIN_OUT
          PortSetPinEnableIPControl = false
          PortSetPinMode = ALT3
          PortSetPinPullUpPullDown = NO_PULL
          PortSetPinEnableInputBuffer = false
          PortSetPinInputBufferType = INPUT_TYPE_SHMT1
          PortSetPinOpenDrain = PUSH_PULL
          PortSetPinDriveStrength = MEDIUM_DRIVER
          PortSetPinEnableOutputValueInversion = false
          PortSetPinEnableBiDirection = false
          PortSetPinLevelValue = PORT_PIN_LEVEL_LOW
          PortSetPinIsSetSafeStateConfig = false
          PortSetPinSafeStateTrigger = DISABLE
          PortSetPinEnableLVDS = false
          PortSetPinLVDSVoltage = VOLTAGE_5V
          PortSetPinLVDSOutPutType = ANSI_TIA_EIA_644_STANDARD
        NewPortSetPinNoiseFilter0 (PortSetPinNoiseFilter):
          PortSetPinIsSetNoiseFilterConfig = false
          PortSetPinNoiseFilterFunctionName = RLIN30RX
          PortSetPinEnableDigitalNoiseFilter = false
          PortSetPinNoiseFilterBypassMode = NOISE_FILTER_SIGNAL
          PortSetPinDetectionMode = DISABLE_EDGE_DETECTION
          PortSetPinNumberOfSamples = 2
          PortSetPinSamplingClockFrequency = SUPPLY_DEVIDED_BY_1
      NewPortSetPinConfigSet4: PortSetPinConfigId=4, PortSetPinConfigLabel=CXP11TX
        NewPortSetPin0 (PortSetPin):
          PortSetPinIsSetPinConfig = true
          PortSetPinSymbolicName = P4_5
          PortSetPinDirection = PORT_PIN_OUT
          PortSetPinEnableIPControl = false
          PortSetPinMode = ALT7
          PortSetPinPullUpPullDown = NO_PULL
          PortSetPinEnableInputBuffer = false
          PortSetPinInputBufferType = INPUT_TYPE_SHMT1
          PortSetPinOpenDrain = PUSH_PULL
          PortSetPinDriveStrength = VERY_LOW_DRIVER
          PortSetPinEnableOutputValueInversion = false
          PortSetPinEnableBiDirection = false
          PortSetPinLevelValue = PORT_PIN_LEVEL_LOW
          PortSetPinIsSetSafeStateConfig = false
          PortSetPinSafeStateTrigger = DISABLE
          PortSetPinEnableLVDS = false
          PortSetPinLVDSVoltage = VOLTAGE_5V
          PortSetPinLVDSOutPutType = ANSI_TIA_EIA_644_STANDARD
        NewPortSetPinNoiseFilter0 (PortSetPinNoiseFilter):
          PortSetPinIsSetNoiseFilterConfig = false
          PortSetPinNoiseFilterFunctionName = RLIN30RX
          PortSetPinEnableDigitalNoiseFilter = false
          PortSetPinNoiseFilterBypassMode = NOISE_FILTER_SIGNAL
          PortSetPinDetectionMode = DISABLE_EDGE_DETECTION
          PortSetPinNumberOfSamples = 2
          PortSetPinSamplingClockFrequency = SUPPLY_DEVIDED_BY_1
      NewPortSetPinConfigSet5: PortSetPinConfigId=5, PortSetPinConfigLabel=MSPI2SO
        NewPortSetPin0 (PortSetPin):
          PortSetPinIsSetPinConfig = true
          PortSetPinSymbolicName = P4_6
          PortSetPinDirection = PORT_PIN_OUT
          PortSetPinEnableIPControl = true
          PortSetPinMode = ALT4
          PortSetPinPullUpPullDown = NO_PULL
          PortSetPinEnableInputBuffer = false
          PortSetPinInputBufferType = INPUT_TYPE_SHMT1
          PortSetPinOpenDrain = PUSH_PULL
          PortSetPinDriveStrength = VERY_LOW_DRIVER
          PortSetPinEnableOutputValueInversion = false
          PortSetPinEnableBiDirection = false
          PortSetPinLevelValue = PORT_PIN_LEVEL_LOW
          PortSetPinIsSetSafeStateConfig = false
          PortSetPinSafeStateTrigger = DISABLE
          PortSetPinEnableLVDS = false
          PortSetPinLVDSVoltage = VOLTAGE_5V
          PortSetPinLVDSOutPutType = ANSI_TIA_EIA_644_STANDARD
        NewPortSetPinNoiseFilter0 (PortSetPinNoiseFilter):
          PortSetPinIsSetNoiseFilterConfig = false
          PortSetPinNoiseFilterFunctionName = RLIN30RX
          PortSetPinEnableDigitalNoiseFilter = false
          PortSetPinNoiseFilterBypassMode = NOISE_FILTER_SIGNAL
          PortSetPinDetectionMode = DISABLE_EDGE_DETECTION
          PortSetPinNumberOfSamples = 2
          PortSetPinSamplingClockFrequency = SUPPLY_DEVIDED_BY_1
      NewPortSetPinConfigSet6: PortSetPinConfigId=6, PortSetPinConfigLabel=MSPI2SC
        NewPortSetPin0 (PortSetPin):
          PortSetPinIsSetPinConfig = true
          PortSetPinSymbolicName = P4_7
          PortSetPinDirection = PORT_PIN_IN
          PortSetPinEnableIPControl = false
          PortSetPinMode = ALT4
          PortSetPinPullUpPullDown = PULL_DOWN
          PortSetPinEnableInputBuffer = false
          PortSetPinInputBufferType = INPUT_TYPE_SHMT1
          PortSetPinOpenDrain = PUSH_PULL
          PortSetPinDriveStrength = VERY_LOW_DRIVER
          PortSetPinEnableOutputValueInversion = false
          PortSetPinEnableBiDirection = false
          PortSetPinLevelValue = PORT_PIN_LEVEL_LOW
          PortSetPinIsSetSafeStateConfig = false
          PortSetPinSafeStateTrigger = DISABLE
          PortSetPinEnableLVDS = false
          PortSetPinLVDSVoltage = VOLTAGE_5V
          PortSetPinLVDSOutPutType = ANSI_TIA_EIA_644_STANDARD
        NewPortSetPinNoiseFilter0 (PortSetPinNoiseFilter):
          PortSetPinIsSetNoiseFilterConfig = false
          PortSetPinNoiseFilterFunctionName = RLIN30RX
          PortSetPinEnableDigitalNoiseFilter = false
          PortSetPinNoiseFilterBypassMode = NOISE_FILTER_SIGNAL
          PortSetPinDetectionMode = DISABLE_EDGE_DETECTION
          PortSetPinNumberOfSamples = 2
          PortSetPinSamplingClockFrequency = SUPPLY_DEVIDED_BY_1
      NewPortSetPinConfigSet7: PortSetPinConfigId=7, PortSetPinConfigLabel=MSPI2SI
        NewPortSetPin0 (PortSetPin):
          PortSetPinIsSetPinConfig = true
          PortSetPinSymbolicName = P4_10
          PortSetPinDirection = PORT_PIN_IN
          PortSetPinEnableIPControl = false
          PortSetPinMode = ALT4
          PortSetPinPullUpPullDown = PULL_DOWN
          PortSetPinEnableInputBuffer = false
          PortSetPinInputBufferType = INPUT_TYPE_SHMT1
          PortSetPinOpenDrain = PUSH_PULL
          PortSetPinDriveStrength = VERY_LOW_DRIVER
          PortSetPinEnableOutputValueInversion = false
          PortSetPinEnableBiDirection = false
          PortSetPinLevelValue = PORT_PIN_LEVEL_LOW
          PortSetPinIsSetSafeStateConfig = false
          PortSetPinSafeStateTrigger = DISABLE
          PortSetPinEnableLVDS = false
          PortSetPinLVDSVoltage = VOLTAGE_5V
          PortSetPinLVDSOutPutType = ANSI_TIA_EIA_644_STANDARD
        NewPortSetPinNoiseFilter0 (PortSetPinNoiseFilter):
          PortSetPinIsSetNoiseFilterConfig = false
          PortSetPinNoiseFilterFunctionName = RLIN30RX
          PortSetPinEnableDigitalNoiseFilter = false
          PortSetPinNoiseFilterBypassMode = NOISE_FILTER_SIGNAL
          PortSetPinDetectionMode = DISABLE_EDGE_DETECTION
          PortSetPinNumberOfSamples = 2
          PortSetPinSamplingClockFrequency = SUPPLY_DEVIDED_BY_1
      NewPortSetPinConfigSet9: PortSetPinConfigId=9, PortSetPinConfigLabel=TAUD1O1
        NewPortSetPin0 (PortSetPin):
          PortSetPinIsSetPinConfig = true
          PortSetPinSymbolicName = P20_1
          PortSetPinDirection = PORT_PIN_OUT
          PortSetPinEnableIPControl = false
          PortSetPinMode = ALT6
          PortSetPinPullUpPullDown = NO_PULL
          PortSetPinEnableInputBuffer = false
          PortSetPinInputBufferType = INPUT_TYPE_SHMT1
          PortSetPinOpenDrain = PUSH_PULL
          PortSetPinDriveStrength = VERY_LOW_DRIVER
          PortSetPinEnableOutputValueInversion = false
          PortSetPinEnableBiDirection = false
          PortSetPinLevelValue = PORT_PIN_LEVEL_LOW
          PortSetPinIsSetSafeStateConfig = false
          PortSetPinSafeStateTrigger = DISABLE
          PortSetPinEnableLVDS = false
          PortSetPinLVDSVoltage = VOLTAGE_5V
          PortSetPinLVDSOutPutType = ANSI_TIA_EIA_644_STANDARD
        NewPortSetPinNoiseFilter0 (PortSetPinNoiseFilter):
          PortSetPinIsSetNoiseFilterConfig = false
          PortSetPinNoiseFilterFunctionName = RLIN30RX
          PortSetPinEnableDigitalNoiseFilter = false
          PortSetPinNoiseFilterBypassMode = NOISE_FILTER_SIGNAL
          PortSetPinDetectionMode = DISABLE_EDGE_DETECTION
          PortSetPinNumberOfSamples = 2
          PortSetPinSamplingClockFrequency = SUPPLY_DEVIDED_BY_1
      NewPortSetPinConfigSet10: PortSetPinConfigId=10, PortSetPinConfigLabel=TAUD1O2
        NewPortSetPin0 (PortSetPin):
          PortSetPinIsSetPinConfig = true
          PortSetPinSymbolicName = P20_2
          PortSetPinDirection = PORT_PIN_OUT
          PortSetPinEnableIPControl = false
          PortSetPinMode = ALT6
          PortSetPinPullUpPullDown = NO_PULL
          PortSetPinEnableInputBuffer = false
          PortSetPinInputBufferType = INPUT_TYPE_SHMT1
          PortSetPinOpenDrain = PUSH_PULL
          PortSetPinDriveStrength = VERY_LOW_DRIVER
          PortSetPinEnableOutputValueInversion = false
          PortSetPinEnableBiDirection = false
          PortSetPinLevelValue = PORT_PIN_LEVEL_LOW
          PortSetPinIsSetSafeStateConfig = false
          PortSetPinSafeStateTrigger = DISABLE
          PortSetPinEnableLVDS = false
          PortSetPinLVDSVoltage = VOLTAGE_5V
          PortSetPinLVDSOutPutType = ANSI_TIA_EIA_644_STANDARD
        NewPortSetPinNoiseFilter0 (PortSetPinNoiseFilter):
          PortSetPinIsSetNoiseFilterConfig = false
          PortSetPinNoiseFilterFunctionName = RLIN30RX
          PortSetPinEnableDigitalNoiseFilter = false
          PortSetPinNoiseFilterBypassMode = NOISE_FILTER_SIGNAL
          PortSetPinDetectionMode = DISABLE_EDGE_DETECTION
          PortSetPinNumberOfSamples = 2
          PortSetPinSamplingClockFrequency = SUPPLY_DEVIDED_BY_1
      NewPortSetPinConfigSet11: PortSetPinConfigId=11, PortSetPinConfigLabel=MSPI4SC
        NewPortSetPin0 (PortSetPin):
          PortSetPinIsSetPinConfig = true
          PortSetPinSymbolicName = P21_0
          PortSetPinDirection = PORT_PIN_IN
          PortSetPinEnableIPControl = false
          PortSetPinMode = ALT4
          PortSetPinPullUpPullDown = PULL_DOWN
          PortSetPinEnableInputBuffer = false
          PortSetPinInputBufferType = INPUT_TYPE_SHMT1
          PortSetPinOpenDrain = PUSH_PULL
          PortSetPinDriveStrength = VERY_LOW_DRIVER
          PortSetPinEnableOutputValueInversion = false
          PortSetPinEnableBiDirection = false
          PortSetPinLevelValue = PORT_PIN_LEVEL_LOW
          PortSetPinIsSetSafeStateConfig = false
          PortSetPinSafeStateTrigger = DISABLE
          PortSetPinEnableLVDS = false
          PortSetPinLVDSVoltage = VOLTAGE_5V
          PortSetPinLVDSOutPutType = ANSI_TIA_EIA_644_STANDARD
        NewPortSetPinNoiseFilter0 (PortSetPinNoiseFilter):
          PortSetPinIsSetNoiseFilterConfig = false
          PortSetPinNoiseFilterFunctionName = RLIN30RX
          PortSetPinEnableDigitalNoiseFilter = false
          PortSetPinNoiseFilterBypassMode = NOISE_FILTER_SIGNAL
          PortSetPinDetectionMode = DISABLE_EDGE_DETECTION
          PortSetPinNumberOfSamples = 2
          PortSetPinSamplingClockFrequency = SUPPLY_DEVIDED_BY_1
      NewPortSetPinConfigSet12: PortSetPinConfigId=12, PortSetPinConfigLabel=MSPI4SI
        NewPortSetPin0 (PortSetPin):
          PortSetPinIsSetPinConfig = true
          PortSetPinSymbolicName = P21_1
          PortSetPinDirection = PORT_PIN_IN
          PortSetPinEnableIPControl = false
          PortSetPinMode = ALT4
          PortSetPinPullUpPullDown = PULL_DOWN
          PortSetPinEnableInputBuffer = false
          PortSetPinInputBufferType = INPUT_TYPE_SHMT1
          PortSetPinOpenDrain = PUSH_PULL
          PortSetPinDriveStrength = VERY_LOW_DRIVER
          PortSetPinEnableOutputValueInversion = false
          PortSetPinEnableBiDirection = false
          PortSetPinLevelValue = PORT_PIN_LEVEL_LOW
          PortSetPinIsSetSafeStateConfig = false
          PortSetPinSafeStateTrigger = DISABLE
          PortSetPinEnableLVDS = false
          PortSetPinLVDSVoltage = VOLTAGE_5V
          PortSetPinLVDSOutPutType = ANSI_TIA_EIA_644_STANDARD
        NewPortSetPinNoiseFilter0 (PortSetPinNoiseFilter):
          PortSetPinIsSetNoiseFilterConfig = false
          PortSetPinNoiseFilterFunctionName = RLIN30RX
          PortSetPinEnableDigitalNoiseFilter = false
          PortSetPinNoiseFilterBypassMode = NOISE_FILTER_SIGNAL
          PortSetPinDetectionMode = DISABLE_EDGE_DETECTION
          PortSetPinNumberOfSamples = 2
          PortSetPinSamplingClockFrequency = SUPPLY_DEVIDED_BY_1
      NewPortSetPinConfigSet13: PortSetPinConfigId=13, PortSetPinConfigLabel=MSPI4SO
        NewPortSetPin0 (PortSetPin):
          PortSetPinIsSetPinConfig = true
          PortSetPinSymbolicName = P21_2
          PortSetPinDirection = PORT_PIN_OUT
          PortSetPinEnableIPControl = true
          PortSetPinMode = ALT4
          PortSetPinPullUpPullDown = NO_PULL
          PortSetPinEnableInputBuffer = false
          PortSetPinInputBufferType = INPUT_TYPE_SHMT1
          PortSetPinOpenDrain = PUSH_PULL
          PortSetPinDriveStrength = VERY_LOW_DRIVER
          PortSetPinEnableOutputValueInversion = false
          PortSetPinEnableBiDirection = false
          PortSetPinLevelValue = PORT_PIN_LEVEL_LOW
          PortSetPinIsSetSafeStateConfig = false
          PortSetPinSafeStateTrigger = DISABLE
          PortSetPinEnableLVDS = false
          PortSetPinLVDSVoltage = VOLTAGE_5V
          PortSetPinLVDSOutPutType = ANSI_TIA_EIA_644_STANDARD
        NewPortSetPinNoiseFilter0 (PortSetPinNoiseFilter):
          PortSetPinIsSetNoiseFilterConfig = false
          PortSetPinNoiseFilterFunctionName = RLIN30RX
          PortSetPinEnableDigitalNoiseFilter = false
          PortSetPinNoiseFilterBypassMode = NOISE_FILTER_SIGNAL
          PortSetPinDetectionMode = DISABLE_EDGE_DETECTION
          PortSetPinNumberOfSamples = 2
          PortSetPinSamplingClockFrequency = SUPPLY_DEVIDED_BY_1
      NewPortSetPinConfigSet17: PortSetPinConfigId=17, PortSetPinConfigLabel=MSPI3SC
        NewPortSetPin0 (PortSetPin):
          PortSetPinIsSetPinConfig = true
          PortSetPinSymbolicName = P24_10
          PortSetPinDirection = PORT_PIN_IN
          PortSetPinEnableIPControl = false
          PortSetPinMode = ALT2
          PortSetPinPullUpPullDown = PULL_DOWN
          PortSetPinEnableInputBuffer = false
          PortSetPinInputBufferType = INPUT_TYPE_SHMT1
          PortSetPinOpenDrain = PUSH_PULL
          PortSetPinDriveStrength = VERY_LOW_DRIVER
          PortSetPinEnableOutputValueInversion = false
          PortSetPinEnableBiDirection = false
          PortSetPinLevelValue = PORT_PIN_LEVEL_LOW
          PortSetPinIsSetSafeStateConfig = false
          PortSetPinSafeStateTrigger = DISABLE
          PortSetPinEnableLVDS = false
          PortSetPinLVDSVoltage = VOLTAGE_5V
          PortSetPinLVDSOutPutType = ANSI_TIA_EIA_644_STANDARD
        NewPortSetPinNoiseFilter0 (PortSetPinNoiseFilter):
          PortSetPinIsSetNoiseFilterConfig = false
          PortSetPinNoiseFilterFunctionName = RLIN30RX
          PortSetPinEnableDigitalNoiseFilter = false
          PortSetPinNoiseFilterBypassMode = NOISE_FILTER_SIGNAL
          PortSetPinDetectionMode = DISABLE_EDGE_DETECTION
          PortSetPinNumberOfSamples = 2
          PortSetPinSamplingClockFrequency = SUPPLY_DEVIDED_BY_1
      NewPortSetPinConfigSet18: PortSetPinConfigId=18, PortSetPinConfigLabel=MSPI3SI
        NewPortSetPin0 (PortSetPin):
          PortSetPinIsSetPinConfig = true
          PortSetPinSymbolicName = P24_12
          PortSetPinDirection = PORT_PIN_IN
          PortSetPinEnableIPControl = false
          PortSetPinMode = ALT2
          PortSetPinPullUpPullDown = PULL_DOWN
          PortSetPinEnableInputBuffer = false
          PortSetPinInputBufferType = INPUT_TYPE_SHMT1
          PortSetPinOpenDrain = PUSH_PULL
          PortSetPinDriveStrength = VERY_LOW_DRIVER
          PortSetPinEnableOutputValueInversion = false
          PortSetPinEnableBiDirection = false
          PortSetPinLevelValue = PORT_PIN_LEVEL_LOW
          PortSetPinIsSetSafeStateConfig = false
          PortSetPinSafeStateTrigger = DISABLE
          PortSetPinEnableLVDS = false
          PortSetPinLVDSVoltage = VOLTAGE_5V
          PortSetPinLVDSOutPutType = ANSI_TIA_EIA_644_STANDARD
        NewPortSetPinNoiseFilter0 (PortSetPinNoiseFilter):
          PortSetPinIsSetNoiseFilterConfig = false
          PortSetPinNoiseFilterFunctionName = RLIN30RX
          PortSetPinEnableDigitalNoiseFilter = false
          PortSetPinNoiseFilterBypassMode = NOISE_FILTER_SIGNAL
          PortSetPinDetectionMode = DISABLE_EDGE_DETECTION
          PortSetPinNumberOfSamples = 2
          PortSetPinSamplingClockFrequency = SUPPLY_DEVIDED_BY_1
      NewPortSetPinConfigSet19: PortSetPinConfigId=19, PortSetPinConfigLabel=MSPI3SO
        NewPortSetPin0 (PortSetPin):
          PortSetPinIsSetPinConfig = true
          PortSetPinSymbolicName = P24_13
          PortSetPinDirection = PORT_PIN_OUT
          PortSetPinEnableIPControl = true
          PortSetPinMode = ALT2
          PortSetPinPullUpPullDown = NO_PULL
          PortSetPinEnableInputBuffer = false
          PortSetPinInputBufferType = INPUT_TYPE_SHMT1
          PortSetPinOpenDrain = PUSH_PULL
          PortSetPinDriveStrength = VERY_LOW_DRIVER
          PortSetPinEnableOutputValueInversion = false
          PortSetPinEnableBiDirection = false
          PortSetPinLevelValue = PORT_PIN_LEVEL_LOW
          PortSetPinIsSetSafeStateConfig = false
          PortSetPinSafeStateTrigger = DISABLE
          PortSetPinEnableLVDS = false
          PortSetPinLVDSVoltage = VOLTAGE_5V
          PortSetPinLVDSOutPutType = ANSI_TIA_EIA_644_STANDARD
        NewPortSetPinNoiseFilter0 (PortSetPinNoiseFilter):
          PortSetPinIsSetNoiseFilterConfig = false
          PortSetPinNoiseFilterFunctionName = RLIN30RX
          PortSetPinEnableDigitalNoiseFilter = false
          PortSetPinNoiseFilterBypassMode = NOISE_FILTER_SIGNAL
          PortSetPinDetectionMode = DISABLE_EDGE_DETECTION
          PortSetPinNumberOfSamples = 2
          PortSetPinSamplingClockFrequency = SUPPLY_DEVIDED_BY_1
      NewPortSetPinConfigSet20: PortSetPinConfigId=20, PortSetPinConfigLabel=CXP10TX
        NewPortSetPin0 (PortSetPin):
          PortSetPinIsSetPinConfig = true
          PortSetPinSymbolicName = P2_10
          PortSetPinDirection = PORT_PIN_OUT
          PortSetPinEnableIPControl = false
          PortSetPinMode = ALT5
          PortSetPinPullUpPullDown = NO_PULL
          PortSetPinEnableInputBuffer = false
          PortSetPinInputBufferType = INPUT_TYPE_SHMT1
          PortSetPinOpenDrain = PUSH_PULL
          PortSetPinDriveStrength = VERY_LOW_DRIVER
          PortSetPinEnableOutputValueInversion = false
          PortSetPinEnableBiDirection = false
          PortSetPinLevelValue = PORT_PIN_LEVEL_LOW
          PortSetPinIsSetSafeStateConfig = false
          PortSetPinSafeStateTrigger = DISABLE
          PortSetPinEnableLVDS = false
          PortSetPinLVDSVoltage = VOLTAGE_5V
          PortSetPinLVDSOutPutType = ANSI_TIA_EIA_644_STANDARD
        NewPortSetPinNoiseFilter0 (PortSetPinNoiseFilter):
          PortSetPinIsSetNoiseFilterConfig = false
          PortSetPinNoiseFilterFunctionName = RLIN30RX
          PortSetPinEnableDigitalNoiseFilter = false
          PortSetPinNoiseFilterBypassMode = NOISE_FILTER_SIGNAL
          PortSetPinDetectionMode = DISABLE_EDGE_DETECTION
          PortSetPinNumberOfSamples = 2
          PortSetPinSamplingClockFrequency = SUPPLY_DEVIDED_BY_1
      NewPortSetPinConfigSet21: PortSetPinConfigId=21, PortSetPinConfigLabel=DO_LO
        NewPortSetPin0 (PortSetPin):
          PortSetPinIsSetPinConfig = true
          PortSetPinSymbolicName = P8_0
          PortSetPinDirection = PORT_PIN_OUT
          PortSetPinEnableIPControl = false
          PortSetPinMode = GPIO
          PortSetPinPullUpPullDown = NO_PULL
          PortSetPinEnableInputBuffer = false
          PortSetPinInputBufferType = INPUT_TYPE_SHMT1
          PortSetPinOpenDrain = PUSH_PULL
          PortSetPinDriveStrength = VERY_LOW_DRIVER
          PortSetPinEnableOutputValueInversion = false
          PortSetPinEnableBiDirection = false
          PortSetPinLevelValue = PORT_PIN_LEVEL_LOW
          PortSetPinIsSetSafeStateConfig = false
          PortSetPinSafeStateTrigger = DISABLE
          PortSetPinEnableLVDS = false
          PortSetPinLVDSVoltage = VOLTAGE_5V
          PortSetPinLVDSOutPutType = ANSI_TIA_EIA_644_STANDARD
        NewPortSetPinNoiseFilter0 (PortSetPinNoiseFilter):
          PortSetPinIsSetNoiseFilterConfig = false
          PortSetPinNoiseFilterFunctionName = RLIN30RX
          PortSetPinEnableDigitalNoiseFilter = false
          PortSetPinNoiseFilterBypassMode = NOISE_FILTER_SIGNAL
          PortSetPinDetectionMode = DISABLE_EDGE_DETECTION
          PortSetPinNumberOfSamples = 2
          PortSetPinSamplingClockFrequency = SUPPLY_DEVIDED_BY_1
      NewPortSetPinConfigSet22: PortSetPinConfigId=22, PortSetPinConfigLabel=DO_LO
        NewPortSetPin0 (PortSetPin):
          PortSetPinIsSetPinConfig = true
          PortSetPinSymbolicName = P8_2
          PortSetPinDirection = PORT_PIN_OUT
          PortSetPinEnableIPControl = false
          PortSetPinMode = GPIO
          PortSetPinPullUpPullDown = NO_PULL
          PortSetPinEnableInputBuffer = false
          PortSetPinInputBufferType = INPUT_TYPE_SHMT1
          PortSetPinOpenDrain = PUSH_PULL
          PortSetPinDriveStrength = VERY_LOW_DRIVER
          PortSetPinEnableOutputValueInversion = false
          PortSetPinEnableBiDirection = false
          PortSetPinLevelValue = PORT_PIN_LEVEL_LOW
          PortSetPinIsSetSafeStateConfig = false
          PortSetPinSafeStateTrigger = DISABLE
          PortSetPinEnableLVDS = false
          PortSetPinLVDSVoltage = VOLTAGE_5V
          PortSetPinLVDSOutPutType = ANSI_TIA_EIA_644_STANDARD
        NewPortSetPinNoiseFilter0 (PortSetPinNoiseFilter):
          PortSetPinIsSetNoiseFilterConfig = false
          PortSetPinNoiseFilterFunctionName = RLIN30RX
          PortSetPinEnableDigitalNoiseFilter = false
          PortSetPinNoiseFilterBypassMode = NOISE_FILTER_SIGNAL
          PortSetPinDetectionMode = DISABLE_EDGE_DETECTION
          PortSetPinNumberOfSamples = 2
          PortSetPinSamplingClockFrequency = SUPPLY_DEVIDED_BY_1
      NewPortSetPinConfigSet23: PortSetPinConfigId=23, PortSetPinConfigLabel=DO_LO
        NewPortSetPin0 (PortSetPin):
          PortSetPinIsSetPinConfig = true
          PortSetPinSymbolicName = AP5_1
          PortSetPinDirection = PORT_PIN_OUT
          PortSetPinEnableIPControl = false
          PortSetPinMode = GPIO
          PortSetPinPullUpPullDown = NO_PULL
          PortSetPinEnableInputBuffer = false
          PortSetPinInputBufferType = INPUT_TYPE_SHMT1
          PortSetPinOpenDrain = PUSH_PULL
          PortSetPinDriveStrength = VERY_LOW_DRIVER
          PortSetPinEnableOutputValueInversion = false
          PortSetPinEnableBiDirection = false
          PortSetPinLevelValue = PORT_PIN_LEVEL_LOW
          PortSetPinIsSetSafeStateConfig = false
          PortSetPinSafeStateTrigger = DISABLE
          PortSetPinEnableLVDS = false
          PortSetPinLVDSVoltage = VOLTAGE_5V
          PortSetPinLVDSOutPutType = ANSI_TIA_EIA_644_STANDARD
        NewPortSetPinNoiseFilter0 (PortSetPinNoiseFilter):
          PortSetPinIsSetNoiseFilterConfig = false
          PortSetPinNoiseFilterFunctionName = RLIN30RX
          PortSetPinEnableDigitalNoiseFilter = false
          PortSetPinNoiseFilterBypassMode = NOISE_FILTER_SIGNAL
          PortSetPinDetectionMode = DISABLE_EDGE_DETECTION
          PortSetPinNumberOfSamples = 2
          PortSetPinSamplingClockFrequency = SUPPLY_DEVIDED_BY_1
      NewPortSetPinConfigSet24: PortSetPinConfigId=24, PortSetPinConfigLabel=RIIC0SDA
        NewPortSetPin0 (PortSetPin):
          PortSetPinIsSetPinConfig = true
          PortSetPinSymbolicName = P10_0
          PortSetPinDirection = PORT_PIN_OUT
          PortSetPinEnableIPControl = false
          PortSetPinMode = ALT7
          PortSetPinPullUpPullDown = NO_PULL
          PortSetPinEnableInputBuffer = false
          PortSetPinInputBufferType = INPUT_TYPE_SHMT1
          PortSetPinOpenDrain = EMULATED_N_CHANNEL_OPEN_DRAIN
          PortSetPinDriveStrength = MEDIUM_DRIVER
          PortSetPinEnableOutputValueInversion = false
          PortSetPinEnableBiDirection = true
          PortSetPinLevelValue = PORT_PIN_LEVEL_LOW
          PortSetPinIsSetSafeStateConfig = false
          PortSetPinSafeStateTrigger = DISABLE
          PortSetPinEnableLVDS = false
          PortSetPinLVDSVoltage = VOLTAGE_5V
          PortSetPinLVDSOutPutType = ANSI_TIA_EIA_644_STANDARD
        NewPortSetPinNoiseFilter0 (PortSetPinNoiseFilter):
          PortSetPinIsSetNoiseFilterConfig = false
          PortSetPinNoiseFilterFunctionName = RLIN30RX
          PortSetPinEnableDigitalNoiseFilter = false
          PortSetPinNoiseFilterBypassMode = NOISE_FILTER_SIGNAL
          PortSetPinDetectionMode = DISABLE_EDGE_DETECTION
          PortSetPinNumberOfSamples = 2
          PortSetPinSamplingClockFrequency = SUPPLY_DEVIDED_BY_1
      NewPortSetPinConfigSet25: PortSetPinConfigId=25, PortSetPinConfigLabel=RIIC0SCL
        NewPortSetPin0 (PortSetPin):
          PortSetPinIsSetPinConfig = true
          PortSetPinSymbolicName = P10_1
          PortSetPinDirection = PORT_PIN_OUT
          PortSetPinEnableIPControl = false
          PortSetPinMode = ALT7
          PortSetPinPullUpPullDown = NO_PULL
          PortSetPinEnableInputBuffer = false
          PortSetPinInputBufferType = INPUT_TYPE_SHMT1
          PortSetPinOpenDrain = EMULATED_N_CHANNEL_OPEN_DRAIN
          PortSetPinDriveStrength = MEDIUM_DRIVER
          PortSetPinEnableOutputValueInversion = false
          PortSetPinEnableBiDirection = true
          PortSetPinLevelValue = PORT_PIN_LEVEL_LOW
          PortSetPinIsSetSafeStateConfig = false
          PortSetPinSafeStateTrigger = DISABLE
          PortSetPinEnableLVDS = false
          PortSetPinLVDSVoltage = VOLTAGE_5V
          PortSetPinLVDSOutPutType = ANSI_TIA_EIA_644_STANDARD
        NewPortSetPinNoiseFilter0 (PortSetPinNoiseFilter):
          PortSetPinIsSetNoiseFilterConfig = false
          PortSetPinNoiseFilterFunctionName = RLIN30RX
          PortSetPinEnableDigitalNoiseFilter = false
          PortSetPinNoiseFilterBypassMode = NOISE_FILTER_SIGNAL
          PortSetPinDetectionMode = DISABLE_EDGE_DETECTION
          PortSetPinNumberOfSamples = 2
          PortSetPinSamplingClockFrequency = SUPPLY_DEVIDED_BY_1
      NewPortSetPinConfigSet26: PortSetPinConfigId=26, PortSetPinConfigLabel=RIIC1SDA
        NewPortSetPin0 (PortSetPin):
          PortSetPinIsSetPinConfig = true
          PortSetPinSymbolicName = P22_3
          PortSetPinDirection = PORT_PIN_OUT
          PortSetPinEnableIPControl = false
          PortSetPinMode = ALT5
          PortSetPinPullUpPullDown = NO_PULL
          PortSetPinEnableInputBuffer = false
          PortSetPinInputBufferType = INPUT_TYPE_SHMT1
          PortSetPinOpenDrain = EMULATED_N_CHANNEL_OPEN_DRAIN
          PortSetPinDriveStrength = MEDIUM_DRIVER
          PortSetPinEnableOutputValueInversion = false
          PortSetPinEnableBiDirection = true
          PortSetPinLevelValue = PORT_PIN_LEVEL_LOW
          PortSetPinIsSetSafeStateConfig = false
          PortSetPinSafeStateTrigger = DISABLE
          PortSetPinEnableLVDS = false
          PortSetPinLVDSVoltage = VOLTAGE_5V
          PortSetPinLVDSOutPutType = ANSI_TIA_EIA_644_STANDARD
        NewPortSetPinNoiseFilter0 (PortSetPinNoiseFilter):
          PortSetPinIsSetNoiseFilterConfig = false
          PortSetPinNoiseFilterFunctionName = RLIN30RX
          PortSetPinEnableDigitalNoiseFilter = false
          PortSetPinNoiseFilterBypassMode = NOISE_FILTER_SIGNAL
          PortSetPinDetectionMode = DISABLE_EDGE_DETECTION
          PortSetPinNumberOfSamples = 2
          PortSetPinSamplingClockFrequency = SUPPLY_DEVIDED_BY_1
      NewPortSetPinConfigSet27: PortSetPinConfigId=27, PortSetPinConfigLabel=RIIC1SCL
        NewPortSetPin0 (PortSetPin):
          PortSetPinIsSetPinConfig = true
          PortSetPinSymbolicName = P22_4
          PortSetPinDirection = PORT_PIN_OUT
          PortSetPinEnableIPControl = false
          PortSetPinMode = ALT5
          PortSetPinPullUpPullDown = NO_PULL
          PortSetPinEnableInputBuffer = false
          PortSetPinInputBufferType = INPUT_TYPE_SHMT1
          PortSetPinOpenDrain = EMULATED_N_CHANNEL_OPEN_DRAIN
          PortSetPinDriveStrength = MEDIUM_DRIVER
          PortSetPinEnableOutputValueInversion = false
          PortSetPinEnableBiDirection = true
          PortSetPinLevelValue = PORT_PIN_LEVEL_LOW
          PortSetPinIsSetSafeStateConfig = false
          PortSetPinSafeStateTrigger = DISABLE
          PortSetPinEnableLVDS = false
          PortSetPinLVDSVoltage = VOLTAGE_5V
          PortSetPinLVDSOutPutType = ANSI_TIA_EIA_644_STANDARD
        NewPortSetPinNoiseFilter0 (PortSetPinNoiseFilter):
          PortSetPinIsSetNoiseFilterConfig = false
          PortSetPinNoiseFilterFunctionName = RLIN30RX
          PortSetPinEnableDigitalNoiseFilter = false
          PortSetPinNoiseFilterBypassMode = NOISE_FILTER_SIGNAL
          PortSetPinDetectionMode = DISABLE_EDGE_DETECTION
          PortSetPinNumberOfSamples = 2
          PortSetPinSamplingClockFrequency = SUPPLY_DEVIDED_BY_1
      NewPortSetPinConfigSet28: PortSetPinConfigId=28, PortSetPinConfigLabel=DO_OD_HI
        NewPortSetPin0 (PortSetPin):
          PortSetPinIsSetPinConfig = true
          PortSetPinSymbolicName = P10_0
          PortSetPinDirection = PORT_PIN_OUT
          PortSetPinEnableIPControl = false
          PortSetPinMode = GPIO
          PortSetPinPullUpPullDown = NO_PULL
          PortSetPinEnableInputBuffer = false
          PortSetPinInputBufferType = INPUT_TYPE_SHMT1
          PortSetPinOpenDrain = EMULATED_N_CHANNEL_OPEN_DRAIN
          PortSetPinDriveStrength = MEDIUM_DRIVER
          PortSetPinEnableOutputValueInversion = false
          PortSetPinEnableBiDirection = false
          PortSetPinLevelValue = PORT_PIN_LEVEL_HIGH
          PortSetPinIsSetSafeStateConfig = false
          PortSetPinSafeStateTrigger = DISABLE
          PortSetPinEnableLVDS = false
          PortSetPinLVDSVoltage = VOLTAGE_5V
          PortSetPinLVDSOutPutType = ANSI_TIA_EIA_644_STANDARD
        NewPortSetPinNoiseFilter0 (PortSetPinNoiseFilter):
          PortSetPinIsSetNoiseFilterConfig = false
          PortSetPinNoiseFilterFunctionName = RLIN30RX
          PortSetPinEnableDigitalNoiseFilter = false
          PortSetPinNoiseFilterBypassMode = NOISE_FILTER_SIGNAL
          PortSetPinDetectionMode = DISABLE_EDGE_DETECTION
          PortSetPinNumberOfSamples = 2
          PortSetPinSamplingClockFrequency = SUPPLY_DEVIDED_BY_1
      NewPortSetPinConfigSet29: PortSetPinConfigId=29, PortSetPinConfigLabel=DO_OD_HI
        NewPortSetPin0 (PortSetPin):
          PortSetPinIsSetPinConfig = true
          PortSetPinSymbolicName = P10_1
          PortSetPinDirection = PORT_PIN_OUT
          PortSetPinEnableIPControl = false
          PortSetPinMode = GPIO
          PortSetPinPullUpPullDown = NO_PULL
          PortSetPinEnableInputBuffer = false
          PortSetPinInputBufferType = INPUT_TYPE_SHMT1
          PortSetPinOpenDrain = EMULATED_N_CHANNEL_OPEN_DRAIN
          PortSetPinDriveStrength = MEDIUM_DRIVER
          PortSetPinEnableOutputValueInversion = false
          PortSetPinEnableBiDirection = false
          PortSetPinLevelValue = PORT_PIN_LEVEL_HIGH
          PortSetPinIsSetSafeStateConfig = false
          PortSetPinSafeStateTrigger = DISABLE
          PortSetPinEnableLVDS = false
          PortSetPinLVDSVoltage = VOLTAGE_5V
          PortSetPinLVDSOutPutType = ANSI_TIA_EIA_644_STANDARD
        NewPortSetPinNoiseFilter0 (PortSetPinNoiseFilter):
          PortSetPinIsSetNoiseFilterConfig = false
          PortSetPinNoiseFilterFunctionName = RLIN30RX
          PortSetPinEnableDigitalNoiseFilter = false
          PortSetPinNoiseFilterBypassMode = NOISE_FILTER_SIGNAL
          PortSetPinDetectionMode = DISABLE_EDGE_DETECTION
          PortSetPinNumberOfSamples = 2
          PortSetPinSamplingClockFrequency = SUPPLY_DEVIDED_BY_1
      NewPortSetPinConfigSet30: PortSetPinConfigId=30, PortSetPinConfigLabel=DO_OD_HI
        NewPortSetPin0 (PortSetPin):
          PortSetPinIsSetPinConfig = true
          PortSetPinSymbolicName = P22_3
          PortSetPinDirection = PORT_PIN_OUT
          PortSetPinEnableIPControl = false
          PortSetPinMode = GPIO
          PortSetPinPullUpPullDown = NO_PULL
          PortSetPinEnableInputBuffer = false
          PortSetPinInputBufferType = INPUT_TYPE_SHMT1
          PortSetPinOpenDrain = EMULATED_N_CHANNEL_OPEN_DRAIN
          PortSetPinDriveStrength = MEDIUM_DRIVER
          PortSetPinEnableOutputValueInversion = false
          PortSetPinEnableBiDirection = false
          PortSetPinLevelValue = PORT_PIN_LEVEL_HIGH
          PortSetPinIsSetSafeStateConfig = false
          PortSetPinSafeStateTrigger = DISABLE
          PortSetPinEnableLVDS = false
          PortSetPinLVDSVoltage = VOLTAGE_5V
          PortSetPinLVDSOutPutType = ANSI_TIA_EIA_644_STANDARD
        NewPortSetPinNoiseFilter0 (PortSetPinNoiseFilter):
          PortSetPinIsSetNoiseFilterConfig = false
          PortSetPinNoiseFilterFunctionName = RLIN30RX
          PortSetPinEnableDigitalNoiseFilter = false
          PortSetPinNoiseFilterBypassMode = NOISE_FILTER_SIGNAL
          PortSetPinDetectionMode = DISABLE_EDGE_DETECTION
          PortSetPinNumberOfSamples = 2
          PortSetPinSamplingClockFrequency = SUPPLY_DEVIDED_BY_1
      NewPortSetPinConfigSet31: PortSetPinConfigId=31, PortSetPinConfigLabel=DO_OD_HI
        NewPortSetPin0 (PortSetPin):
          PortSetPinIsSetPinConfig = true
          PortSetPinSymbolicName = P22_4
          PortSetPinDirection = PORT_PIN_OUT
          PortSetPinEnableIPControl = false
          PortSetPinMode = GPIO
          PortSetPinPullUpPullDown = NO_PULL
          PortSetPinEnableInputBuffer = false
          PortSetPinInputBufferType = INPUT_TYPE_SHMT1
          PortSetPinOpenDrain = EMULATED_N_CHANNEL_OPEN_DRAIN
          PortSetPinDriveStrength = MEDIUM_DRIVER
          PortSetPinEnableOutputValueInversion = false
          PortSetPinEnableBiDirection = false
          PortSetPinLevelValue = PORT_PIN_LEVEL_HIGH
          PortSetPinIsSetSafeStateConfig = false
          PortSetPinSafeStateTrigger = DISABLE
          PortSetPinEnableLVDS = false
          PortSetPinLVDSVoltage = VOLTAGE_5V
          PortSetPinLVDSOutPutType = ANSI_TIA_EIA_644_STANDARD
        NewPortSetPinNoiseFilter0 (PortSetPinNoiseFilter):
          PortSetPinIsSetNoiseFilterConfig = false
          PortSetPinNoiseFilterFunctionName = RLIN30RX
          PortSetPinEnableDigitalNoiseFilter = false
          PortSetPinNoiseFilterBypassMode = NOISE_FILTER_SIGNAL
          PortSetPinDetectionMode = DISABLE_EDGE_DETECTION
          PortSetPinNumberOfSamples = 2
          PortSetPinSamplingClockFrequency = SUPPLY_DEVIDED_BY_1
      NewPortSetPinConfigSet32: PortSetPinConfigId=32, PortSetPinConfigLabel=DO_LO
        NewPortSetPin0 (PortSetPin):
          PortSetPinIsSetPinConfig = true
          PortSetPinSymbolicName = P2_10
          PortSetPinDirection = PORT_PIN_OUT
          PortSetPinEnableIPControl = false
          PortSetPinMode = GPIO
          PortSetPinPullUpPullDown = NO_PULL
          PortSetPinEnableInputBuffer = false
          PortSetPinInputBufferType = INPUT_TYPE_SHMT1
          PortSetPinOpenDrain = PUSH_PULL
          PortSetPinDriveStrength = VERY_LOW_DRIVER
          PortSetPinEnableOutputValueInversion = false
          PortSetPinEnableBiDirection = false
          PortSetPinLevelValue = PORT_PIN_LEVEL_LOW
          PortSetPinIsSetSafeStateConfig = false
          PortSetPinSafeStateTrigger = DISABLE
          PortSetPinEnableLVDS = false
          PortSetPinLVDSVoltage = VOLTAGE_5V
          PortSetPinLVDSOutPutType = ANSI_TIA_EIA_644_STANDARD
        NewPortSetPinNoiseFilter0 (PortSetPinNoiseFilter):
          PortSetPinIsSetNoiseFilterConfig = false
          PortSetPinNoiseFilterFunctionName = RLIN30RX
          PortSetPinEnableDigitalNoiseFilter = false
          PortSetPinNoiseFilterBypassMode = NOISE_FILTER_SIGNAL
          PortSetPinDetectionMode = DISABLE_EDGE_DETECTION
          PortSetPinNumberOfSamples = 2
          PortSetPinSamplingClockFrequency = SUPPLY_DEVIDED_BY_1
      NewPortSetPinConfigSet33: PortSetPinConfigId=33, PortSetPinConfigLabel=DI
        NewPortSetPin0 (PortSetPin):
          PortSetPinIsSetPinConfig = true
          PortSetPinSymbolicName = P2_11
          PortSetPinDirection = PORT_PIN_IN
          PortSetPinEnableIPControl = false
          PortSetPinMode = GPIO
          PortSetPinPullUpPullDown = PULL_DOWN
          PortSetPinEnableInputBuffer = true
          PortSetPinInputBufferType = INPUT_TYPE_SHMT1
          PortSetPinOpenDrain = PUSH_PULL
          PortSetPinDriveStrength = VERY_LOW_DRIVER
          PortSetPinEnableOutputValueInversion = false
          PortSetPinEnableBiDirection = false
          PortSetPinLevelValue = PORT_PIN_LEVEL_LOW
          PortSetPinIsSetSafeStateConfig = false
          PortSetPinSafeStateTrigger = DISABLE
          PortSetPinEnableLVDS = false
          PortSetPinLVDSVoltage = VOLTAGE_5V
          PortSetPinLVDSOutPutType = ANSI_TIA_EIA_644_STANDARD
        NewPortSetPinNoiseFilter0 (PortSetPinNoiseFilter):
          PortSetPinIsSetNoiseFilterConfig = false
          PortSetPinNoiseFilterFunctionName = RLIN30RX
          PortSetPinEnableDigitalNoiseFilter = false
          PortSetPinNoiseFilterBypassMode = NOISE_FILTER_SIGNAL
          PortSetPinDetectionMode = DISABLE_EDGE_DETECTION
          PortSetPinNumberOfSamples = 2
          PortSetPinSamplingClockFrequency = SUPPLY_DEVIDED_BY_1
      NewPortSetPinConfigSet34: PortSetPinConfigId=34, PortSetPinConfigLabel=DO_LO
        NewPortSetPin0 (PortSetPin):
          PortSetPinIsSetPinConfig = true
          PortSetPinSymbolicName = P2_12
          PortSetPinDirection = PORT_PIN_OUT
          PortSetPinEnableIPControl = false
          PortSetPinMode = GPIO
          PortSetPinPullUpPullDown = NO_PULL
          PortSetPinEnableInputBuffer = false
          PortSetPinInputBufferType = INPUT_TYPE_SHMT1
          PortSetPinOpenDrain = PUSH_PULL
          PortSetPinDriveStrength = MEDIUM_DRIVER
          PortSetPinEnableOutputValueInversion = false
          PortSetPinEnableBiDirection = false
          PortSetPinLevelValue = PORT_PIN_LEVEL_LOW
          PortSetPinIsSetSafeStateConfig = false
          PortSetPinSafeStateTrigger = DISABLE
          PortSetPinEnableLVDS = false
          PortSetPinLVDSVoltage = VOLTAGE_5V
          PortSetPinLVDSOutPutType = ANSI_TIA_EIA_644_STANDARD
        NewPortSetPinNoiseFilter0 (PortSetPinNoiseFilter):
          PortSetPinIsSetNoiseFilterConfig = false
          PortSetPinNoiseFilterFunctionName = RLIN30RX
          PortSetPinEnableDigitalNoiseFilter = false
          PortSetPinNoiseFilterBypassMode = NOISE_FILTER_SIGNAL
          PortSetPinDetectionMode = DISABLE_EDGE_DETECTION
          PortSetPinNumberOfSamples = 2
          PortSetPinSamplingClockFrequency = SUPPLY_DEVIDED_BY_1
      NewPortSetPinConfigSet35: PortSetPinConfigId=35, PortSetPinConfigLabel=DO_LO
        NewPortSetPin0 (PortSetPin):
          PortSetPinIsSetPinConfig = true
          PortSetPinSymbolicName = P2_13
          PortSetPinDirection = PORT_PIN_OUT
          PortSetPinEnableIPControl = false
          PortSetPinMode = GPIO
          PortSetPinPullUpPullDown = NO_PULL
          PortSetPinEnableInputBuffer = false
          PortSetPinInputBufferType = INPUT_TYPE_SHMT1
          PortSetPinOpenDrain = PUSH_PULL
          PortSetPinDriveStrength = MEDIUM_DRIVER
          PortSetPinEnableOutputValueInversion = false
          PortSetPinEnableBiDirection = false
          PortSetPinLevelValue = PORT_PIN_LEVEL_LOW
          PortSetPinIsSetSafeStateConfig = false
          PortSetPinSafeStateTrigger = DISABLE
          PortSetPinEnableLVDS = false
          PortSetPinLVDSVoltage = VOLTAGE_5V
          PortSetPinLVDSOutPutType = ANSI_TIA_EIA_644_STANDARD
        NewPortSetPinNoiseFilter0 (PortSetPinNoiseFilter):
          PortSetPinIsSetNoiseFilterConfig = false
          PortSetPinNoiseFilterFunctionName = RLIN30RX
          PortSetPinEnableDigitalNoiseFilter = false
          PortSetPinNoiseFilterBypassMode = NOISE_FILTER_SIGNAL
          PortSetPinDetectionMode = DISABLE_EDGE_DETECTION
          PortSetPinNumberOfSamples = 2
          PortSetPinSamplingClockFrequency = SUPPLY_DEVIDED_BY_1
      NewPortSetPinConfigSet36: PortSetPinConfigId=36, PortSetPinConfigLabel=DO_LO
        NewPortSetPin0 (PortSetPin):
          PortSetPinIsSetPinConfig = true
          PortSetPinSymbolicName = P2_14
          PortSetPinDirection = PORT_PIN_OUT
          PortSetPinEnableIPControl = false
          PortSetPinMode = GPIO
          PortSetPinPullUpPullDown = NO_PULL
          PortSetPinEnableInputBuffer = false
          PortSetPinInputBufferType = INPUT_TYPE_SHMT1
          PortSetPinOpenDrain = PUSH_PULL
          PortSetPinDriveStrength = MEDIUM_DRIVER
          PortSetPinEnableOutputValueInversion = false
          PortSetPinEnableBiDirection = false
          PortSetPinLevelValue = PORT_PIN_LEVEL_LOW
          PortSetPinIsSetSafeStateConfig = false
          PortSetPinSafeStateTrigger = DISABLE
          PortSetPinEnableLVDS = false
          PortSetPinLVDSVoltage = VOLTAGE_5V
          PortSetPinLVDSOutPutType = ANSI_TIA_EIA_644_STANDARD
        NewPortSetPinNoiseFilter0 (PortSetPinNoiseFilter):
          PortSetPinIsSetNoiseFilterConfig = false
          PortSetPinNoiseFilterFunctionName = RLIN30RX
          PortSetPinEnableDigitalNoiseFilter = false
          PortSetPinNoiseFilterBypassMode = NOISE_FILTER_SIGNAL
          PortSetPinDetectionMode = DISABLE_EDGE_DETECTION
          PortSetPinNumberOfSamples = 2
          PortSetPinSamplingClockFrequency = SUPPLY_DEVIDED_BY_1
      NewPortSetPinConfigSet37: PortSetPinConfigId=37, PortSetPinConfigLabel=DO_LO
        NewPortSetPin0 (PortSetPin):
          PortSetPinIsSetPinConfig = true
          PortSetPinSymbolicName = P4_5
          PortSetPinDirection = PORT_PIN_OUT
          PortSetPinEnableIPControl = false
          PortSetPinMode = GPIO
          PortSetPinPullUpPullDown = NO_PULL
          PortSetPinEnableInputBuffer = false
          PortSetPinInputBufferType = INPUT_TYPE_SHMT1
          PortSetPinOpenDrain = PUSH_PULL
          PortSetPinDriveStrength = VERY_LOW_DRIVER
          PortSetPinEnableOutputValueInversion = false
          PortSetPinEnableBiDirection = false
          PortSetPinLevelValue = PORT_PIN_LEVEL_LOW
          PortSetPinIsSetSafeStateConfig = false
          PortSetPinSafeStateTrigger = DISABLE
          PortSetPinEnableLVDS = false
          PortSetPinLVDSVoltage = VOLTAGE_5V
          PortSetPinLVDSOutPutType = ANSI_TIA_EIA_644_STANDARD
        NewPortSetPinNoiseFilter0 (PortSetPinNoiseFilter):
          PortSetPinIsSetNoiseFilterConfig = false
          PortSetPinNoiseFilterFunctionName = RLIN30RX
          PortSetPinEnableDigitalNoiseFilter = false
          PortSetPinNoiseFilterBypassMode = NOISE_FILTER_SIGNAL
          PortSetPinDetectionMode = DISABLE_EDGE_DETECTION
          PortSetPinNumberOfSamples = 2
          PortSetPinSamplingClockFrequency = SUPPLY_DEVIDED_BY_1
      NewPortSetPinConfigSet38: PortSetPinConfigId=38, PortSetPinConfigLabel=DO_LO
        NewPortSetPin0 (PortSetPin):
          PortSetPinIsSetPinConfig = true
          PortSetPinSymbolicName = P4_6
          PortSetPinDirection = PORT_PIN_OUT
          PortSetPinEnableIPControl = false
          PortSetPinMode = GPIO
          PortSetPinPullUpPullDown = NO_PULL
          PortSetPinEnableInputBuffer = false
          PortSetPinInputBufferType = INPUT_TYPE_SHMT1
          PortSetPinOpenDrain = PUSH_PULL
          PortSetPinDriveStrength = VERY_LOW_DRIVER
          PortSetPinEnableOutputValueInversion = false
          PortSetPinEnableBiDirection = false
          PortSetPinLevelValue = PORT_PIN_LEVEL_LOW
          PortSetPinIsSetSafeStateConfig = false
          PortSetPinSafeStateTrigger = DISABLE
          PortSetPinEnableLVDS = false
          PortSetPinLVDSVoltage = VOLTAGE_5V
          PortSetPinLVDSOutPutType = ANSI_TIA_EIA_644_STANDARD
        NewPortSetPinNoiseFilter0 (PortSetPinNoiseFilter):
          PortSetPinIsSetNoiseFilterConfig = false
          PortSetPinNoiseFilterFunctionName = RLIN30RX
          PortSetPinEnableDigitalNoiseFilter = false
          PortSetPinNoiseFilterBypassMode = NOISE_FILTER_SIGNAL
          PortSetPinDetectionMode = DISABLE_EDGE_DETECTION
          PortSetPinNumberOfSamples = 2
          PortSetPinSamplingClockFrequency = SUPPLY_DEVIDED_BY_1
      NewPortSetPinConfigSet39: PortSetPinConfigId=39, PortSetPinConfigLabel=DI
        NewPortSetPin0 (PortSetPin):
          PortSetPinIsSetPinConfig = true
          PortSetPinSymbolicName = P4_7
          PortSetPinDirection = PORT_PIN_IN
          PortSetPinEnableIPControl = false
          PortSetPinMode = GPIO
          PortSetPinPullUpPullDown = PULL_DOWN
          PortSetPinEnableInputBuffer = true
          PortSetPinInputBufferType = INPUT_TYPE_SHMT1
          PortSetPinOpenDrain = PUSH_PULL
          PortSetPinDriveStrength = VERY_LOW_DRIVER
          PortSetPinEnableOutputValueInversion = false
          PortSetPinEnableBiDirection = false
          PortSetPinLevelValue = PORT_PIN_LEVEL_LOW
          PortSetPinIsSetSafeStateConfig = false
          PortSetPinSafeStateTrigger = DISABLE
          PortSetPinEnableLVDS = false
          PortSetPinLVDSVoltage = VOLTAGE_5V
          PortSetPinLVDSOutPutType = ANSI_TIA_EIA_644_STANDARD
        NewPortSetPinNoiseFilter0 (PortSetPinNoiseFilter):
          PortSetPinIsSetNoiseFilterConfig = false
          PortSetPinNoiseFilterFunctionName = RLIN30RX
          PortSetPinEnableDigitalNoiseFilter = false
          PortSetPinNoiseFilterBypassMode = NOISE_FILTER_SIGNAL
          PortSetPinDetectionMode = DISABLE_EDGE_DETECTION
          PortSetPinNumberOfSamples = 2
          PortSetPinSamplingClockFrequency = SUPPLY_DEVIDED_BY_1
      NewPortSetPinConfigSet40: PortSetPinConfigId=40, PortSetPinConfigLabel=DI
        NewPortSetPin0 (PortSetPin):
          PortSetPinIsSetPinConfig = true
          PortSetPinSymbolicName = P4_10
          PortSetPinDirection = PORT_PIN_IN
          PortSetPinEnableIPControl = false
          PortSetPinMode = GPIO
          PortSetPinPullUpPullDown = PULL_DOWN
          PortSetPinEnableInputBuffer = true
          PortSetPinInputBufferType = INPUT_TYPE_SHMT1
          PortSetPinOpenDrain = PUSH_PULL
          PortSetPinDriveStrength = VERY_LOW_DRIVER
          PortSetPinEnableOutputValueInversion = false
          PortSetPinEnableBiDirection = false
          PortSetPinLevelValue = PORT_PIN_LEVEL_LOW
          PortSetPinIsSetSafeStateConfig = false
          PortSetPinSafeStateTrigger = DISABLE
          PortSetPinEnableLVDS = false
          PortSetPinLVDSVoltage = VOLTAGE_5V
          PortSetPinLVDSOutPutType = ANSI_TIA_EIA_644_STANDARD
        NewPortSetPinNoiseFilter0 (PortSetPinNoiseFilter):
          PortSetPinIsSetNoiseFilterConfig = false
          PortSetPinNoiseFilterFunctionName = RLIN30RX
          PortSetPinEnableDigitalNoiseFilter = false
          PortSetPinNoiseFilterBypassMode = NOISE_FILTER_SIGNAL
          PortSetPinDetectionMode = DISABLE_EDGE_DETECTION
          PortSetPinNumberOfSamples = 2
          PortSetPinSamplingClockFrequency = SUPPLY_DEVIDED_BY_1
      NewPortSetPinConfigSet41: PortSetPinConfigId=41, PortSetPinConfigLabel=DO_LO
        NewPortSetPin0 (PortSetPin):
          PortSetPinIsSetPinConfig = true
          PortSetPinSymbolicName = P20_1
          PortSetPinDirection = PORT_PIN_OUT
          PortSetPinEnableIPControl = false
          PortSetPinMode = GPIO
          PortSetPinPullUpPullDown = NO_PULL
          PortSetPinEnableInputBuffer = false
          PortSetPinInputBufferType = INPUT_TYPE_SHMT1
          PortSetPinOpenDrain = PUSH_PULL
          PortSetPinDriveStrength = VERY_LOW_DRIVER
          PortSetPinEnableOutputValueInversion = false
          PortSetPinEnableBiDirection = false
          PortSetPinLevelValue = PORT_PIN_LEVEL_LOW
          PortSetPinIsSetSafeStateConfig = false
          PortSetPinSafeStateTrigger = DISABLE
          PortSetPinEnableLVDS = false
          PortSetPinLVDSVoltage = VOLTAGE_5V
          PortSetPinLVDSOutPutType = ANSI_TIA_EIA_644_STANDARD
        NewPortSetPinNoiseFilter0 (PortSetPinNoiseFilter):
          PortSetPinIsSetNoiseFilterConfig = false
          PortSetPinNoiseFilterFunctionName = RLIN30RX
          PortSetPinEnableDigitalNoiseFilter = false
          PortSetPinNoiseFilterBypassMode = NOISE_FILTER_SIGNAL
          PortSetPinDetectionMode = DISABLE_EDGE_DETECTION
          PortSetPinNumberOfSamples = 2
          PortSetPinSamplingClockFrequency = SUPPLY_DEVIDED_BY_1
      NewPortSetPinConfigSet42: PortSetPinConfigId=42, PortSetPinConfigLabel=DO_LO
        NewPortSetPin0 (PortSetPin):
          PortSetPinIsSetPinConfig = true
          PortSetPinSymbolicName = P20_2
          PortSetPinDirection = PORT_PIN_OUT
          PortSetPinEnableIPControl = false
          PortSetPinMode = GPIO
          PortSetPinPullUpPullDown = NO_PULL
          PortSetPinEnableInputBuffer = false
          PortSetPinInputBufferType = INPUT_TYPE_SHMT1
          PortSetPinOpenDrain = PUSH_PULL
          PortSetPinDriveStrength = VERY_LOW_DRIVER
          PortSetPinEnableOutputValueInversion = false
          PortSetPinEnableBiDirection = false
          PortSetPinLevelValue = PORT_PIN_LEVEL_LOW
          PortSetPinIsSetSafeStateConfig = false
          PortSetPinSafeStateTrigger = DISABLE
          PortSetPinEnableLVDS = false
          PortSetPinLVDSVoltage = VOLTAGE_5V
          PortSetPinLVDSOutPutType = ANSI_TIA_EIA_644_STANDARD
        NewPortSetPinNoiseFilter0 (PortSetPinNoiseFilter):
          PortSetPinIsSetNoiseFilterConfig = false
          PortSetPinNoiseFilterFunctionName = RLIN30RX
          PortSetPinEnableDigitalNoiseFilter = false
          PortSetPinNoiseFilterBypassMode = NOISE_FILTER_SIGNAL
          PortSetPinDetectionMode = DISABLE_EDGE_DETECTION
          PortSetPinNumberOfSamples = 2
          PortSetPinSamplingClockFrequency = SUPPLY_DEVIDED_BY_1
      NewPortSetPinConfigSet43: PortSetPinConfigId=43, PortSetPinConfigLabel=DI
        NewPortSetPin0 (PortSetPin):
          PortSetPinIsSetPinConfig = true
          PortSetPinSymbolicName = P21_0
          PortSetPinDirection = PORT_PIN_IN
          PortSetPinEnableIPControl = false
          PortSetPinMode = GPIO
          PortSetPinPullUpPullDown = PULL_DOWN
          PortSetPinEnableInputBuffer = true
          PortSetPinInputBufferType = INPUT_TYPE_SHMT1
          PortSetPinOpenDrain = PUSH_PULL
          PortSetPinDriveStrength = VERY_LOW_DRIVER
          PortSetPinEnableOutputValueInversion = false
          PortSetPinEnableBiDirection = false
          PortSetPinLevelValue = PORT_PIN_LEVEL_LOW
          PortSetPinIsSetSafeStateConfig = false
          PortSetPinSafeStateTrigger = DISABLE
          PortSetPinEnableLVDS = false
          PortSetPinLVDSVoltage = VOLTAGE_5V
          PortSetPinLVDSOutPutType = ANSI_TIA_EIA_644_STANDARD
        NewPortSetPinNoiseFilter0 (PortSetPinNoiseFilter):
          PortSetPinIsSetNoiseFilterConfig = false
          PortSetPinNoiseFilterFunctionName = RLIN30RX
          PortSetPinEnableDigitalNoiseFilter = false
          PortSetPinNoiseFilterBypassMode = NOISE_FILTER_SIGNAL
          PortSetPinDetectionMode = DISABLE_EDGE_DETECTION
          PortSetPinNumberOfSamples = 2
          PortSetPinSamplingClockFrequency = SUPPLY_DEVIDED_BY_1
      NewPortSetPinConfigSet44: PortSetPinConfigId=44, PortSetPinConfigLabel=DI
        NewPortSetPin0 (PortSetPin):
          PortSetPinIsSetPinConfig = true
          PortSetPinSymbolicName = P21_1
          PortSetPinDirection = PORT_PIN_IN
          PortSetPinEnableIPControl = false
          PortSetPinMode = GPIO
          PortSetPinPullUpPullDown = PULL_DOWN
          PortSetPinEnableInputBuffer = true
          PortSetPinInputBufferType = INPUT_TYPE_SHMT1
          PortSetPinOpenDrain = PUSH_PULL
          PortSetPinDriveStrength = VERY_LOW_DRIVER
          PortSetPinEnableOutputValueInversion = false
          PortSetPinEnableBiDirection = false
          PortSetPinLevelValue = PORT_PIN_LEVEL_LOW
          PortSetPinIsSetSafeStateConfig = false
          PortSetPinSafeStateTrigger = DISABLE
          PortSetPinEnableLVDS = false
          PortSetPinLVDSVoltage = VOLTAGE_5V
          PortSetPinLVDSOutPutType = ANSI_TIA_EIA_644_STANDARD
        NewPortSetPinNoiseFilter0 (PortSetPinNoiseFilter):
          PortSetPinIsSetNoiseFilterConfig = false
          PortSetPinNoiseFilterFunctionName = RLIN30RX
          PortSetPinEnableDigitalNoiseFilter = false
          PortSetPinNoiseFilterBypassMode = NOISE_FILTER_SIGNAL
          PortSetPinDetectionMode = DISABLE_EDGE_DETECTION
          PortSetPinNumberOfSamples = 2
          PortSetPinSamplingClockFrequency = SUPPLY_DEVIDED_BY_1
      NewPortSetPinConfigSet45: PortSetPinConfigId=45, PortSetPinConfigLabel=DO_LO
        NewPortSetPin0 (PortSetPin):
          PortSetPinIsSetPinConfig = true
          PortSetPinSymbolicName = P21_2
          PortSetPinDirection = PORT_PIN_OUT
          PortSetPinEnableIPControl = false
          PortSetPinMode = GPIO
          PortSetPinPullUpPullDown = NO_PULL
          PortSetPinEnableInputBuffer = false
          PortSetPinInputBufferType = INPUT_TYPE_SHMT1
          PortSetPinOpenDrain = PUSH_PULL
          PortSetPinDriveStrength = VERY_LOW_DRIVER
          PortSetPinEnableOutputValueInversion = false
          PortSetPinEnableBiDirection = false
          PortSetPinLevelValue = PORT_PIN_LEVEL_LOW
          PortSetPinIsSetSafeStateConfig = false
          PortSetPinSafeStateTrigger = DISABLE
          PortSetPinEnableLVDS = false
          PortSetPinLVDSVoltage = VOLTAGE_5V
          PortSetPinLVDSOutPutType = ANSI_TIA_EIA_644_STANDARD
        NewPortSetPinNoiseFilter0 (PortSetPinNoiseFilter):
          PortSetPinIsSetNoiseFilterConfig = false
          PortSetPinNoiseFilterFunctionName = RLIN30RX
          PortSetPinEnableDigitalNoiseFilter = false
          PortSetPinNoiseFilterBypassMode = NOISE_FILTER_SIGNAL
          PortSetPinDetectionMode = DISABLE_EDGE_DETECTION
          PortSetPinNumberOfSamples = 2
          PortSetPinSamplingClockFrequency = SUPPLY_DEVIDED_BY_1
      NewPortSetPinConfigSet46: PortSetPinConfigId=46, PortSetPinConfigLabel=DI
        NewPortSetPin0 (PortSetPin):
          PortSetPinIsSetPinConfig = true
          PortSetPinSymbolicName = P24_10
          PortSetPinDirection = PORT_PIN_IN
          PortSetPinEnableIPControl = false
          PortSetPinMode = GPIO
          PortSetPinPullUpPullDown = PULL_DOWN
          PortSetPinEnableInputBuffer = true
          PortSetPinInputBufferType = INPUT_TYPE_SHMT1
          PortSetPinOpenDrain = PUSH_PULL
          PortSetPinDriveStrength = VERY_LOW_DRIVER
          PortSetPinEnableOutputValueInversion = false
          PortSetPinEnableBiDirection = false
          PortSetPinLevelValue = PORT_PIN_LEVEL_LOW
          PortSetPinIsSetSafeStateConfig = false
          PortSetPinSafeStateTrigger = DISABLE
          PortSetPinEnableLVDS = false
          PortSetPinLVDSVoltage = VOLTAGE_5V
          PortSetPinLVDSOutPutType = ANSI_TIA_EIA_644_STANDARD
        NewPortSetPinNoiseFilter0 (PortSetPinNoiseFilter):
          PortSetPinIsSetNoiseFilterConfig = false
          PortSetPinNoiseFilterFunctionName = RLIN30RX
          PortSetPinEnableDigitalNoiseFilter = false
          PortSetPinNoiseFilterBypassMode = NOISE_FILTER_SIGNAL
          PortSetPinDetectionMode = DISABLE_EDGE_DETECTION
          PortSetPinNumberOfSamples = 2
          PortSetPinSamplingClockFrequency = SUPPLY_DEVIDED_BY_1
      NewPortSetPinConfigSet47: PortSetPinConfigId=47, PortSetPinConfigLabel=DI
        NewPortSetPin0 (PortSetPin):
          PortSetPinIsSetPinConfig = true
          PortSetPinSymbolicName = P24_12
          PortSetPinDirection = PORT_PIN_IN
          PortSetPinEnableIPControl = false
          PortSetPinMode = GPIO
          PortSetPinPullUpPullDown = PULL_DOWN
          PortSetPinEnableInputBuffer = true
          PortSetPinInputBufferType = INPUT_TYPE_SHMT1
          PortSetPinOpenDrain = PUSH_PULL
          PortSetPinDriveStrength = VERY_LOW_DRIVER
          PortSetPinEnableOutputValueInversion = false
          PortSetPinEnableBiDirection = false
          PortSetPinLevelValue = PORT_PIN_LEVEL_LOW
          PortSetPinIsSetSafeStateConfig = false
          PortSetPinSafeStateTrigger = DISABLE
          PortSetPinEnableLVDS = false
          PortSetPinLVDSVoltage = VOLTAGE_5V
          PortSetPinLVDSOutPutType = ANSI_TIA_EIA_644_STANDARD
        NewPortSetPinNoiseFilter0 (PortSetPinNoiseFilter):
          PortSetPinIsSetNoiseFilterConfig = false
          PortSetPinNoiseFilterFunctionName = RLIN30RX
          PortSetPinEnableDigitalNoiseFilter = false
          PortSetPinNoiseFilterBypassMode = NOISE_FILTER_SIGNAL
          PortSetPinDetectionMode = DISABLE_EDGE_DETECTION
          PortSetPinNumberOfSamples = 2
          PortSetPinSamplingClockFrequency = SUPPLY_DEVIDED_BY_1
      NewPortSetPinConfigSet48: PortSetPinConfigId=48, PortSetPinConfigLabel=DO_LO
        NewPortSetPin0 (PortSetPin):
          PortSetPinIsSetPinConfig = true
          PortSetPinSymbolicName = P24_13
          PortSetPinDirection = PORT_PIN_OUT
          PortSetPinEnableIPControl = false
          PortSetPinMode = GPIO
          PortSetPinPullUpPullDown = NO_PULL
          PortSetPinEnableInputBuffer = false
          PortSetPinInputBufferType = INPUT_TYPE_SHMT1
          PortSetPinOpenDrain = PUSH_PULL
          PortSetPinDriveStrength = VERY_LOW_DRIVER
          PortSetPinEnableOutputValueInversion = false
          PortSetPinEnableBiDirection = false
          PortSetPinLevelValue = PORT_PIN_LEVEL_LOW
          PortSetPinIsSetSafeStateConfig = false
          PortSetPinSafeStateTrigger = DISABLE
          PortSetPinEnableLVDS = false
          PortSetPinLVDSVoltage = VOLTAGE_5V
          PortSetPinLVDSOutPutType = ANSI_TIA_EIA_644_STANDARD
        NewPortSetPinNoiseFilter0 (PortSetPinNoiseFilter):
          PortSetPinIsSetNoiseFilterConfig = false
          PortSetPinNoiseFilterFunctionName = RLIN30RX
          PortSetPinEnableDigitalNoiseFilter = false
          PortSetPinNoiseFilterBypassMode = NOISE_FILTER_SIGNAL
          PortSetPinDetectionMode = DISABLE_EDGE_DETECTION
          PortSetPinNumberOfSamples = 2
          PortSetPinSamplingClockFrequency = SUPPLY_DEVIDED_BY_1
      NewPortSetPinConfigSet14: PortSetPinConfigId=14, PortSetPinConfigLabel=DO_LO
        NewPortSetPin0 (PortSetPin):
          PortSetPinIsSetPinConfig = true
          PortSetPinSymbolicName = P2_6
          PortSetPinDirection = PORT_PIN_OUT
          PortSetPinEnableIPControl = false
          PortSetPinMode = GPIO
          PortSetPinPullUpPullDown = NO_PULL
          PortSetPinEnableInputBuffer = false
          PortSetPinInputBufferType = INPUT_TYPE_SHMT1
          PortSetPinOpenDrain = PUSH_PULL
          PortSetPinDriveStrength = VERY_LOW_DRIVER
          PortSetPinEnableOutputValueInversion = false
          PortSetPinEnableBiDirection = false
          PortSetPinLevelValue = PORT_PIN_LEVEL_LOW
          PortSetPinIsSetSafeStateConfig = false
          PortSetPinSafeStateTrigger = DISABLE
          PortSetPinEnableLVDS = false
          PortSetPinLVDSVoltage = VOLTAGE_5V
          PortSetPinLVDSOutPutType = ANSI_TIA_EIA_644_STANDARD
        NewPortSetPinNoiseFilter0 (PortSetPinNoiseFilter):
          PortSetPinIsSetNoiseFilterConfig = false
          PortSetPinNoiseFilterFunctionName = RLIN30RX
          PortSetPinEnableDigitalNoiseFilter = false
          PortSetPinNoiseFilterBypassMode = NOISE_FILTER_SIGNAL
          PortSetPinDetectionMode = DISABLE_EDGE_DETECTION
          PortSetPinNumberOfSamples = 2
          PortSetPinSamplingClockFrequency = SUPPLY_DEVIDED_BY_1
      NewPortSetPinConfigSet15: PortSetPinConfigId=15, PortSetPinConfigLabel=DO_LO
        NewPortSetPin0 (PortSetPin):
          PortSetPinIsSetPinConfig = true
          PortSetPinSymbolicName = P2_8
          PortSetPinDirection = PORT_PIN_OUT
          PortSetPinEnableIPControl = false
          PortSetPinMode = GPIO
          PortSetPinPullUpPullDown = NO_PULL
          PortSetPinEnableInputBuffer = false
          PortSetPinInputBufferType = INPUT_TYPE_SHMT1
          PortSetPinOpenDrain = PUSH_PULL
          PortSetPinDriveStrength = VERY_LOW_DRIVER
          PortSetPinEnableOutputValueInversion = false
          PortSetPinEnableBiDirection = false
          PortSetPinLevelValue = PORT_PIN_LEVEL_LOW
          PortSetPinIsSetSafeStateConfig = false
          PortSetPinSafeStateTrigger = DISABLE
          PortSetPinEnableLVDS = false
          PortSetPinLVDSVoltage = VOLTAGE_5V
          PortSetPinLVDSOutPutType = ANSI_TIA_EIA_644_STANDARD
        NewPortSetPinNoiseFilter0 (PortSetPinNoiseFilter):
          PortSetPinIsSetNoiseFilterConfig = false
          PortSetPinNoiseFilterFunctionName = RLIN30RX
          PortSetPinEnableDigitalNoiseFilter = false
          PortSetPinNoiseFilterBypassMode = NOISE_FILTER_SIGNAL
          PortSetPinDetectionMode = DISABLE_EDGE_DETECTION
          PortSetPinNumberOfSamples = 2
          PortSetPinSamplingClockFrequency = SUPPLY_DEVIDED_BY_1
      NewPortSetPinConfigSet16: PortSetPinConfigId=16, PortSetPinConfigLabel=DO_LO
        NewPortSetPin0 (PortSetPin):
          PortSetPinIsSetPinConfig = true
          PortSetPinSymbolicName = P21_3
          PortSetPinDirection = PORT_PIN_OUT
          PortSetPinEnableIPControl = false
          PortSetPinMode = GPIO
          PortSetPinPullUpPullDown = NO_PULL
          PortSetPinEnableInputBuffer = false
          PortSetPinInputBufferType = INPUT_TYPE_SHMT1
          PortSetPinOpenDrain = PUSH_PULL
          PortSetPinDriveStrength = VERY_LOW_DRIVER
          PortSetPinEnableOutputValueInversion = false
          PortSetPinEnableBiDirection = false
          PortSetPinLevelValue = PORT_PIN_LEVEL_LOW
          PortSetPinIsSetSafeStateConfig = false
          PortSetPinSafeStateTrigger = DISABLE
          PortSetPinEnableLVDS = false
          PortSetPinLVDSVoltage = VOLTAGE_5V
          PortSetPinLVDSOutPutType = ANSI_TIA_EIA_644_STANDARD
        NewPortSetPinNoiseFilter0 (PortSetPinNoiseFilter):
          PortSetPinIsSetNoiseFilterConfig = false
          PortSetPinNoiseFilterFunctionName = RLIN30RX
          PortSetPinEnableDigitalNoiseFilter = false
          PortSetPinNoiseFilterBypassMode = NOISE_FILTER_SIGNAL
          PortSetPinDetectionMode = DISABLE_EDGE_DETECTION
          PortSetPinNumberOfSamples = 2
          PortSetPinSamplingClockFrequency = SUPPLY_DEVIDED_BY_1
