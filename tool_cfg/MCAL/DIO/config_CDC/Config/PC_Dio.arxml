AUTOSAR XML (schema 00047)
package /Dio
  module config Dio
    NewDioGeneral0 (DioGeneral): DioFlipChannelApi=true, DioPackage=DIO_U2A16_373, DioProtectionControl=false
    NewDioConfig0 (DioConfig)
      NewDioPort0 (DioPort)
