AUTOSAR XML (schema 00047)
package /Dio
  module config Dio
    NewDioGeneral0 (DioGeneral): DioFlipChannelApi=true, DioPackage=DIO_U2A16_373
    NewDioConfig0 (DioConfig)
      NewDioPort0 (DioPort)
        NewDioChannelGroup0 (DioChannelGroup): DioPortId=DIO_ID_PORT0, DioChannelGroupIdentification=DIO_CFG_CH_GRP_ARRAY, DioPortMask=DIO_CH_GRP_MASK_16_0, DioPortOffset=0
