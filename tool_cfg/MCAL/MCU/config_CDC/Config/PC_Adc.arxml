AUTOSAR XML (schema 00047)
package /Adc
  module config Adc
    NewAdcConfigSet0 (AdcConfigSet)
      3 x AdcHwUnit, all with AdcSuspendMethod=, AdcResultFormat=, AdcResultAlign=, AdcReSolution=, AdcSamplingPeriod=, AdcBufferAmp=false:
        NewAdcHwUnit{0..2}
      NewAdcGroup0 (AdcGroup):
        AdcGroupConversionMode = 
        AdcGroupId = (unset)
        AdcGroupTriggSrc = 
        AdcHwTrigSignal = PIC2_EDG_DIRECT_RISING
        AdcUseTAUD{0..3} = false
        AdcUseTSG30TG0 = false
        AdcUseTSG30TG1 = false
        AdcUseE3S0AD = false
        AdcUseE3S0AD1 = false
        AdcUseTAUD2Ch7 = false
        AdcUseTAUD2Ch15 = false
        AdcUseTAUJ{0..3}Ch3 = false
        AdcHwUnitId = 
        AdcScanGroupId = 
        AdcDmaId = 
        AdcUseDmaHalfInt = false
        AdcAccessMode = 
        AdcStreamingNum = (unset)
        NewAdcGroupDefinition0 (AdcGroupDefinition): AdcConvChannel=
      4 x AdcTAUD:
        NewAdcTAUD0
          5 x AdcTAUDScanGroup:
            NewAdcTAUDScanGroup{0..4}
        NewAdcTAUD1
          5 x AdcTAUDScanGroup:
            NewAdcTAUDScanGroup{0..4}
        NewAdcTAUD2
          5 x AdcTAUDScanGroup:
            NewAdcTAUDScanGroup{0..4}
        NewAdcTAUD3
          5 x AdcTAUDScanGroup:
            NewAdcTAUDScanGroup{0..4}
    NewAdcGeneral0 (AdcGeneral):
      AdcPackage = 
      AdcDeInitApi = false
      AdcEnableStartStopGroupApi = false
      AdcHwTriggerApi = false
      AdcReadGroupApi = false
      AdcDetReportRuntimeError = false
      AdcProcessTimeOut = (unset)
      AdcRegisterCheck = false
      AdcRegisterRefresh = false
