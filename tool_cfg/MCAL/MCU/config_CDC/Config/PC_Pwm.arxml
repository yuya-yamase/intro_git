AUTOSAR XML (schema 00047)
package /Pwm
  module config Pwm
    NewPwmChannelConfigSet0 (PwmChannelConfigSet)
    NewPwmConfigurationOfOptApiServices0 (PwmConfigurationOfOptApiServices): PwmDeInitApi=false, PwmGetOutputState=false, PwmSetDutyCycle=false, PwmSetOutputToIdle=false, PwmSetPeriodAndDuty=false
    NewPwmGeneral0 (PwmGeneral): PwmNotificationSupported=false, PwmMicon=, PwmRegisterCheck=false, PwmRegisterRefresh=false
