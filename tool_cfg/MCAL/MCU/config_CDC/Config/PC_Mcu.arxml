AUTOSAR XML (schema 00047)
package /Mcu
  module config Mcu
    NewMcuGeneralConfiguration0 (McuGeneralConfiguration):
      McuInitClock = true
      McuNoPll = false
      McuPerformResetApi = false
      McuResetReason = false
      McuPackage = MCU_U2A16_373
      McuRegisterCheck = false
      McuRegisterRefresh = false
    NewMcuModuleConfiguration0 (McuModuleConfiguration)
      NewMcuClockSettingConfig0 (McuClockSettingConfig)
        NewMcuClockConf0 (McuClockConf):
          McuClockSourceRLIN = MCU_CLK_RLIN_MOSC_1
          McuClockSourceRCAN = MCU_CLK_RCAN_MOSC_2
          McuClockSourceMSPI_A = MCU_CLK_MSPI_A_HSB_1
          McuClockSourceWDTBA_A = MCU_CLK_WDTBA_A_LSIOSC_1
          McuClockSourceTAUJ_A = MCU_CLK_ATAUJC_A_MOSC_1
          McuClockSourceRTCA_A = MCU_CLK_ARTCAC_A_MOSC_16
          McuClockSourceFOUT0 = MCU_CLK_FOUT0C_HSB_1
          McuClockDividerFOUT0 = 0
          McuClockSourceWDTBn_A = MCU_CLK_WDTC_A_HSIOSC_640
          McuClockSourceADCJn = MCU_CLK_ADCJ_LSB_1
          McuClockSourceADCJ2_A = MCU_CLK_AADCC_A_LSB_1
          McuClockDividerADCJ2 = MCU_CLKD_AADCC_1
          McuClockSourceFOUT1 = MCU_CLK_FOUT1C_HSB_1
          McuClockDividerFOUT1 = 0
          McuClockSourceModulationSSCG = false
          McuClockSourceModulationFrequencySSCG = MCU_CLK_SSCG_30
          McuClockSourceModulationDitheredRangeSSCG = MCU_CLK_SSCG_DITHERED_1
          McuClockSourceRLIN3 = MCU_CLK_RLIN3_HSBC_1
          McuClockSourceRLIN3_CH23 = MCU_CLK_RLIN3_CH23_HBUSC_1
          McuClockSourceCANFD_XIN = MCU_CLK_CANFD_XIN_MOSC_1
          McuClockSourceCANFD_C = MCU_CLK_CANFD_C_HSBC_1
          McuClockSourceMSPI_B = MCU_CLK_MSPI_B_MOSC_1
          McuClockSourceWDTBn_B = MCU_CLK_WDTC_B_HSIOSC_640
          McuClockSourceEXTCLK0 = MCU_CLK_EXTCLK0C_HSB_1
          McuClockDividerEXTCLK0 = 0
          McuClockSourceEXTCLK1 = MCU_CLK_EXTCLK1C_HSB_1
          McuClockDividerEXTCLK1 = 0
          McuClockSourceSWDT = MCU_CLK_SWDT_HSIOSC_20
          McuPerformClockMonitor = false
        NewMcuModuleStandbyConf0 (McuModuleStandbyConf)
          NewMcuModuleStandbyRSCFD0 (McuModuleStandbyRSCFD): McuModuleStandbyRSCFD0=CLOCK_SUPPLIED, McuModuleStandbyRSCFD1=CLOCK_SUPPLIED
          NewMcuModuleStandbyFLXA0 (McuModuleStandbyFLXA): McuModuleStandbyFLXA0=CLOCK_STOPPED, McuModuleStandbyFLXA1=CLOCK_STOPPED
          NewMcuModuleStandbyETNB0 (McuModuleStandbyETNB): McuModuleStandbyETNB0=CLOCK_STOPPED, McuModuleStandbyETNB1=CLOCK_STOPPED
          NewMcuModuleStandbyRSENT0 (McuModuleStandbyRSENT):
            McuModuleStandbyRSENT{0..29} = CLOCK_STOPPED
          NewMcuModuleStandbyMSPI0 (McuModuleStandbyMSPI):
            McuModuleStandbyMSPI0 = CLOCK_SUPPLIED
            McuModuleStandbyMSPI1 = CLOCK_STOPPED
            McuModuleStandbyMSPI{2..7} = CLOCK_SUPPLIED
            McuModuleStandbyMSPI8 = CLOCK_STOPPED
            McuModuleStandbyMSPI9 = CLOCK_STOPPED
          NewMcuModuleStandbyRLIN30 (McuModuleStandbyRLIN3):
            McuModuleStandbyRLIN{30..39} = CLOCK_SUPPLIED
            McuModuleStandbyRLIN{310..323} = CLOCK_SUPPLIED
          NewMcuModuleStandbyRIIC0 (McuModuleStandbyRIIC): McuModuleStandbyRIIC0=CLOCK_SUPPLIED, McuModuleStandbyRIIC1=CLOCK_SUPPLIED
          NewMcuModuleStandbyTAUD0 (McuModuleStandbyTAUD):
            McuModuleStandbyTAUD{0..2} = CLOCK_SUPPLIED
            McuModuleStandbyTAUD3 = CLOCK_STOPPED
          NewMcuModuleStandbyTAUJ_ISO0 (McuModuleStandbyTAUJ_ISO): McuModuleStandbyTAUJ_ISO0=CLOCK_SUPPLIED, McuModuleStandbyTAUJ_ISO1=CLOCK_SUPPLIED
          NewMcuModuleStandbyTAUJ_AWO0 (McuModuleStandbyTAUJ_AWO): McuModuleStandbyTAUJ_AWO2=CLOCK_SUPPLIED, McuModuleStandbyTAUJ_AWO3=CLOCK_SUPPLIED
          NewMcuModuleStandbyOSTM0 (McuModuleStandbyOSTM):
            McuModuleStandbyOSTM{0..9} = CLOCK_SUPPLIED
          NewMcuModuleStandbyRTCA0 (McuModuleStandbyRTCA): McuModuleStandbyRTCA0=CLOCK_STOPPED
          NewMcuModuleStandbyGTM0 (McuModuleStandbyGTM): McuModuleStandbyGTM0=CLOCK_STOPPED
          NewMcuModuleStandbyADCJ_ISO0 (McuModuleStandbyADCJ_ISO): McuModuleStandbyADCJ_ISO0=CLOCK_SUPPLIED, McuModuleStandbyADCJ_ISO1=CLOCK_SUPPLIED
          NewMcuModuleStandbyADCJ_AWO0 (McuModuleStandbyADCJ_AWO): McuModuleStandbyADCJ_AWO2=CLOCK_SUPPLIED
          NewMcuModuleStandbyCXPI0 (McuModuleStandbyCXPI): McuModuleStandbyCXPI0=CLOCK_STOPPED, McuModuleStandbyCXPI1=CLOCK_STOPPED, McuModuleStandbyCXPI2=CLOCK_STOPPED, McuModuleStandbyCXPI3=CLOCK_STOPPED
          NewMcuModuleStandbyMMCA0 (McuModuleStandbyMMCA): McuModuleStandbyMMCA=CLOCK_STOPPED
          NewMcuModuleStandbyENCA0 (McuModuleStandbyENCA): McuModuleStandbyENCA0=CLOCK_STOPPED, McuModuleStandbyENCA1=CLOCK_STOPPED
          NewMcuModuleStandbyPSI50 (McuModuleStandbyPSI5):
            McuModuleStandbyPSI{50..53} = CLOCK_STOPPED
            McuModuleStandbyPSI55 = CLOCK_STOPPED
          NewMcuModuleStandbyPSI5S0 (McuModuleStandbyPSI5S): McuModuleStandbyPSI5S0=CLOCK_STOPPED, McuModuleStandbyPSI5S1=CLOCK_STOPPED
          NewMcuModuleStandbyPWMD0 (McuModuleStandbyPWMD): McuModuleStandbyPWMD=CLOCK_STOPPED
          NewMcuModuleStandbyRHSIF0 (McuModuleStandbyRHSIF): McuModuleStandbyRHSIF0=CLOCK_STOPPED, McuModuleStandbyRHSIF1=CLOCK_STOPPED
          NewMcuModuleStandbySCI30 (McuModuleStandbySCI3): McuModuleStandbySCI30=CLOCK_STOPPED, McuModuleStandbySCI31=CLOCK_STOPPED, McuModuleStandbySCI32=CLOCK_STOPPED
          NewMcuModuleStandbyTAPA0 (McuModuleStandbyTAPA):
            McuModuleStandbyTAPA{0..5} = CLOCK_STOPPED
          NewMcuModuleStandbyTPBA0 (McuModuleStandbyTPBA): McuModuleStandbyTPBA0=CLOCK_STOPPED, McuModuleStandbyTPBA1=CLOCK_STOPPED
          NewMcuModuleStandbyTSG30 (McuModuleStandbyTSG3): McuModuleStandbyTSG30=CLOCK_STOPPED, McuModuleStandbyTSG31=CLOCK_STOPPED, McuModuleStandbyTSG32=CLOCK_STOPPED
          NewMcuModuleStandbySFMA0 (McuModuleStandbySFMA): McuModuleStandbySFMA0=CLOCK_STOPPED
          NewMcuModuleStandbyRHSB0 (McuModuleStandbyRHSB): McuModuleStandbyRHSB0=CLOCK_STOPPED, McuModuleStandbyRHSB1=CLOCK_STOPPED, McuModuleStandbyRHSB2=CLOCK_STOPPED, McuModuleStandbyRHSB3=CLOCK_STOPPED
          NewMcuModuleStandbyETN0 (McuModuleStandbyETN): McuModuleStandbyETN0=CLOCK_STOPPED, McuModuleStandbyETN1=CLOCK_STOPPED, McuModuleStandbyETN2=CLOCK_STOPPED
          NewMcuModuleStandbyHRPWM0 (McuModuleStandbyHRPWM): McuModuleStandbyHRPWM0=CLOCK_STOPPED
          NewMcuModuleStandbyADCK_ISO0 (McuModuleStandbyADCK_ISO):
            McuModuleStandbyADCK_ISO{0..7} = CLOCK_STOPPED
          NewMcuModuleStandbyDSADC_CADC0 (McuModuleStandbyDSADC_CADC):
            McuModuleStandbyDSADC_CADC{0..3} = CLOCK_SUPPLIED
          NewMcuModuleStandbyDFE0 (McuModuleStandbyDFE): McuModuleStandbyDFE0=CLOCK_STOPPED
          NewMcuModuleStandbyEMU0 (McuModuleStandbyEMU): McuModuleStandbyEMU0=CLOCK_STOPPED, McuModuleStandbyEMU1=CLOCK_STOPPED
          NewMcuModuleStandbyRDC0 (McuModuleStandbyRDC): McuModuleStandbyRDC0=CLOCK_STOPPED, McuModuleStandbyRDC1=CLOCK_STOPPED, McuModuleStandbyRDC2=CLOCK_STOPPED, McuModuleStandbyRDC3=CLOCK_STOPPED
          NewMcuModuleStandbyFCOMP0 (McuModuleStandbyFCOMP):
            McuModuleStandbyFCOMP{0..10} = CLOCK_STOPPED
          NewMcuModuleStandbyByStandbyRSCFD0 (McuModuleStandbyByStandbyRSCFD): McuModuleStandbyByStandbyModeRSCFD=CLOCK_STOPPED
          NewMcuModuleStandbyByStandbyRLIN30 (McuModuleStandbyByStandbyRLIN3): McuModuleStandbyByStandbyModeRLIN3=CLOCK_STOPPED
          NewMcuModuleStandbyByStandbyRTCA0 (McuModuleStandbyByStandbyRTCA): McuModuleStandbyByStandbyModeRTCA=CLOCK_STOPPED
          NewMcuModuleStandbyByStandbyTAUJ_AWO0 (McuModuleStandbyByStandbyTAUJ_AWO): McuModuleStandbyByStandbyModeTAUJ_AWO=CLOCK_SUPPLIED
          NewMcuModuleStandbyByStandbyWDTB_AWO0 (McuModuleStandbyByStandbyWDTB_AWO): McuModuleStandbyByStandbyModeWDTB_AWO=CLOCK_STOPPED
          NewMcuModuleStandbyByStandbyADCJ_AWO0 (McuModuleStandbyByStandbyADCJ_AWO): McuModuleStandbyByStandbyModeADCJ_AWO=CLOCK_STOPPED
          NewMcuModuleStandbyByStandbyMOSC0 (McuModuleStandbyByStandbyMOSC): McuModuleStandbyByStandbyModeMOSC=CLOCK_SUPPLIED
          NewMcuModuleStandbyByStandbyHSIOSC0 (McuModuleStandbyByStandbyHSIOSC): McuModuleStandbyByStandbyModeHSIOSC=CLOCK_STOPPED
      NewMcuClockMoniterConfig0 (McuClockMoniterConfig): McuClockMoniterBackupClock=false
        NewMcuClockMoniterControlConf0 (McuClockMoniterControlConf):
          McuClockMoniterControl{0..3} = false
          McuClockMoniterControl{5..9} = false
          McuClockMoniterControl{13..17} = false
        NewMcuClockMoniterLowerLimitConf0 (McuClockMoniterLowerLimitConf):
          McuClockMoniterLowerLimit{0..3} = 1
          McuClockMoniterLowerLimit{5..9} = 1
          McuClockMoniterLowerLimit{13..17} = 1
        NewMcuClockMoniterHigherLimitConf0 (McuClockMoniterHigherLimitConf):
          McuClockMoniterHigherLimit{0..3} = 1023
          McuClockMoniterHigherLimit{5..9} = 1023
          McuClockMoniterHigherLimit{13..17} = 1023
      NewMcuPowerSaveConfig0 (McuPowerSaveConfig):
        McuPowerSaveClockSourceFOUT0 = MCU_CLK_FOUT0C_MOSC_1
        McuPowerSaveClockDividerFOUT0 = 0
        McuPowerSaveClockSourceWDTBA_A = MCU_CLK_WDTBA_A_LSIOSC_1
        McuPowerSaveClockSourceTAUJ_A = MCU_CLK_ATAUJC_A_MOSC_1
        McuPowerSaveClockSourceARTCAC_A = MCU_CLK_ARTCAC_A_MOSC_16
        McuPowerSaveClockSourceWDTC_A = MCU_CLK_WDTC_A_HSIOSC_640
        McuPowerSaveClockSourceFOUT1 = MCU_CLK_FOUT1C_MOSC_1
        McuPowerSaveClockDividerFOUT1 = 0
        McuPowerSaveClockSourceADCJ2 = MCU_CLK_AADCC_A_MOSC_1
        McuPowerSaveClockDividerADCJ2 = MCU_CLKD_AADCC_1
        McuStabilizationTimeISOVDD = 4200
        McuUseSleepReadyCallout = false
        McuSleepReadyCallout = NULL_PTR
    NewMcuPublishedInformation0 (McuPublishedInformation)
      NewMcuResetReasonConf0 (McuResetReasonConf): McuResetReason=MCU_SYSTEM_RESET_2
