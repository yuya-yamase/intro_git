AUTOSAR XML (schema 00047)
package /Port
  module config Port
    NewPortGeneral0 (PortGeneral):
      PortDevErrorDetect = false
      PortSetPinDirectionApi = true
      PortSetPinModeApi = true
      PortVersionInfoApi = false
      PortRelIOBufHoldState = true
      PortRegisterCheck = false
      PortRegisterRefresh = false
      NewPortExclusionControl0 (PortExclusionControl): PortExclusionEnterApi=, PortExclusionExitApi=, PortExclusionInc=(unset)
    NewPortConfigSet0 (PortConfigSet)
      NewPortContainer0 (PortContainer): PortNumber=0, PortNumberOfPortPins=16
        NewPortPin0 (PortPin):
          PortPinId = 0
          PortIsSetPinConfig = true
          PortPinDirectionChangeable = false
          PortPinModeChangeable = false
          PortPinDirection = PORT_PIN_IN
          PortEnableIPControl = false
          PortPinInitialMode = GPIO
          PortPinMode = GPIO
          PortPinLevelValue = PORT_PIN_LEVEL_LOW
          PortPullUpPullDown = NO_PULL
          PortDriveStrength = VERY_LOW_DRIVER
          PortOpenDrainControl = PUSH_PULL
          PortInputBufferType = INPUT_TYPE_SHMT1
          PortEnableInputBuffer = false
          PortEnableOutputvalueInversion = false
          PortEnableBiDirectionMode = false
          PortIsSetSafeStateConfig = true
          PortSetSafeStateTrigger = DISABLE
      NewPortLVDS0 (PortLVDS):
        PortIsSetLVDSConfig = true
        PortLVDSGroup = (unset)
        PortLVDSCTRL0 = DISABLE
        PortLVDSCTRL1 = DISABLE
        PortLVDSCTRL{3..5} = DISABLE
        PortLVDSOutputType = ANSI_TIA_EIA_644_STANDARD
        PortLVDSVoltage = VOLTAGE_5V
      NewPortLVDS1 (PortLVDS):
        PortIsSetLVDSConfig = true
        PortLVDSGroup = (unset)
        PortLVDSCTRL0 = DISABLE
        PortLVDSCTRL1 = DISABLE
        PortLVDSCTRL{3..5} = DISABLE
        PortLVDSOutputType = ANSI_TIA_EIA_644_STANDARD
        PortLVDSVoltage = VOLTAGE_5V
      NewPortNoiseFilter0 (PortNoiseFilter):
        PortIsSetNoiseFilterConfig = true
        PortNoiseFilterFunctionName = (unset)
        PortEnableDigitalNoiseFilter = false
        PortNoiseFilterBypassMode = NOISE_FILTER_SIGNAL
        PortDetectionMode = DISABLE_EDGE_DETECTION
        PortNumberOfSamples = 2
        PortSamplingClockFrequency = SUPPLY_DEVIDED_BY_1
    NewPortSetPinConfigSet0 (PortSetPinConfigSet): PortSetPinConfigId=(unset)
      NewPortSetPin0 (PortSetPin):
        PortSetPinIsSetPinConfig = false
        PortSetPinSymbolicName = (unset)
        PortSetPinDirection = PORT_PIN_IN
        PortSetPinEnableIPControl = false
        PortSetPinMode = GPIO
        PortSetPinPullUpPullDown = NO_PULL
        PortSetPinEnableInputBuffer = false
        PortSetPinInputBufferType = INPUT_TYPE_SHMT1
        PortSetPinOpenDrain = PUSH_PULL
        PortSetPinDriveStrength = VERY_LOW_DRIVER
        PortSetPinEnableOutputValueInversion = false
        PortSetPinEnableBiDirection = false
        PortSetPinLevelValue = PORT_PIN_LEVEL_LOW
        PortSetPinIsSetSafeStateConfig = false
        PortSetPinSafeStateTrigger = DISABLE
        PortSetPinEnableLVDS = false
        PortSetPinLVDSVoltage = VOLTAGE_5V
      NewPortSetPinNoiseFilter0 (PortSetPinNoiseFilter):
        PortSetPinIsSetNoiseFilterConfig = false
        PortSetPinNoiseFilterFunctionName = (unset)
        PortSetPinEnableDigitalNoiseFilter = false
        PortSetPinNoiseFilterBypassMode = NOISE_FILTER_SIGNAL
        PortSetPinDetectionMode = DISABLE_EDGE_DETECTION
        PortSetPinNumberOfSamples = 2
        PortSetPinSamplingClockFrequency = SUPPLY_DEVIDED_BY_1
