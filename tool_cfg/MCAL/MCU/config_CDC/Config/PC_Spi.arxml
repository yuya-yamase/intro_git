AUTOSAR XML (schema 00047)
package /Spi
  module config Spi
    NewSpiGeneral0 (SpiGeneral): SpiPackage=(unset), SpiCancelApi=false, SpiHwStatusApi=false, SpiLevelDelivered=(unset), SpiRegisterCheck=false, SpiRegisterRefresh=false
    NewSpiDetEventParameterRefs0 (SpiDetEventParameterRefs): SPI_DET_REPORT_RUNTIMEERROR=false
    NewSpiDriver0 (SpiDriver): SpiMaxChannel=(unset), SpiMaxJob=(unset), SpiMaxSequence=(unset), SpiMaxJobInSequence=32, SpiMaxChannelInJob=(unset)
      NewSpiChannel0 (SpiChannel): SpiChannelId=(unset), SpiDataWidth=(unset), SpiDefaultData=(unset), SpiTransferStart=
      NewSpiSequence0 (SpiSequence): SpiJobAssignment=(unset), SpiJobAssignment=(unset)
      NewSpiJob0 (SpiJob): SpiJobId=(unset), SpiDeviceAssignment=(unset)
        NewSpiChannelList0 (SpiChannelList): SpiChannelAssignment=(unset)
      NewSpiPhysicalDevice0 (SpiPhysicalDevice): SpiHwUnit=(unset), SpiHwChannel=(unset)
      5 x SpiSequence:
        NewSpiSequence{1..5}: SpiJobAssignment=(unset), SpiJobAssignment=(unset)
      8 x SpiChannel, all with SpiChannelId=(unset), SpiDataWidth=(unset), SpiDefaultData=(unset), SpiTransferStart=:
        NewSpiChannel{1..8}
      6 x SpiJob, all with SpiJobId=(unset), SpiDeviceAssignment=(unset):
        NewSpiJob1: SpiJobRegisterCheckNotification=
          NewSpiChannelList0 (SpiChannelList): SpiChannelAssignment=(unset)
        NewSpiJob2
          NewSpiChannelList0 (SpiChannelList): SpiChannelAssignment=(unset)
        NewSpiJob3
          NewSpiChannelList0 (SpiChannelList): SpiChannelAssignment=(unset)
        NewSpiJob4: SpiJobRegisterCheckNotification=
          NewSpiChannelList0 (SpiChannelList): SpiChannelAssignment=(unset)
        NewSpiJob5
          NewSpiChannelList0 (SpiChannelList): SpiChannelAssignment=(unset)
        NewSpiJob6
          NewSpiChannelList0 (SpiChannelList): SpiChannelAssignment=(unset)
      3 x SpiExternalDevice, all with SpiCsPolarity=, SpiCsSelection=, SpiDataShiftEdge=, SpiEnableCs=true, SpiShiftClockIdleLevel=, SpiTimeClk2Cs=(unset), SpiHwUnitId=, SpiCommBrps=, SpiCommBrdv=, SpiCsHold=(unset), SpiCsIdle=(unset), SpiCsInda=(unset), SpiClockPolarity=, SPiCsLastFrameEnd=, SpiSoutFunction=, SpiCrcFunction=, SpiSamplingTiming=, SpiTxDMAResource=, SpiRxDMAResource=, SpiConsistencyCheck=false, SpiParityCheck=:
        NewSpiExternalDevice{0..2}
      NewSpiPhysicalDevice1 (SpiPhysicalDevice): SpiHwUnit=(unset), SpiHwChannel=(unset)
      NewSpiPhysicalDevice2 (SpiPhysicalDevice): SpiHwUnit=(unset), SpiHwChannel=(unset)
