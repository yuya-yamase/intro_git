AUTOSAR XML (schema 00047)
package /Wdg
  module config Wdg
    NewWdgGeneral0 (WdgGeneral): WdgPackage=, WdgRegisterCheck=false
    NewWdgSettingsConfig0 (WdgSettingsConfig): WdgCoreIdGetOwnDefinition=false
