AUTOSAR XML (schema 4-0-1)
package /ECUC
  module config Gpt
    NewGptChannelConfigSet0 (GptChannelConfigSet)
      NewGptChannelConfiguration0 (GptChannelConfiguration):
        GptChannelId = GPT_TAUJ0_CH0
        GptChannelMode = GPT_CH_MODE_CONTINUOUS
        GptEnableWakeup = false
        GptChannelPrescaler = GPT_PRESCALER_TYPE_CK0
        GptWakeupType = 0
    NewGptConfigurationOfOptApiServices0 (GptConfigurationOfOptApiServices): GptDeinitApi=true, GptEnableDisableNotificationApi=true, GptTimeElapsedApi=true, GptTimeRemainingApi=true, GptWakeupFunctionalityApi=true
    NewGptWakeupConfiguration0 (GptWakeupConfiguration): GptReportWakeupSource=true
    NewGptOptionalInterfaces0 (GptOptionalInterfaces): GptCfgDetReportRuntimeerror=false, GptCfgEcumWakeupvalidation=false
    NewGptGeneral0 (GptGeneral): GptMicon=(unset), GptProcessTimeOutFast=4294967294, GptProcessTimeOutNormal=4294967294, GptRegisterCheck=false, GptRegisterRefresh=false
    NewGptPrescaler0 (GptPrescaler): GptPrescalerId=(unset), GptPrescalerValue=(unset)
