AUTOSAR XML (schema 00047)
package /Dma
  module config Dma
    NewDmaGeneral0 (DmaGeneral): DmaMicon=(unset), DmaRegisterCheck=false, DmaRegisterRefresh=false
    NewDmaChannelConfigSet0 (DmaChannelConfigSet)
