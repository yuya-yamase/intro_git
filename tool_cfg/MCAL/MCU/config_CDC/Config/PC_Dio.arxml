AUTOSAR XML (schema 00047)
package /Dio
  module config Dio
    NewDioGeneral0 (DioGeneral): DioFlipChannelApi=true, DioPackage=(unset)
    NewDioConfig0 (DioConfig)
      NewDioPort0 (DioPort)
