AUTOSAR XML (schema 00047)
package /Icu
  module config Icu
    NewIcuOptionalApis0 (IcuOptionalApis):
      IcuDeInitApi = true
      IcuDisableWakeupApi = true
      IcuEdgeCountApi = true
      IcuEdgeDetectApi = true
      IcuEnableWakeupApi = true
      IcuGetDutyCycleValuesApi = true
      IcuGetInputStateApi = true
      IcuGetTimeElapsedApi = true
      IcuSetModeApi = true
      IcuSignalMeasurementApi = true
      IcuTimestampApi = true
      IcuWakeupFunctionalityApi = true
    NewIcuConfigSet0 (IcuConfigSet)
      NewIcuPrescaler0 (IcuPrescaler): IcuPrescalerId=(unset), IcuPrescalerValue=(unset)
    NewIcuGeneral0 (IcuGeneral): IcuPackage=, IcuDetReportRunTimeError=false, IcuWakeupValidation=false, IcuRegisterCheck=false, IcuRegisterRefresh=false
