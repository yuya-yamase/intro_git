AUTOSAR XML (schema 00047)
package /Dma
  module config Dma
    NewDmaGeneral0 (DmaGeneral): DmaMicon=DMA_U2A, DmaRegisterCheck=false, DmaRegisterRefresh=false, DmaGlobalRegisterControl=true, DmaDma0Access=true, DmaDma1Access=true
      NewDmaExclusionControl0 (DmaExclusionControl): DmaExclusionEnterApi=SuspendAllInterrupts(), DmaExclusionExitApi=ResumeAllInterrupts(), DmaExclusionInc=Os.h
    NewDmaChannelConfigSet0 (DmaChannelConfigSet)
      7 x DmaChannelConfiguration, all with DmaType=DMA_DMAC0, DmaPrilevel=DMA_PRIORITY_NOUSE:
        NewDmaChannelConfiguration0: DmaReq=PIL_DMAC_GR0_DMAMSPI16, DmaHwch=PIL_DMAC_CH0
        NewDmaChannelConfiguration1: DmaReq=PIL_DMAC_GR0_DMAMSPI17, DmaHwch=PIL_DMAC_CH1
        NewDmaChannelConfiguration2: DmaReq=PIL_DMAC_GR0_DMAMSPI20, DmaHwch=PIL_DMAC_CH2
        NewDmaChannelConfiguration3: DmaReq=PIL_DMAC_GR0_DMAMSPI21, DmaHwch=PIL_DMAC_CH3
        NewDmaChannelConfiguration4: DmaReq=PIL_DMAC_GR0_DMAMSPI24, DmaHwch=PIL_DMAC_CH4
        NewDmaChannelConfiguration5: DmaReq=PIL_DMAC_GR0_DMAMSPI25, DmaHwch=PIL_DMAC_CH5
        NewDmaChannelConfiguration6: DmaReq=PIL_DMAC_GR0_INTRLIN311UR1, DmaHwch=PIL_DMAC_CH10
