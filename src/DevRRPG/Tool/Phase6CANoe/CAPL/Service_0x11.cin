/*@!Encoding:932*/

/* ************************************************************** */
/*                      includes                                  */
/* ************************************************************** */
includes
{
}

/* ************************************************************** */
/*                      variables                                 */
/* ************************************************************** */
variables
{
}


/* ************************************************************** */
/*                           system                               */
/* ************************************************************** */



/* ************************************************************** */
/*                        Functions                               */
/* ************************************************************** */

/// <EcuReset>
/* ********************************************************************* */
/* Function                                                              */
/*  EcuReset_timeout_handler                                             */
/* Discription                                                           */
/*  Sid0x11 [EcuReset] timeout handler                                   */
/* IN :                                                                  */
/*  None                                                                 */
/* OUT:                                                                  */
/*  None                                                                 */
/* RET:                                                                  */
/*  None                                                                 */
/* NOTE:                                                                 */
/*  EcuReset(hardReset)のタイムアウト時のみ実行される                    */
/* ********************************************************************* */
void EcuReset_timeout_handler(void)
{
  /* SID Request Sid0x11 [EcuReset] のレスポンスメッセージ型のオブジェクトを定義 */
  diagResponse EcuReset_hardReset res_msg;
  
  Debug_Log_output("EcuReset_timeout_handler: timeout detected.");
  
  /* レスポンス受信ハンドラを呼び出して処理を継続する */
  Diag_Response_handler(res_msg);
  
  return;
}


/// <EcuReset>
/* ******************************************************** */
/* Function                                                 */
/*  EcuReset_hardReset_request_01_send                      */
/* Discription                                              */
/*  Send Request Sid0x11 [EcuReset]                         */
/* IN :                                                     */
/*  addrtype : 機能/物理アドレスの指定                      */
/*  sprmib : SPRMIB有効フラグ(E_FLAG_ON=ならSPRMIBを付与)   */
/* OUT:                                                     */
/*  None                                                    */
/* RET:                                                     */
/*  diagSendRequest()の処理結果 または                      */
/*  E_Return_SPRMIB_Set_NG                                  */
/* NOTE:                                                    */
/*  None                                                    */
/* ******************************************************** */
long EcuReset_hardReset_request_01_send( dword addrtype, long sprmib )
{
  /* 戻り値 */
  int ret;

  /* アドレス指定によって物理アドレスか機能アドレスのどちらに送信するか判定 */
  if ( addrtype == E_Send_Address_Phy )
  {
    /* 物理アドレスにリクエスト送信 */
    if ( sprmib == E_Flag_OFF )
    {
      /* リクエスト送信 */
      ret = diagSendRequest( G_EcuReset_req_01 );
    }
    else if( sprmib == E_Flag_ON )
    {
      /* SPRMIBを設定するので、タイムアウト時に次のシーケンスに移れるよう専用のタイムアウトハンドラを再登録する */
      ret = diagSetTimeoutHandler(G_EcuReset_req_01, "EcuReset_timeout_handler");
      if(ret != 0)
      {
        /* ハンドラ設定失敗 */
        /* デバッグ表示 */
        Error_Log_output("EcuReset_hardReset_request_01_send:diagSetTimeoutHandler error. for G_EcuReset_req_01");
      }
      /* リクエスト送信 */
      ret = diagSendRequest( G_EcuReset_req_01 );    
    }
    else
    {
      Error_Log_output("EcuReset_hardReset_request_01_send: illegal sprmib set.");
    }
  }
  else if (addrtype == E_Send_Address_Func )
  {
    /* 機能アドレスにリクエスト送信 */
        if ( sprmib == E_Flag_OFF )
    {
      /* リクエスト送信 */
      ret = diagSendFunctional( G_EcuReset_req_01 );
    }
    else if( sprmib == E_Flag_ON )
    {
      /* SPRMIBを設定するので、タイムアウト時に次のシーケンスに移れるよう専用のタイムアウトハンドラを再登録する */
      ret = diagSetTimeoutHandler(G_EcuReset_req_01, "EcuReset_timeout_handler");
      if(ret != 0)
      {
        /* ハンドラ設定失敗 */
        /* デバッグ表示 */
        Error_Log_output("EcuReset_hardReset_request_01_send:diagSetTimeoutHandler error. for G_EcuReset_req_01");
      }
      /* リクエスト送信 */
      ret = diagSendFunctional( G_EcuReset_req_01 );    
    }
    else
    {
      Error_Log_output("EcuReset_hardReset_request_01_send: illegal sprmib set.");
    }
  }
  else
  {
    /* 通常ありえないがアドレス指定異常 */
    Error_Log_output("EcuReset_hardReset_request_01_send:illegal addrtype.");
  }
  
  /* リクエスト送信の戻り値を返す */
  return ret;    
}


/// <EcuReset>
/* ******************************************************** */
/* Function                                                 */
/*  ECUReset_req_distribution                               */
/* Discription                                              */
/*  Sid0x11 [ECUReset] request distribution                 */
/* IN :                                                     */
/*  addrtype : 機能/物理アドレスの指定                      */
/*  type   : resetTypeに相当する値                          */
/*  sprmib : SPRMIB有効フラグ(E_FLAG_ON=ならSPRMIBを付与)   */
/* OUT:                                                     */
/*  None                                                    */
/* RET:                                                     */
/*  diagSendRequest()の処理結果 または                      */
/*  E_Return_SPRMIB_Set_NG または E_Return_PRAMETER_NG      */
/* NOTE:                                                    */
/*  None                                                    */
/* ******************************************************** */
long ECUReset_req_distribution( dword addrtype, dword type, long sprmib )
{
  /* 戻り値 */
  int ret;
  
  /* resetTypeの指定によってリクエスト送信処理を振り分ける */
  if ( type == E_resetType_hardReset )
  {
    /* リクエスト送信実施(ECUReset(hardReset)) */
    ret = EcuReset_hardReset_request_01_send( addrtype, sprmib );
  }
  else
  {
    /* パラメータエラー */
    ret = E_Return_PRAMETER_NG;    
  }

  /* 戻り値の判断は上位関数で実施 */
  return ret;
}


/// <EcuReset>
/* ******************************************************** */
/* Function                                                 */
/*  ECUReset_res_distribution                               */
/* Discription                                              */
/*  Sid0x11 [ECUReset]  response distribution               */
/* IN :                                                     */
/*  res_msg   : diagResponse型のPosRspメッセージ            */
/* OUT:                                                     */
/*  None                                                    */
/* RET:                                                     */
/*  E_Return_OK                                             */
/* NOTE:                                                    */
/*  byte#1 ECUReset Response SID                            */
/*  byte#2 resetType                                        */
/* ******************************************************** */
long ECUReset_res_distribution( diagResponse * res_msg )
{
  /* 戻り値 */
  int ret;

  /* ECUResetのポジティブレスポンス受信時は処理無し */
  ret = E_Return_OK;
  
  return ret;
}
